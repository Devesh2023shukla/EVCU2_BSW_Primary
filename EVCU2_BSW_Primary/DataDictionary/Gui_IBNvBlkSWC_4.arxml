[part 4 of 5: package /IBNvBlkSWC_4]
AUTOSAR XML (schema 00050)
package /IBNvBlkSWC_4  (continued)
  nv block sw component type IBNvBlkSWC_4  (continued)
    10 x nv block descriptor, all with support-dirty-flag=true:  (continued)
      ExpendableNonVolatile_Descr_Core4  (continued)
        nv block needs NvBlockNeeds: calc-ram-block-crc=false, check-static-block-id=false, readonly=false, resistant-to-changed-sw=false, restore-at-start=true, store-at-shutdown=true, store-cyclic=false, store-emergency=false, store-immediate=false, use-auto-validation-at-shut-down=false, use-crc-comp-mechanism=true, write-only-once=false, write-verification=false
        ram block ExpendableNonVolatile_RamBlock_Core4: type=ExpendableNonVolatile_Ram_Core4, init-value={short-label=ExpendableNonVolatile_Ram_Core4, fields=[NeESMC_I_Ahrperhr_DS:0, NeSCPR_g_DoNotRepeatValSch1:0, NeSCPR_Pct_Sch1CoCH_ImmSOCtrgt:0, NeSCPR_Pct_Sch2CoCH_ExtSOCtrgt:0, NeSCPR_Pct_Sch2CoCH_ImmSOCtrgt:0, NeDCCR_E_TECharge:0, NeDCCR_E_TEDischarge:0, NeSCPR_k_LastSecond:0, NeSCPR_k_LastRTC:0, NeSCPR_k_CancOverlapTrack:0, NeSCPR_k_CancGlStartTrack:0, NeSCPR_k_CancGlEndTrack:0, NeSCPR_k_CabinTempSetPoint:4294967295, NeSCPR_g_Sch2CoCH_DNRvalue:0, NeSCPR_g_Sch2CP_DNRvalue:0, NeSCPR_g_Sch1CoCH_DNRvalue:0, NeSCPR_g_Sch1CP_DNRvalue:0, NeSCPR_g_DoNotRepeatValSch2:0, NeSCPR_Pct_SOCArb:100, NeSCPR_Pct_Sch1CoCH_ExtSOCtrgt:0, NeITIR_t_TimeToResetRecentVar:0, NeITIR_E_MtrATotalTractionEnergy_Lifetime:0, NeITIR_E_MtrATotalTractionEnergy_Recent:0, NeITIR_E_MtrBTotalTractionEnergy_Lifetime:0, NeITIR_E_MtrBTotalTractionEnergy_Recent:0, NeITIR_E_NonGrdEnrgy_Lifetime:0, NeITIR_E_NonGrdEnrgy_Recent:0, NeITIR_l_DistTravelChrgDepEngOff_Lifetime:0, NeITIR_l_DistTravelChrgDepEngOff_Recent:0, NeITIR_l_DistTravelChrgDepEngOn_Lifetime:0, NeITIR_l_DistTravelChrgDepEngOn_Recent:0, NeITIR_l_DistTravelChrgIncrease_Recent:0, NeITIR_l_DistTrvlChrgIncrease_Lifetime:0, NeITIR_l_TotalDistTravelled_Lifetime:0, NeITIR_l_TotalDistTravelled_Recent:0, NeITIR_E_GrdEnrgyIntoBatt_Lifetime:0, NeITIR_E_GrdEnrgyIntoBatt_Recent:0, NeITIR_E_GrdEnrgyChrgDepEngOn_Recent:0, NeCSVR_l_DistSinceCodeClr:0, NeITIR_Cnt_FuelConsChrgDep_Lifetime:0, NeRTMR_t_BattChrgTimer_PID:0, NeRTMR_P_BattChrgPwrOffset_PID:0, NeRTMR_It_BattChrgTarget_PID:0, 0, NeRTMR_It_BattChargedAmnt_PID:0, NeITIR_Cnt_FuelConsChrgDep_Recent:0, NeITIR_E_GrdEnrgyChrgDepEngOn_Lifetime:0, NeITIR_Cnt_FuelConsChrgIncrease_Lifetime:0, NeITIR_Cnt_FuelConsChrgIncrease_Recent:0, NeITIR_Cnt_FuelEngIgnCycl_Lifetime:0, NeITIR_Cnt_FuelEngIgnCycl_Recent:0, NeITIR_Cnt_IgnCycl_Lifetime:0, NeITIR_Cnt_IgnCycl_Recent:0, NeITIR_Cnt_Total_City_PSA_Time_Lifetime:0, NeITIR_Cnt_Total_City_PSA_Time_Recent:0, NeITIR_Cnt_Total_Idle_PSA_Time_Lifetime:0, NeITIR_Cnt_Total_Idle_PSA_Time_Recent:0, NeITIR_Cnt_Total_PSA_Time_Lifetime:0, NeITIR_Cnt_Total_PSA_Time_Recent:0, NeITIR_E_GrdEnrgyChrgDepEngOff_Lifetime:0, NeITIR_E_GrdEnrgyChrgDepEngOff_Recent:0, NeCSVR_l_DistTravelMIL_On:0, NeBPCR_T_BatModTmp:0, NeTPCR_Pct_WupSOC:4294967295, NeCCCR_P_PLSMaxPower:0, NeCCCR_T_AmbTemp_CntrlrOff:0, NeCCCR_T_EngTemp_CntrlrOff:0, NeCCCR_t_CntrlrOnTime:0, 0, NeAATR_T_AmbAirTempPred_Prev:25, NeCCCR_t_CntrlrOffTime:0, NePWDR_Cnt_HVFuseEMFOP:0, NeVLDR_Cnt_CPV2_PerfDiag_MFOP:0, NeVLDR_Cnt_BHV_PerfDiag_MFOP:0, NeVLDR_Cnt_CPV_PerfDiag_MFOP:0, NePWDR_Cnt_HVOverVoltFailureMSOF:65535, NeVLDR_Cnt_CabVlvOpeng_Err_MFOP:0, NePWDR_Cnt_HVOverVoltWarnMFOP:0, NeVLDR_Cnt_EEXV_PerfDiag_MFOP:0, NeVLDR_Cnt_EEXV_PressElctrFlt_MFOP:0, NePWDR_Cnt_HVFuseDMFOP:0, NePWDR_Cnt_HVFuseCMFOP:0, NePWDR_Cnt_HVILCkt_MFOP:0, NePWDR_Cnt_HVFuseBMFOP:0, NePWDR_Cnt_HVFuseAMFOP:0, NePWDR_Cnt_HVDAPMFOP:0, NePWDR_Cnt_HVOverVoltFailureMFOP:0, NeVLDR_Cnt_EEXV_TempElctrFlt_MFOP:0, NePWDR_Cnt_BattOverTempFailureMFOP:0, NeVLDR_Cnt_EEXV_PressSens_MFOP:0, NeVLDR_Cnt_EXV_PerfDiag_MFOP:0, NePMDR_Cnt_BF1SysVoltHi_MFOP:0, NePMDR_Cnt_BFHBSpareSysVoltHi_MFOP:0, NePMDR_Cnt_BF3SysVoltLow_MFOP:0, NeVLDR_Cnt_OEXV_PressElctrFlt_MFOP:0, NeVLDR_Cnt_OEXV_PressSens_MFOP:0, NePMDR_Cnt_BF3SysVoltHi_MFOP:0, NePMDR_Cnt_BF2SysVoltLow_MFOP:0, NePMDR_Cnt_BF2SysVoltHi_MFOP:0, NePMDR_Cnt_BF1SysVoltLow_MFOP:0, NePMDD_Cnt_RunLoMaxFOP:0, NeVLDR_Cnt_EXV_PressElctrFlt_MFOP:0, NeVLDR_Cnt_OEXV_TempElctrFlt_MFOP:0, NeAADR_Cnt_AAD_PerfDiag_MFOP:0, NePMDD_Cnt_RunCrankOpenMaxFOP:0, NePMDD_Cnt_RunCrankHiMaxFOP:0, NePMDD_Cnt_AccLoMaxFOP:0, NePMDD_Cnt_AccHiMaxFOP:0, NePMDR_Cnt_BFHBSysVoltHi_MFOP:0, NePMDR_Cnt_HBSpareSysVoltLow_MFOP:0, NePMDR_Cnt_HBSysVoltLow_MFOP:0, NePWDR_Cnt_HVUnderVoltFailureMFOP:0, NeVLDR_Cnt_EXV_PressSens_MFOP:0, NeVLDR_Cnt_EXV_TempElctrFlt_MFOP:0, NeVLDR_Cnt_EXV_TempSens_MFOP:0, NeVLDR_Cnt_HCTV_Leak_MFOP:0, NeVLDR_Cnt_HTL_PerfDiag_MFOP:0, NeVLDR_Cnt_HTSoV_StkCls_MFOP:0, NePWDR_Cnt_BPCM_MFOP:0, NeVLDR_Cnt_HTSoV_StkOpn_MFOP:0, NeVLDR_Cnt_LTR_PerfDiag_MFOP:0, NeVLDR_Cnt_LTSOV_StkOff_MFOP:0, NeVLDR_Cnt_LTSOV_StkOn_MFOP:0, NeVLDR_Cnt_OEXV_PerfDiag_MFOP:0, NePWDR_Cnt_HVOverVoltWarnMSOF:65535, NeTHDR_Cnt_OEXV_In_MFOP:0, NePWDR_Cnt_HVUnderVoltFailureMSOF:65535, NeTHDR_Cnt_InTmpSns_MFOP:0, NeTHDR_Cnt_HTAP_MFOP:0, NeTHDR_Cnt_HCCTOS_MFOP:0, NeSCPR_e_NxtSchCH_StrtDay:0, NeSCPR_e_NxtSchCH_EndMin:0, NeSCPR_e_NxtSchCH_StrtMin:0, NeSCPR_e_NxtSchCH_EndHr:0, NeSCPR_e_NxtSchCH_EndDay:0, NeSCPR_e_LastNowIndex:0, NeSCPR_e_EndIndexCanc:0, NeSCPR_e_CancelStartIndx:0, NeSCPR_e_CancStartIdxHold:0, NeSCPR_e_NxtSchCH_StrtHr:0, NeSCPR_e_Sch2CoCH_StopMin:0, NeTHDR_Cnt_OEXV_Out_MFOP:0, NeTHDR_Cnt_OOCTOS_MFOP:0, NeTHDR_Cnt_PPCTIS_MFOP:0, NeTHDR_Cnt_PPCTIS_OT_MSOP:0, NeTHDR_Cnt_LTPP2_MFOP:0, NeTHDR_Cnt_LRCTOS_MFOP:0, NeTIDR_Cnt_EngTrqHiFlt_MFOP:0, NeTIDR_Cnt_EngTrqHiFlt_MSOF:0, NeSCPR_e_Sch2CoCH_StopHr:0, NeTISD_Cnt_SpdRatlFlt_MFOP:0, NeSCPR_e_Sch1CoCH_StopMin:0, NeSCPR_e_Sch1CoCH_StopHr:0, NeTIDR_Cnt_EngTrqLoFlt_MFOP:0, NeTIDR_Cnt_EngTrqLoFlt_MSOF:0, NeTIMR_e_TrrnMdSt:0, NeSCPR_e_NxtSchCP_StrtMin:0, NeSCPR_e_NxtSchCP_StrtHr:0, NeSCPR_e_NxtSchCP_Day:0, NeTHDR_Cnt_HCCTIS_MFOP:0, NeTHDR_Cnt_LTPP_MFOP:0, NeTHDR_Cnt_AGS2_Perf_MFOP:0, NePWDR_Cnt_StuckHiFOP:0, NePWDR_Cnt_SOCLowWarnMFOP:0, NePWDR_Cnt_SOCLowFailureMFOP:0, NePWDR_Cnt_SOCHighWarnMFOP:0, NePWDR_Cnt_SOCHighFailureMFOP:0, NePWDR_Cnt_MsmtchLowFOP:0, NePWDR_Cnt_HVUnderVoltWarnMSOF:65535, NeTHDR_Cnt_AGS_Perf_MFOP:0, NeTHDR_Cnt_EEXV_Out_MFOP:0, NeTHDR_Cnt_ECH_outTmpSns_MFOP:0, NeTHDR_Cnt_ECHTIS_MFOP:0, NePWDR_Cnt_HVUnderVoltWarnMFOP:0, NePMDD_Cnt_RunHiMaxFOP:0, NeCPDR_Cnt_LTAP_FunPer_MFOP:0, NeCSVD_Cnt_RearAxleRatlFlt_MFOP:0, NeCSVD_Cnt_FrontAxleRatlFlt_MFOP:0, NeCPDR_Cnt_LTPP_FunPer_MFOP:0, NeCPDR_Cnt_LTPP_FunDryRun_MFOP:0, NeCPDR_Cnt_LTPP2_FunPer_MFOP:0, NeCPDR_Cnt_LTPP2_FunDryRun_MFOP:0, NeCPDR_Cnt_LTAP_FunDryRun_MFOP:0, NeDMIR_e_DriveStyleSts:0, NeCPDR_Cnt_HTAP_FunPer_MFOP:0, NeCPDR_Cnt_EOPB_FunPer_MFOP:0, NeCPDR_Cnt_EOPB_FunDryRun_MFOP:0, NeCPDR_Cnt_EOPA_FunPer_MFOP:0, NeCPDR_Cnt_EOPA_FunDryRun_MFOP:0, NeCDMR_Cnt_PwrOutletPanelMod2Perf_MFOP:0, NeCDMR_Cnt_PwrOutletPanelMod2LmpCntrl_MFOP:0, NeCDMR_Cnt_PwrOutletPanelMod2InACPwrCktPerf_MFOP:0, NeCDMR_Cnt_PwrOutletPanelMod1Perf_MFOP:0, NeDMIR_e_DrvMdArb:0, NeHCDR_Cnt_HVC_Heater_MFOP:0, NeHSWD_Cnt_SecBnt_Correlation_MFOP:0, NeHSWD_Cnt_SecBnt_CircuitPerf_MFOP:0, NeHSWD_Cnt_SecBnt_CircuitLow_MFOP:0, NeHSWD_Cnt_SecBnt_CircuitHigh_MFOP:0, NeHSWD_Cnt_CBC_FaultLow_MFOP:0, NeHSWD_Cnt_CBC_FaultHigh_MFOP:0, NeHCDR_Cnt_HVC_Heater4_MFOP:0, NeHCDR_Cnt_HVC_Heater3_MFOP:0, NeHCDR_Cnt_HVC_Heater2_MFOP:0, NeHCDR_Cnt_EACPref_MFOP:0, NeGENR_Cnt_InPlantAPMOff:0, NeCDMR_Cnt_PwrOutletPanelMod1LmpCntrl_MFOP:0, NeCDMR_Cnt_PwrOutletPanelMod1InACPwrCktPerf_MFOP:0, NeCDMR_Cnt_InletSensor_MFOP:0, NeAATR_Cnt_SCP_DCPstvTemp_LoFlt_MFOP:0, NeBPCR_Cnt_PWMCntctrStMFOP:0, NeADIR_Cnt_WEDMechFailure_MFOP:0, NeAATR_Cnt_SCP_InletTemp_PerfFlt_MFOP:0, NeAATR_Cnt_SCP_InletTemp_LoFlt_MFOP:0, NeAATR_Cnt_SCP_InletTemp_HiFlt_MFOP:0, NeAATR_Cnt_SCP_InletTemp_Flt_MFOP:0, NeAATR_Cnt_SCP_DCPstvTemp_PerfFlt_MFOP:0, NeAATR_Cnt_SCP_DCPstvTemp_Flt_MFOP:0, NeCDMR_Cnt_DTCShortName6_MFOP:0, NeAATR_Cnt_SCP_DCNegtvTemp_PerfFlt_MFOP:0, NeAATR_Cnt_SCP_DCNegtvTemp_LoFlt_MFOP:0, NeAATR_Cnt_SCP_DCNegtvTemp_HiFlt_MFOP:0, NeAATR_Cnt_SCP_DCNegtvTemp_Flt_MFOP:0, NeAATR_Cnt_ECM_IntakeTemp_PerfFlt_MFOP:0, NeAATR_Cnt_DCPstvTemp_HiFlt_MFOP:0, NeAATR_Cnt_AmbAirVolt_LoFlt_MFOP:0, NeAATR_Cnt_AmbAirVolt_HiFlt_MFOP:0, NeAATR_Cnt_AmbAirTemp_PerfFlt_MFOP:0, NeCDMR_Cnt_ChrgPortUnlock_MFOP:0, NeCDMR_Cnt_ChrgPortRlyActCkt_MFOP:0, NeCDMR_Cnt_ChrgPortLock_MFOP:0, NeCDMR_Cnt_ChgPrtLckFailLMFOP:0, NeCDMR_Cnt_ChgPrtLckFailHMFOP:0, NeCDMR_Cnt_CPIMInternal_MFOP:0, NeCDMR_Cnt_BCIMInternal_MFOP:0, NeCCTR_Cnt_SpdCntrlSw1_MFOP:0, NeBTQD_Cnt_ESPSignalDiag_MFOP:0, NeBRDR_Cnt_LTAP_MFOP:0, NeBRDR_Cnt_HeatExPerf_MFOP:0, NeBRDR_Cnt_HV_BTOS_MFOP:0, NeBRDR_Cnt_HV_BTOS2_MFOP:0, NeBRDR_Cnt_HV_BTIS_MFOP:0, NeBRDR_Cnt_HV_BTIS2_MFOP:0, NeBRDR_Cnt_HV_BHOS_MFOP:0, NeBRDR_Cnt_HVBatCltLvlSnsCkt_MFOP:0, NeBRDR_Cnt_HVBatCltLvLo_OC_MFOP:0, NeBRDR_Cnt_ChillPerf_MFOP:0, NeHVTR_Cnt_AntiTampCounter:65535, NeHSWD_Cnt_CBC_Range_MFOP:0, NeITIR_Cnt_TimeSinceEngineStrt:0, NeIMPR_Cnt_HVShtDwn_MFOP:0, NeCCCR_b_FirstIncrFlag_MinHot:0, NeCITR_b_PortLockBCM_Cmd:0, NeCITR_b_Lock_Status:0, NeCCCR_e_PwrLvlSet:0, NeDMIR_e_PddlMdStatus:0, NeDMIR_e_CreepSts:0, NeCSVR_e_MIL_LightRequest:255, NeSSDC_b_HVBatPerWU12VChrg:0, NeSSDC_b_HVBatPerWUCabinPre:0, NeSSDC_b_HVBatPerWUSchChrg:0, NeSSDC_b_HVBatPerWUThermal:0, NeCSVR_b_PriorMIL_StatusOn:1, NeCPLR_e_RemoteLockLastSts:0, NeCPLR_e_DoorLastSts:0, NeCPLR_e_ChargeportLockLastSts:0, NeCPLR_b_ManualRelease:0, NeCCCR_b_FirstIncrFlag_MaxHot:0, NeCCCR_b_FirstIncrFlag_MinCold:0, NeCCCR_b_FirstIncrFlag_Cold:0, NeCCCR_b_FirstIncrFlag_MaxCold:0, NeAECR_e_eCoastLvlLatched:0, NeAECR_e_eCoastDefaultCustom:0, NeAECR_e_eCoastDefaultAuto:0, NeAECR_e_RegenSts:0, NeAECR_e_RaceModeSts:0, NeAECR_e_PddlMdStatus:0, NeCCCR_b_FirstIncrFlag_Hot:0, NeAATR_b_AmbAirTempPred_PrevFA:1, NeOBCR_b_GoodConnEst:1, NeOBCR_b_Lvl1Latch:1, NeOBCR_b_Lvl2Latch:1, NeOBCR_b_SmartEvse_Detected:1, NeOFCR_b_PluginLatchOverride:0, NeOFCR_b_RadioRqLstVldStt:0, NeBPCR_b_HV_BatPackSOC_FA_Ovrd:1, NeBPCR_b_HV_BatRdy:1, NeDMIR_e_RegenSts:0, NeCCCR_b_FirstDecrFlag_MinHot:0, NeCCCR_b_FirstDecrFlag_MinCold:0, NeCCCR_b_FirstDecrFlag_MaxHot:0, NeTIMR_b_RacePrepType:0, NeTIMR_e_CustomDrvMdSts:0, NeTIMR_e_RacePrepMode:0, NeCCCR_b_FirstDecrFlag_MaxCold:0, NeCCCR_b_FirstDecrFlag_Hot:0, NeCCCR_b_FirstDecrFlag_Cold:0, NeTPCR_b_12VloadShed:1, NeTPCR_b_HoldCabPrecFailLtch:1, NeTPCR_b_RS_CabPrecDeny_Prev:1, NeTRGR_y_IP_PRNDLTestFailStatus:0, NePPCR_e_PrvCmdVal:255, NeDMIR_e_RaceModeSts:0, NeDMIR_e_eCoastDefaultAuto:0, NeSCPR_y_Sch2CoCH_Day:0, NeRTMR_y_RngTestResult_PID:0, NeRTMR_e_BattChrgStatus_PID:0, NeRTMR_y_BattChrgCndtnCheck_PID:0, NeRTMR_y_RngTestStatus_PID:0, NeRTMR_y_RngTstCndtnCheck1_PID:0, NeRTMR_y_RngTstCndtnCheck2_PID:0, NeSCPR_y_Sch1CoCH_Day:0, NeSCPR_e_Sch1CH_SchType:0, NeSCPR_e_Sch2CH_SchType:0, NeENGR_b_IAT_SnsrFA:0, NeENGR_b_ECT_SnsrFA:0, NeDMIR_e_eCoastLvlLatched:0, NeDMIR_e_eCoastDefaultCustom:0, NeSCPR_b_xMinUFCancel:0, NeSCPR_b_xMinUF:0, NeSCPR_b_StopChrg:0, NeSCPR_b_Sch2CoCH_Enbl:0, NeHVTR_b_AntiTampFailed:0, NeSCPR_b_AllowCancel:0, NeSCPR_b_CancSchedIsUF:0, NeSCPR_b_CancWindow:0, NeSCPR_b_ChrgComplete:0, NeSCPR_b_CoCH_Sch1_DNR:0, NeSCPR_b_CoCH_Sch2_DNR:0, NeSCPR_b_CoCh_VehLocation:0, NeSCPR_b_PluginLatchOverride:0, NeSCPR_b_RadioRqLstVldStt:0, NeSCPR_b_Sch1CoCH_Enbl:0, Reserved1:0, Reserved2:0, Reserved3:0, Reserved4:0, Reserved5:0, Reserved6:0, Reserved7:0, Reserved8:0, Reserved9:0, Reserved10:0, Reserved11:0, Reserved12:0, Reserved13:0, Reserved14:0, Reserved15:0, Reserved16:0, Reserved17:0, Reserved18:0, Reserved19:0, Reserved20:0, Reserved21:0, Reserved22:0, Reserved23:0, Reserved24:0, Reserved25:0, Reserved26:0]}
        rom block ExpendableNonVolatile_RomBlock_Core4: type=ExpendableNonVolatile_Rom_Core4, init-value={short-label=ExpendableNonVolatile_Rom_Core4, fields=[NeESMC_I_Ahrperhr_DS:0, NeSCPR_g_DoNotRepeatValSch1:0, NeSCPR_Pct_Sch1CoCH_ImmSOCtrgt:0, NeSCPR_Pct_Sch2CoCH_ExtSOCtrgt:0, NeSCPR_Pct_Sch2CoCH_ImmSOCtrgt:0, NeDCCR_E_TECharge:0, NeDCCR_E_TEDischarge:0, NeSCPR_k_LastSecond:0, NeSCPR_k_LastRTC:0, NeSCPR_k_CancOverlapTrack:0, NeSCPR_k_CancGlStartTrack:0, NeSCPR_k_CancGlEndTrack:0, NeSCPR_k_CabinTempSetPoint:4294967295, NeSCPR_g_Sch2CoCH_DNRvalue:0, NeSCPR_g_Sch2CP_DNRvalue:0, NeSCPR_g_Sch1CoCH_DNRvalue:0, NeSCPR_g_Sch1CP_DNRvalue:0, NeSCPR_g_DoNotRepeatValSch2:0, NeSCPR_Pct_SOCArb:100, NeSCPR_Pct_Sch1CoCH_ExtSOCtrgt:0, NeITIR_t_TimeToResetRecentVar:0, NeITIR_E_MtrATotalTractionEnergy_Lifetime:0, NeITIR_E_MtrATotalTractionEnergy_Recent:0, NeITIR_E_MtrBTotalTractionEnergy_Lifetime:0, NeITIR_E_MtrBTotalTractionEnergy_Recent:0, NeITIR_E_NonGrdEnrgy_Lifetime:0, NeITIR_E_NonGrdEnrgy_Recent:0, NeITIR_l_DistTravelChrgDepEngOff_Lifetime:0, NeITIR_l_DistTravelChrgDepEngOff_Recent:0, NeITIR_l_DistTravelChrgDepEngOn_Lifetime:0, NeITIR_l_DistTravelChrgDepEngOn_Recent:0, NeITIR_l_DistTravelChrgIncrease_Recent:0, NeITIR_l_DistTrvlChrgIncrease_Lifetime:0, NeITIR_l_TotalDistTravelled_Lifetime:0, NeITIR_l_TotalDistTravelled_Recent:0, NeITIR_E_GrdEnrgyIntoBatt_Lifetime:0, NeITIR_E_GrdEnrgyIntoBatt_Recent:0, NeITIR_E_GrdEnrgyChrgDepEngOn_Recent:0, NeCSVR_l_DistSinceCodeClr:0, NeITIR_Cnt_FuelConsChrgDep_Lifetime:0, NeRTMR_t_BattChrgTimer_PID:0, NeRTMR_P_BattChrgPwrOffset_PID:0, NeRTMR_It_BattChrgTarget_PID:0, 0, NeRTMR_It_BattChargedAmnt_PID:0, NeITIR_Cnt_FuelConsChrgDep_Recent:0, NeITIR_E_GrdEnrgyChrgDepEngOn_Lifetime:0, NeITIR_Cnt_FuelConsChrgIncrease_Lifetime:0, NeITIR_Cnt_FuelConsChrgIncrease_Recent:0, NeITIR_Cnt_FuelEngIgnCycl_Lifetime:0, NeITIR_Cnt_FuelEngIgnCycl_Recent:0, NeITIR_Cnt_IgnCycl_Lifetime:0, NeITIR_Cnt_IgnCycl_Recent:0, NeITIR_Cnt_Total_City_PSA_Time_Lifetime:0, NeITIR_Cnt_Total_City_PSA_Time_Recent:0, NeITIR_Cnt_Total_Idle_PSA_Time_Lifetime:0, NeITIR_Cnt_Total_Idle_PSA_Time_Recent:0, NeITIR_Cnt_Total_PSA_Time_Lifetime:0, NeITIR_Cnt_Total_PSA_Time_Recent:0, NeITIR_E_GrdEnrgyChrgDepEngOff_Lifetime:0, NeITIR_E_GrdEnrgyChrgDepEngOff_Recent:0, NeCSVR_l_DistTravelMIL_On:0, NeBPCR_T_BatModTmp:0, NeTPCR_Pct_WupSOC:4294967295, NeCCCR_P_PLSMaxPower:0, NeCCCR_T_AmbTemp_CntrlrOff:0, NeCCCR_T_EngTemp_CntrlrOff:0, NeCCCR_t_CntrlrOnTime:0, 0, NeAATR_T_AmbAirTempPred_Prev:25, NeCCCR_t_CntrlrOffTime:0, NePWDR_Cnt_HVFuseEMFOP:0, NeVLDR_Cnt_CPV2_PerfDiag_MFOP:0, NeVLDR_Cnt_BHV_PerfDiag_MFOP:0, NeVLDR_Cnt_CPV_PerfDiag_MFOP:0, NePWDR_Cnt_HVOverVoltFailureMSOF:65535, NeVLDR_Cnt_CabVlvOpeng_Err_MFOP:0, NePWDR_Cnt_HVOverVoltWarnMFOP:0, NeVLDR_Cnt_EEXV_PerfDiag_MFOP:0, NeVLDR_Cnt_EEXV_PressElctrFlt_MFOP:0, NePWDR_Cnt_HVFuseDMFOP:0, NePWDR_Cnt_HVFuseCMFOP:0, NePWDR_Cnt_HVILCkt_MFOP:0, NePWDR_Cnt_HVFuseBMFOP:0, NePWDR_Cnt_HVFuseAMFOP:0, NePWDR_Cnt_HVDAPMFOP:0, NePWDR_Cnt_HVOverVoltFailureMFOP:0, NeVLDR_Cnt_EEXV_TempElctrFlt_MFOP:0, NePWDR_Cnt_BattOverTempFailureMFOP:0, NeVLDR_Cnt_EEXV_PressSens_MFOP:0, NeVLDR_Cnt_EXV_PerfDiag_MFOP:0, NePMDR_Cnt_BF1SysVoltHi_MFOP:0, NePMDR_Cnt_BFHBSpareSysVoltHi_MFOP:0, NePMDR_Cnt_BF3SysVoltLow_MFOP:0, NeVLDR_Cnt_OEXV_PressElctrFlt_MFOP:0, NeVLDR_Cnt_OEXV_PressSens_MFOP:0, NePMDR_Cnt_BF3SysVoltHi_MFOP:0, NePMDR_Cnt_BF2SysVoltLow_MFOP:0, NePMDR_Cnt_BF2SysVoltHi_MFOP:0, NePMDR_Cnt_BF1SysVoltLow_MFOP:0, NePMDD_Cnt_RunLoMaxFOP:0, NeVLDR_Cnt_EXV_PressElctrFlt_MFOP:0, NeVLDR_Cnt_OEXV_TempElctrFlt_MFOP:0, NeAADR_Cnt_AAD_PerfDiag_MFOP:0, NePMDD_Cnt_RunCrankOpenMaxFOP:0, NePMDD_Cnt_RunCrankHiMaxFOP:0, NePMDD_Cnt_AccLoMaxFOP:0, NePMDD_Cnt_AccHiMaxFOP:0, NePMDR_Cnt_BFHBSysVoltHi_MFOP:0, NePMDR_Cnt_HBSpareSysVoltLow_MFOP:0, NePMDR_Cnt_HBSysVoltLow_MFOP:0, NePWDR_Cnt_HVUnderVoltFailureMFOP:0, NeVLDR_Cnt_EXV_PressSens_MFOP:0, NeVLDR_Cnt_EXV_TempElctrFlt_MFOP:0, NeVLDR_Cnt_EXV_TempSens_MFOP:0, NeVLDR_Cnt_HCTV_Leak_MFOP:0, NeVLDR_Cnt_HTL_PerfDiag_MFOP:0, NeVLDR_Cnt_HTSoV_StkCls_MFOP:0, NePWDR_Cnt_BPCM_MFOP:0, NeVLDR_Cnt_HTSoV_StkOpn_MFOP:0, NeVLDR_Cnt_LTR_PerfDiag_MFOP:0, NeVLDR_Cnt_LTSOV_StkOff_MFOP:0, NeVLDR_Cnt_LTSOV_StkOn_MFOP:0, NeVLDR_Cnt_OEXV_PerfDiag_MFOP:0, NePWDR_Cnt_HVOverVoltWarnMSOF:65535, NeTHDR_Cnt_OEXV_In_MFOP:0, NePWDR_Cnt_HVUnderVoltFailureMSOF:65535, NeTHDR_Cnt_InTmpSns_MFOP:0, NeTHDR_Cnt_HTAP_MFOP:0, NeTHDR_Cnt_HCCTOS_MFOP:0, NeSCPR_e_NxtSchCH_StrtDay:0, NeSCPR_e_NxtSchCH_EndMin:0, NeSCPR_e_NxtSchCH_StrtMin:0, NeSCPR_e_NxtSchCH_EndHr:0, NeSCPR_e_NxtSchCH_EndDay:0, NeSCPR_e_LastNowIndex:0, NeSCPR_e_EndIndexCanc:0, NeSCPR_e_CancelStartIndx:0, NeSCPR_e_CancStartIdxHold:0, NeSCPR_e_NxtSchCH_StrtHr:0, NeSCPR_e_Sch2CoCH_StopMin:0, NeTHDR_Cnt_OEXV_Out_MFOP:0, NeTHDR_Cnt_OOCTOS_MFOP:0, NeTHDR_Cnt_PPCTIS_MFOP:0, NeTHDR_Cnt_PPCTIS_OT_MSOP:0, NeTHDR_Cnt_LTPP2_MFOP:0, NeTHDR_Cnt_LRCTOS_MFOP:0, NeTIDR_Cnt_EngTrqHiFlt_MFOP:0, NeTIDR_Cnt_EngTrqHiFlt_MSOF:0, NeSCPR_e_Sch2CoCH_StopHr:0, NeTISD_Cnt_SpdRatlFlt_MFOP:0, NeSCPR_e_Sch1CoCH_StopMin:0, NeSCPR_e_Sch1CoCH_StopHr:0, NeTIDR_Cnt_EngTrqLoFlt_MFOP:0, NeTIDR_Cnt_EngTrqLoFlt_MSOF:0, NeTIMR_e_TrrnMdSt:0, NeSCPR_e_NxtSchCP_StrtMin:0, NeSCPR_e_NxtSchCP_StrtHr:0, NeSCPR_e_NxtSchCP_Day:0, NeTHDR_Cnt_HCCTIS_MFOP:0, NeTHDR_Cnt_LTPP_MFOP:0, NeTHDR_Cnt_AGS2_Perf_MFOP:0, NePWDR_Cnt_StuckHiFOP:0, NePWDR_Cnt_SOCLowWarnMFOP:0, NePWDR_Cnt_SOCLowFailureMFOP:0, NePWDR_Cnt_SOCHighWarnMFOP:0, NePWDR_Cnt_SOCHighFailureMFOP:0, NePWDR_Cnt_MsmtchLowFOP:0, NePWDR_Cnt_HVUnderVoltWarnMSOF:65535, NeTHDR_Cnt_AGS_Perf_MFOP:0, NeTHDR_Cnt_EEXV_Out_MFOP:0, NeTHDR_Cnt_ECH_outTmpSns_MFOP:0, NeTHDR_Cnt_ECHTIS_MFOP:0, NePWDR_Cnt_HVUnderVoltWarnMFOP:0, NePMDD_Cnt_RunHiMaxFOP:0, NeCPDR_Cnt_LTAP_FunPer_MFOP:0, NeCSVD_Cnt_RearAxleRatlFlt_MFOP:0, NeCSVD_Cnt_FrontAxleRatlFlt_MFOP:0, NeCPDR_Cnt_LTPP_FunPer_MFOP:0, NeCPDR_Cnt_LTPP_FunDryRun_MFOP:0, NeCPDR_Cnt_LTPP2_FunPer_MFOP:0, NeCPDR_Cnt_LTPP2_FunDryRun_MFOP:0, NeCPDR_Cnt_LTAP_FunDryRun_MFOP:0, NeDMIR_e_DriveStyleSts:0, NeCPDR_Cnt_HTAP_FunPer_MFOP:0, NeCPDR_Cnt_EOPB_FunPer_MFOP:0, NeCPDR_Cnt_EOPB_FunDryRun_MFOP:0, NeCPDR_Cnt_EOPA_FunPer_MFOP:0, NeCPDR_Cnt_EOPA_FunDryRun_MFOP:0, NeCDMR_Cnt_PwrOutletPanelMod2Perf_MFOP:0, NeCDMR_Cnt_PwrOutletPanelMod2LmpCntrl_MFOP:0, NeCDMR_Cnt_PwrOutletPanelMod2InACPwrCktPerf_MFOP:0, NeCDMR_Cnt_PwrOutletPanelMod1Perf_MFOP:0, NeDMIR_e_DrvMdArb:0, NeHCDR_Cnt_HVC_Heater_MFOP:0, NeHSWD_Cnt_SecBnt_Correlation_MFOP:0, NeHSWD_Cnt_SecBnt_CircuitPerf_MFOP:0, NeHSWD_Cnt_SecBnt_CircuitLow_MFOP:0, NeHSWD_Cnt_SecBnt_CircuitHigh_MFOP:0, NeHSWD_Cnt_CBC_FaultLow_MFOP:0, NeHSWD_Cnt_CBC_FaultHigh_MFOP:0, NeHCDR_Cnt_HVC_Heater4_MFOP:0, NeHCDR_Cnt_HVC_Heater3_MFOP:0, NeHCDR_Cnt_HVC_Heater2_MFOP:0, NeHCDR_Cnt_EACPref_MFOP:0, NeGENR_Cnt_InPlantAPMOff:0, NeCDMR_Cnt_PwrOutletPanelMod1LmpCntrl_MFOP:0, NeCDMR_Cnt_PwrOutletPanelMod1InACPwrCktPerf_MFOP:0, NeCDMR_Cnt_InletSensor_MFOP:0, NeAATR_Cnt_SCP_DCPstvTemp_LoFlt_MFOP:0, NeBPCR_Cnt_PWMCntctrStMFOP:0, NeADIR_Cnt_WEDMechFailure_MFOP:0, NeAATR_Cnt_SCP_InletTemp_PerfFlt_MFOP:0, NeAATR_Cnt_SCP_InletTemp_LoFlt_MFOP:0, NeAATR_Cnt_SCP_InletTemp_HiFlt_MFOP:0, NeAATR_Cnt_SCP_InletTemp_Flt_MFOP:0, NeAATR_Cnt_SCP_DCPstvTemp_PerfFlt_MFOP:0, NeAATR_Cnt_SCP_DCPstvTemp_Flt_MFOP:0, NeCDMR_Cnt_DTCShortName6_MFOP:0, NeAATR_Cnt_SCP_DCNegtvTemp_PerfFlt_MFOP:0, NeAATR_Cnt_SCP_DCNegtvTemp_LoFlt_MFOP:0, NeAATR_Cnt_SCP_DCNegtvTemp_HiFlt_MFOP:0, NeAATR_Cnt_SCP_DCNegtvTemp_Flt_MFOP:0, NeAATR_Cnt_ECM_IntakeTemp_PerfFlt_MFOP:0, NeAATR_Cnt_DCPstvTemp_HiFlt_MFOP:0, NeAATR_Cnt_AmbAirVolt_LoFlt_MFOP:0, NeAATR_Cnt_AmbAirVolt_HiFlt_MFOP:0, NeAATR_Cnt_AmbAirTemp_PerfFlt_MFOP:0, NeCDMR_Cnt_ChrgPortUnlock_MFOP:0, NeCDMR_Cnt_ChrgPortRlyActCkt_MFOP:0, NeCDMR_Cnt_ChrgPortLock_MFOP:0, NeCDMR_Cnt_ChgPrtLckFailLMFOP:0, NeCDMR_Cnt_ChgPrtLckFailHMFOP:0, NeCDMR_Cnt_CPIMInternal_MFOP:0, NeCDMR_Cnt_BCIMInternal_MFOP:0, NeCCTR_Cnt_SpdCntrlSw1_MFOP:0, NeBTQD_Cnt_ESPSignalDiag_MFOP:0, NeBRDR_Cnt_LTAP_MFOP:0, NeBRDR_Cnt_HeatExPerf_MFOP:0, NeBRDR_Cnt_HV_BTOS_MFOP:0, NeBRDR_Cnt_HV_BTOS2_MFOP:0, NeBRDR_Cnt_HV_BTIS_MFOP:0, NeBRDR_Cnt_HV_BTIS2_MFOP:0, NeBRDR_Cnt_HV_BHOS_MFOP:0, NeBRDR_Cnt_HVBatCltLvlSnsCkt_MFOP:0, NeBRDR_Cnt_HVBatCltLvLo_OC_MFOP:0, NeBRDR_Cnt_ChillPerf_MFOP:0, NeHVTR_Cnt_AntiTampCounter:65535, NeHSWD_Cnt_CBC_Range_MFOP:0, NeITIR_Cnt_TimeSinceEngineStrt:0, NeIMPR_Cnt_HVShtDwn_MFOP:0, NeCCCR_b_FirstIncrFlag_MinHot:0, NeCITR_b_PortLockBCM_Cmd:0, NeCITR_b_Lock_Status:0, NeCCCR_e_PwrLvlSet:0, NeDMIR_e_PddlMdStatus:0, NeDMIR_e_CreepSts:0, NeCSVR_e_MIL_LightRequest:255, NeSSDC_b_HVBatPerWU12VChrg:0, NeSSDC_b_HVBatPerWUCabinPre:0, NeSSDC_b_HVBatPerWUSchChrg:0, NeSSDC_b_HVBatPerWUThermal:0, NeCSVR_b_PriorMIL_StatusOn:1, NeCPLR_e_RemoteLockLastSts:0, NeCPLR_e_DoorLastSts:0, NeCPLR_e_ChargeportLockLastSts:0, NeCPLR_b_ManualRelease:0, NeCCCR_b_FirstIncrFlag_MaxHot:0, NeCCCR_b_FirstIncrFlag_MinCold:0, NeCCCR_b_FirstIncrFlag_Cold:0, NeCCCR_b_FirstIncrFlag_MaxCold:0, NeAECR_e_eCoastLvlLatched:0, NeAECR_e_eCoastDefaultCustom:0, NeAECR_e_eCoastDefaultAuto:0, NeAECR_e_RegenSts:0, NeAECR_e_RaceModeSts:0, NeAECR_e_PddlMdStatus:0, NeCCCR_b_FirstIncrFlag_Hot:0, NeAATR_b_AmbAirTempPred_PrevFA:1, NeOBCR_b_GoodConnEst:1, NeOBCR_b_Lvl1Latch:1, NeOBCR_b_Lvl2Latch:1, NeOBCR_b_SmartEvse_Detected:1, NeOFCR_b_PluginLatchOverride:0, NeOFCR_b_RadioRqLstVldStt:0, NeBPCR_b_HV_BatPackSOC_FA_Ovrd:1, NeBPCR_b_HV_BatRdy:1, NeDMIR_e_RegenSts:0, NeCCCR_b_FirstDecrFlag_MinHot:0, NeCCCR_b_FirstDecrFlag_MinCold:0, NeCCCR_b_FirstDecrFlag_MaxHot:0, NeTIMR_b_RacePrepType:0, NeTIMR_e_CustomDrvMdSts:0, NeTIMR_e_RacePrepMode:0, NeCCCR_b_FirstDecrFlag_MaxCold:0, NeCCCR_b_FirstDecrFlag_Hot:0, NeCCCR_b_FirstDecrFlag_Cold:0, NeTPCR_b_12VloadShed:1, NeTPCR_b_HoldCabPrecFailLtch:1, NeTPCR_b_RS_CabPrecDeny_Prev:1, NeTRGR_y_IP_PRNDLTestFailStatus:0, NePPCR_e_PrvCmdVal:255, NeDMIR_e_RaceModeSts:0, NeDMIR_e_eCoastDefaultAuto:0, NeSCPR_y_Sch2CoCH_Day:0, NeRTMR_y_RngTestResult_PID:0, NeRTMR_e_BattChrgStatus_PID:0, NeRTMR_y_BattChrgCndtnCheck_PID:0, NeRTMR_y_RngTestStatus_PID:0, NeRTMR_y_RngTstCndtnCheck1_PID:0, NeRTMR_y_RngTstCndtnCheck2_PID:0, NeSCPR_y_Sch1CoCH_Day:0, NeSCPR_e_Sch1CH_SchType:0, NeSCPR_e_Sch2CH_SchType:0, NeENGR_b_IAT_SnsrFA:0, NeENGR_b_ECT_SnsrFA:0, NeDMIR_e_eCoastLvlLatched:0, NeDMIR_e_eCoastDefaultCustom:0, NeSCPR_b_xMinUFCancel:0, NeSCPR_b_xMinUF:0, NeSCPR_b_StopChrg:0, NeSCPR_b_Sch2CoCH_Enbl:0, NeHVTR_b_AntiTampFailed:0, NeSCPR_b_AllowCancel:0, NeSCPR_b_CancSchedIsUF:0, NeSCPR_b_CancWindow:0, NeSCPR_b_ChrgComplete:0, NeSCPR_b_CoCH_Sch1_DNR:0, NeSCPR_b_CoCH_Sch2_DNR:0, NeSCPR_b_CoCh_VehLocation:0, NeSCPR_b_PluginLatchOverride:0, NeSCPR_b_RadioRqLstVldStt:0, NeSCPR_b_Sch1CoCH_Enbl:0, Reserved1:0, Reserved2:0, Reserved3:0, Reserved4:0, Reserved5:0, Reserved6:0, Reserved7:0, Reserved8:0, Reserved9:0, Reserved10:0, Reserved11:0, Reserved12:0, Reserved13:0, Reserved14:0, Reserved15:0, Reserved16:0, Reserved17:0, Reserved18:0, Reserved19:0, Reserved20:0, Reserved21:0, Reserved22:0, Reserved23:0, Reserved24:0, Reserved25:0, Reserved26:0]}
      CumulativeNonVolatile_Descr_Core4
        nv-block-data-mappings:
          {nv-ram-block-element=autosar-variable-in-impl-datatype={root-variable-data-prototype=CumulativeNonVolatile_RamBlock_Core4, target-data-prototype=CumulativeNonVolatile_Ram_Core4/EePLTR_t_RTCTime}, read-nv-data=EePLTR_t_RTCTime.EePLTR_t_RTCTime}
          {nv-ram-block-element=autosar-variable-in-impl-datatype={root-variable-data-prototype=CumulativeNonVolatile_RamBlock_Core4, target-data-prototype=CumulativeNonVolatile_Ram_Core4/EePLTR_t_RTCTime}, written-nv-data=EePLTR_t_RTCTime_Rx.EePLTR_t_RTCTime}
          {nv-ram-block-element=autosar-variable-in-impl-datatype={root-variable-data-prototype=CumulativeNonVolatile_RamBlock_Core4, target-data-prototype=CumulativeNonVolatile_Ram_Core4/EeHCDR_t_RealTime_Comp_On}, read-nv-data=EeHCDR_t_RealTime_Comp_On.EeHCDR_t_RealTime_Comp_On}
          {nv-ram-block-element=autosar-variable-in-impl-datatype={root-variable-data-prototype=CumulativeNonVolatile_RamBlock_Core4, target-data-prototype=CumulativeNonVolatile_Ram_Core4/EeHCDR_t_RealTime_Comp_On}, written-nv-data=EeHCDR_t_RealTime_Comp_On_Rx.EeHCDR_t_RealTime_Comp_On}
          {nv-ram-block-element=autosar-variable-in-impl-datatype={root-variable-data-prototype=CumulativeNonVolatile_RamBlock_Core4, target-data-prototype=CumulativeNonVolatile_Ram_Core4/EeHCDR_t_RealTime_Comp_Off}, read-nv-data=EeHCDR_t_RealTime_Comp_Off.EeHCDR_t_RealTime_Comp_Off}
          {nv-ram-block-element=autosar-variable-in-impl-datatype={root-variable-data-prototype=CumulativeNonVolatile_RamBlock_Core4, target-data-prototype=CumulativeNonVolatile_Ram_Core4/EeHCDR_t_RealTime_Comp_Off}, written-nv-data=EeHCDR_t_RealTime_Comp_Off_Rx.EeHCDR_t_RealTime_Comp_Off}
          {nv-ram-block-element=autosar-variable-in-impl-datatype={root-variable-data-prototype=CumulativeNonVolatile_RamBlock_Core4, target-data-prototype=CumulativeNonVolatile_Ram_Core4/EeERER_l_EEPROM_EstRange}, read-nv-data=EeERER_l_EEPROM_EstRange.EeERER_l_EEPROM_EstRange}
          {nv-ram-block-element=autosar-variable-in-impl-datatype={root-variable-data-prototype=CumulativeNonVolatile_RamBlock_Core4, target-data-prototype=CumulativeNonVolatile_Ram_Core4/EeERER_l_EEPROM_EstRange}, written-nv-data=EeERER_l_EEPROM_EstRange_Rx.EeERER_l_EEPROM_EstRange}
          {nv-ram-block-element=autosar-variable-in-impl-datatype={root-variable-data-prototype=CumulativeNonVolatile_RamBlock_Core4, target-data-prototype=CumulativeNonVolatile_Ram_Core4/EeDCCR_t_V2GPerfInhibTime}, read-nv-data=EeDCCR_t_V2GPerfInhibTime.EeDCCR_t_V2GPerfInhibTime}
          {nv-ram-block-element=autosar-variable-in-impl-datatype={root-variable-data-prototype=CumulativeNonVolatile_RamBlock_Core4, target-data-prototype=CumulativeNonVolatile_Ram_Core4/EeDCCR_t_V2GPerfInhibTime}, written-nv-data=EeDCCR_t_V2GPerfInhibTime_Rx.EeDCCR_t_V2GPerfInhibTime}
          {nv-ram-block-element=autosar-variable-in-impl-datatype={root-variable-data-prototype=CumulativeNonVolatile_RamBlock_Core4, target-data-prototype=CumulativeNonVolatile_Ram_Core4/EeDCCR_t_V2GTime}, read-nv-data=EeDCCR_t_V2GTime.EeDCCR_t_V2GTime}
          {nv-ram-block-element=autosar-variable-in-impl-datatype={root-variable-data-prototype=CumulativeNonVolatile_RamBlock_Core4, target-data-prototype=CumulativeNonVolatile_Ram_Core4/EeDCCR_t_V2GTime}, written-nv-data=EeDCCR_t_V2GTime_Rx.EeDCCR_t_V2GTime}
          {nv-ram-block-element=autosar-variable-in-impl-datatype={root-variable-data-prototype=CumulativeNonVolatile_RamBlock_Core4, target-data-prototype=CumulativeNonVolatile_Ram_Core4/EeERER_F_EEPROM_WhperKM}, read-nv-data=EeERER_F_EEPROM_WhperKM.EeERER_F_EEPROM_WhperKM}
          {nv-ram-block-element=autosar-variable-in-impl-datatype={root-variable-data-prototype=CumulativeNonVolatile_RamBlock_Core4, target-data-prototype=CumulativeNonVolatile_Ram_Core4/EeERER_F_EEPROM_WhperKM}, written-nv-data=EeERER_F_EEPROM_WhperKM_Rx.EeERER_F_EEPROM_WhperKM}
          {nv-ram-block-element=autosar-variable-in-impl-datatype={root-variable-data-prototype=CumulativeNonVolatile_RamBlock_Core4, target-data-prototype=CumulativeNonVolatile_Ram_Core4/EeERER_k_Modify_Factor}, read-nv-data=EeERER_k_Modify_Factor.EeERER_k_Modify_Factor}
          {nv-ram-block-element=autosar-variable-in-impl-datatype={root-variable-data-prototype=CumulativeNonVolatile_RamBlock_Core4, target-data-prototype=CumulativeNonVolatile_Ram_Core4/EeERER_k_Modify_Factor}, written-nv-data=EeERER_k_Modify_Factor_Rx.EeERER_k_Modify_Factor}
          {nv-ram-block-element=autosar-variable-in-impl-datatype={root-variable-data-prototype=CumulativeNonVolatile_RamBlock_Core4, target-data-prototype=CumulativeNonVolatile_Ram_Core4/EeERER_l_VehDist_Delta}, read-nv-data=EeERER_l_VehDist_Delta.EeERER_l_VehDist_Delta}
          {nv-ram-block-element=autosar-variable-in-impl-datatype={root-variable-data-prototype=CumulativeNonVolatile_RamBlock_Core4, target-data-prototype=CumulativeNonVolatile_Ram_Core4/EeERER_l_VehDist_Delta}, written-nv-data=EeERER_l_VehDist_Delta_Rx.EeERER_l_VehDist_Delta}
          {nv-ram-block-element=autosar-variable-in-impl-datatype={root-variable-data-prototype=CumulativeNonVolatile_RamBlock_Core4, target-data-prototype=CumulativeNonVolatile_Ram_Core4/EePWDR_t_DAP_FA_InitTime}, read-nv-data=EePWDR_t_DAP_FA_InitTime.EePWDR_t_DAP_FA_InitTime}
          {nv-ram-block-element=autosar-variable-in-impl-datatype={root-variable-data-prototype=CumulativeNonVolatile_RamBlock_Core4, target-data-prototype=CumulativeNonVolatile_Ram_Core4/EePWDR_t_DAP_FA_InitTime}, written-nv-data=EePWDR_t_DAP_FA_InitTime_Rx.EePWDR_t_DAP_FA_InitTime}
          {nv-ram-block-element=autosar-variable-in-impl-datatype={root-variable-data-prototype=CumulativeNonVolatile_RamBlock_Core4, target-data-prototype=CumulativeNonVolatile_Ram_Core4/EePWDR_t_DAP_FA_ElapsedTime}, read-nv-data=EePWDR_t_DAP_FA_ElapsedTime.EePWDR_t_DAP_FA_ElapsedTime}
          {nv-ram-block-element=autosar-variable-in-impl-datatype={root-variable-data-prototype=CumulativeNonVolatile_RamBlock_Core4, target-data-prototype=CumulativeNonVolatile_Ram_Core4/EePWDR_t_DAP_FA_ElapsedTime}, written-nv-data=EePWDR_t_DAP_FA_ElapsedTime_Rx.EePWDR_t_DAP_FA_ElapsedTime}
          {nv-ram-block-element=autosar-variable-in-impl-datatype={root-variable-data-prototype=CumulativeNonVolatile_RamBlock_Core4, target-data-prototype=CumulativeNonVolatile_Ram_Core4/EePWDR_l_DAP_FA_DistTravld}, read-nv-data=EePWDR_l_DAP_FA_DistTravld.EePWDR_l_DAP_FA_DistTravld}
          {nv-ram-block-element=autosar-variable-in-impl-datatype={root-variable-data-prototype=CumulativeNonVolatile_RamBlock_Core4, target-data-prototype=CumulativeNonVolatile_Ram_Core4/EePWDR_l_DAP_FA_DistTravld}, written-nv-data=EePWDR_l_DAP_FA_DistTravld_Rx.EePWDR_l_DAP_FA_DistTravld}
          {nv-ram-block-element=autosar-variable-in-impl-datatype={root-variable-data-prototype=CumulativeNonVolatile_RamBlock_Core4, target-data-prototype=CumulativeNonVolatile_Ram_Core4/EeOBCR_t_EstTimeofChrg_Lv1}, read-nv-data=EeOBCR_t_EstTimeofChrg_Lv1.EeOBCR_t_EstTimeofChrg_Lv1}
          {nv-ram-block-element=autosar-variable-in-impl-datatype={root-variable-data-prototype=CumulativeNonVolatile_RamBlock_Core4, target-data-prototype=CumulativeNonVolatile_Ram_Core4/EeOBCR_t_EstTimeofChrg_Lv1}, written-nv-data=EeOBCR_t_EstTimeofChrg_Lv1_Rx.EeOBCR_t_EstTimeofChrg_Lv1}
          {nv-ram-block-element=autosar-variable-in-impl-datatype={root-variable-data-prototype=CumulativeNonVolatile_RamBlock_Core4, target-data-prototype=CumulativeNonVolatile_Ram_Core4/EeOBCR_t_EstTimeofChrg_Lv2}, read-nv-data=EeOBCR_t_EstTimeofChrg_Lv2.EeOBCR_t_EstTimeofChrg_Lv2}
          {nv-ram-block-element=autosar-variable-in-impl-datatype={root-variable-data-prototype=CumulativeNonVolatile_RamBlock_Core4, target-data-prototype=CumulativeNonVolatile_Ram_Core4/EeOBCR_t_EstTimeofChrg_Lv2}, written-nv-data=EeOBCR_t_EstTimeofChrg_Lv2_Rx.EeOBCR_t_EstTimeofChrg_Lv2}
          {nv-ram-block-element=autosar-variable-in-impl-datatype={root-variable-data-prototype=CumulativeNonVolatile_RamBlock_Core4, target-data-prototype=CumulativeNonVolatile_Ram_Core4/EeIMOR_M_Rand1_prev}, read-nv-data=EeIMOR_M_Rand1_prev.EeIMOR_M_Rand1_prev}
          {nv-ram-block-element=autosar-variable-in-impl-datatype={root-variable-data-prototype=CumulativeNonVolatile_RamBlock_Core4, target-data-prototype=CumulativeNonVolatile_Ram_Core4/EeIMOR_M_Rand1_prev}, written-nv-data=EeIMOR_M_Rand1_prev_Rx.EeIMOR_M_Rand1_prev}
          {nv-ram-block-element=autosar-variable-in-impl-datatype={root-variable-data-prototype=CumulativeNonVolatile_RamBlock_Core4, target-data-prototype=CumulativeNonVolatile_Ram_Core4/EeIMOR_M_Rand2_prev}, read-nv-data=EeIMOR_M_Rand2_prev.EeIMOR_M_Rand2_prev}
          {nv-ram-block-element=autosar-variable-in-impl-datatype={root-variable-data-prototype=CumulativeNonVolatile_RamBlock_Core4, target-data-prototype=CumulativeNonVolatile_Ram_Core4/EeIMOR_M_Rand2_prev}, written-nv-data=EeIMOR_M_Rand2_prev_Rx.EeIMOR_M_Rand2_prev}
          {nv-ram-block-element=autosar-variable-in-impl-datatype={root-variable-data-prototype=CumulativeNonVolatile_RamBlock_Core4, target-data-prototype=CumulativeNonVolatile_Ram_Core4/EeIMOR_M_Rand3_prev}, read-nv-data=EeIMOR_M_Rand3_prev.EeIMOR_M_Rand3_prev}
          {nv-ram-block-element=autosar-variable-in-impl-datatype={root-variable-data-prototype=CumulativeNonVolatile_RamBlock_Core4, target-data-prototype=CumulativeNonVolatile_Ram_Core4/EeIMOR_M_Rand3_prev}, written-nv-data=EeIMOR_M_Rand3_prev_Rx.EeIMOR_M_Rand3_prev}
          {nv-ram-block-element=autosar-variable-in-impl-datatype={root-variable-data-prototype=CumulativeNonVolatile_RamBlock_Core4, target-data-prototype=CumulativeNonVolatile_Ram_Core4/EeIMOR_M_Rand4_prev}, read-nv-data=EeIMOR_M_Rand4_prev.EeIMOR_M_Rand4_prev}
          {nv-ram-block-element=autosar-variable-in-impl-datatype={root-variable-data-prototype=CumulativeNonVolatile_RamBlock_Core4, target-data-prototype=CumulativeNonVolatile_Ram_Core4/EeIMOR_M_Rand4_prev}, written-nv-data=EeIMOR_M_Rand4_prev_Rx.EeIMOR_M_Rand4_prev}
          {nv-ram-block-element=autosar-variable-in-impl-datatype={root-variable-data-prototype=CumulativeNonVolatile_RamBlock_Core4, target-data-prototype=CumulativeNonVolatile_Ram_Core4/EePLTR_t_PowerdownTime}, read-nv-data=EePLTR_t_PowerdownTime.EePLTR_t_PowerdownTime}
          {nv-ram-block-element=autosar-variable-in-impl-datatype={root-variable-data-prototype=CumulativeNonVolatile_RamBlock_Core4, target-data-prototype=CumulativeNonVolatile_Ram_Core4/EePLTR_t_PowerdownTime}, written-nv-data=EePLTR_t_PowerdownTime_Rx.EePLTR_t_PowerdownTime}
          {nv-ram-block-element=autosar-variable-in-impl-datatype={root-variable-data-prototype=CumulativeNonVolatile_RamBlock_Core4, target-data-prototype=CumulativeNonVolatile_Ram_Core4/EeTPCR_e_HoldClusterMsg}, read-nv-data=EeTPCR_e_HoldClusterMsg.EeTPCR_e_HoldClusterMsg}
          {nv-ram-block-element=autosar-variable-in-impl-datatype={root-variable-data-prototype=CumulativeNonVolatile_RamBlock_Core4, target-data-prototype=CumulativeNonVolatile_Ram_Core4/EeTPCR_e_HoldClusterMsg}, written-nv-data=EeTPCR_e_HoldClusterMsg_Rx.EeTPCR_e_HoldClusterMsg}
          {nv-ram-block-element=autosar-variable-in-impl-datatype={root-variable-data-prototype=CumulativeNonVolatile_RamBlock_Core4, target-data-prototype=CumulativeNonVolatile_Ram_Core4/EeTPCR_e_HoldClusterMsg_KHC}, read-nv-data=EeTPCR_e_HoldClusterMsg_KHC.EeTPCR_e_HoldClusterMsg_KHC}
          {nv-ram-block-element=autosar-variable-in-impl-datatype={root-variable-data-prototype=CumulativeNonVolatile_RamBlock_Core4, target-data-prototype=CumulativeNonVolatile_Ram_Core4/EeTPCR_e_HoldClusterMsg_KHC}, written-nv-data=EeTPCR_e_HoldClusterMsg_KHC_Rx.EeTPCR_e_HoldClusterMsg_KHC}
          {nv-ram-block-element=autosar-variable-in-impl-datatype={root-variable-data-prototype=CumulativeNonVolatile_RamBlock_Core4, target-data-prototype=CumulativeNonVolatile_Ram_Core4/EePLTR_e_ShippingMode}, read-nv-data=EePLTR_e_ShippingMode.EePLTR_e_ShippingMode}
          {nv-ram-block-element=autosar-variable-in-impl-datatype={root-variable-data-prototype=CumulativeNonVolatile_RamBlock_Core4, target-data-prototype=CumulativeNonVolatile_Ram_Core4/EePLTR_e_ShippingMode}, written-nv-data=EePLTR_e_ShippingMode_Rx.EePLTR_e_ShippingMode}
          {nv-ram-block-element=autosar-variable-in-impl-datatype={root-variable-data-prototype=CumulativeNonVolatile_RamBlock_Core4, target-data-prototype=CumulativeNonVolatile_Ram_Core4/EeDMIR_d_ChargeTypeCnf}, read-nv-data=EeDMIR_d_ChargeTypeCnf.EeDMIR_d_ChargeTypeCnf}
          {nv-ram-block-element=autosar-variable-in-impl-datatype={root-variable-data-prototype=CumulativeNonVolatile_RamBlock_Core4, target-data-prototype=CumulativeNonVolatile_Ram_Core4/EeDMIR_d_ChargeTypeCnf}, written-nv-data=EeDMIR_d_ChargeTypeCnf_Rx.EeDMIR_d_ChargeTypeCnf}
          {nv-ram-block-element=autosar-variable-in-impl-datatype={root-variable-data-prototype=CumulativeNonVolatile_RamBlock_Core4, target-data-prototype=CumulativeNonVolatile_Ram_Core4/EeDMIR_d_TgtSOCRngCnf}, read-nv-data=EeDMIR_d_TgtSOCRngCnf.EeDMIR_d_TgtSOCRngCnf}
          {nv-ram-block-element=autosar-variable-in-impl-datatype={root-variable-data-prototype=CumulativeNonVolatile_RamBlock_Core4, target-data-prototype=CumulativeNonVolatile_Ram_Core4/EeDMIR_d_TgtSOCRngCnf}, written-nv-data=EeDMIR_d_TgtSOCRngCnf_Rx.EeDMIR_d_TgtSOCRngCnf}
          {nv-ram-block-element=autosar-variable-in-impl-datatype={root-variable-data-prototype=CumulativeNonVolatile_RamBlock_Core4, target-data-prototype=CumulativeNonVolatile_Ram_Core4/EeIMOR_e_BuildAssemblyModeStat}, read-nv-data=EeIMOR_e_BuildAssemblyModeStat.EeIMOR_e_BuildAssemblyModeStat}
          {nv-ram-block-element=autosar-variable-in-impl-datatype={root-variable-data-prototype=CumulativeNonVolatile_RamBlock_Core4, target-data-prototype=CumulativeNonVolatile_Ram_Core4/EeIMOR_e_BuildAssemblyModeStat}, written-nv-data=EeIMOR_e_BuildAssemblyModeStat_Rx.EeIMOR_e_BuildAssemblyModeStat}
          {nv-ram-block-element=autosar-variable-in-impl-datatype={root-variable-data-prototype=CumulativeNonVolatile_RamBlock_Core4, target-data-prototype=CumulativeNonVolatile_Ram_Core4/EeHVTR_e_StrtCmd_SrvcProc1320}, read-nv-data=EeHVTR_e_StrtCmd_SrvcProc1320.EeHVTR_e_StrtCmd_SrvcProc1320}
          {nv-ram-block-element=autosar-variable-in-impl-datatype={root-variable-data-prototype=CumulativeNonVolatile_RamBlock_Core4, target-data-prototype=CumulativeNonVolatile_Ram_Core4/EeHVTR_e_StrtCmd_SrvcProc1320}, written-nv-data=EeHVTR_e_StrtCmd_SrvcProc1320_Rx.EeHVTR_e_StrtCmd_SrvcProc1320}
          {nv-ram-block-element=autosar-variable-in-impl-datatype={root-variable-data-prototype=CumulativeNonVolatile_RamBlock_Core4, target-data-prototype=CumulativeNonVolatile_Ram_Core4/EePLTR_e_RTCStatus}, read-nv-data=EePLTR_e_RTCStatus.EePLTR_e_RTCStatus}
          {nv-ram-block-element=autosar-variable-in-impl-datatype={root-variable-data-prototype=CumulativeNonVolatile_RamBlock_Core4, target-data-prototype=CumulativeNonVolatile_Ram_Core4/EePLTR_e_RTCStatus}, written-nv-data=EePLTR_e_RTCStatus_Rx.EePLTR_e_RTCStatus}
          {nv-ram-block-element=autosar-variable-in-impl-datatype={root-variable-data-prototype=CumulativeNonVolatile_RamBlock_Core4, target-data-prototype=CumulativeNonVolatile_Ram_Core4/EeERER_e_DriveMode}, read-nv-data=EeERER_e_DriveMode.EeERER_e_DriveMode}
          {nv-ram-block-element=autosar-variable-in-impl-datatype={root-variable-data-prototype=CumulativeNonVolatile_RamBlock_Core4, target-data-prototype=CumulativeNonVolatile_Ram_Core4/EeERER_e_DriveMode}, written-nv-data=EeERER_e_DriveMode_Rx.EeERER_e_DriveMode}
          {nv-ram-block-element=autosar-variable-in-impl-datatype={root-variable-data-prototype=CumulativeNonVolatile_RamBlock_Core4, target-data-prototype=CumulativeNonVolatile_Ram_Core4/EeERER_e_TurtleMode}, read-nv-data=EeERER_e_TurtleMode.EeERER_e_TurtleMode}
          {nv-ram-block-element=autosar-variable-in-impl-datatype={root-variable-data-prototype=CumulativeNonVolatile_RamBlock_Core4, target-data-prototype=CumulativeNonVolatile_Ram_Core4/EeERER_e_TurtleMode}, written-nv-data=EeERER_e_TurtleMode_Rx.EeERER_e_TurtleMode}
          {nv-ram-block-element=autosar-variable-in-impl-datatype={root-variable-data-prototype=CumulativeNonVolatile_RamBlock_Core4, target-data-prototype=CumulativeNonVolatile_Ram_Core4/EeAECR_e_MaxRegenDsrdSt}, read-nv-data=EeAECR_e_MaxRegenDsrdSt.EeAECR_e_MaxRegenDsrdSt}
          {nv-ram-block-element=autosar-variable-in-impl-datatype={root-variable-data-prototype=CumulativeNonVolatile_RamBlock_Core4, target-data-prototype=CumulativeNonVolatile_Ram_Core4/EeAECR_e_MaxRegenDsrdSt}, written-nv-data=EeAECR_e_MaxRegenDsrdSt_Rx.EeAECR_e_MaxRegenDsrdSt}
          {nv-ram-block-element=autosar-variable-in-impl-datatype={root-variable-data-prototype=CumulativeNonVolatile_RamBlock_Core4, target-data-prototype=CumulativeNonVolatile_Ram_Core4/EeOBCR_e_ChargingSystemSts}, read-nv-data=EeOBCR_e_ChargingSystemSts.EeOBCR_e_ChargingSystemSts}
          {nv-ram-block-element=autosar-variable-in-impl-datatype={root-variable-data-prototype=CumulativeNonVolatile_RamBlock_Core4, target-data-prototype=CumulativeNonVolatile_Ram_Core4/EeOBCR_e_ChargingSystemSts}, written-nv-data=EeOBCR_e_ChargingSystemSts_Rx.EeOBCR_e_ChargingSystemSts}
          {nv-ram-block-element=autosar-variable-in-impl-datatype={root-variable-data-prototype=CumulativeNonVolatile_RamBlock_Core4, target-data-prototype=CumulativeNonVolatile_Ram_Core4/EeOBCR_e_ChargingLevel}, read-nv-data=EeOBCR_e_ChargingLevel.EeOBCR_e_ChargingLevel}
          {nv-ram-block-element=autosar-variable-in-impl-datatype={root-variable-data-prototype=CumulativeNonVolatile_RamBlock_Core4, target-data-prototype=CumulativeNonVolatile_Ram_Core4/EeOBCR_e_ChargingLevel}, written-nv-data=EeOBCR_e_ChargingLevel_Rx.EeOBCR_e_ChargingLevel}
          {nv-ram-block-element=autosar-variable-in-impl-datatype={root-variable-data-prototype=CumulativeNonVolatile_RamBlock_Core4, target-data-prototype=CumulativeNonVolatile_Ram_Core4/EeCHFR_b_ChrgSysFault}, read-nv-data=EeCHFR_b_ChrgSysFault.EeCHFR_b_ChrgSysFault}
          {nv-ram-block-element=autosar-variable-in-impl-datatype={root-variable-data-prototype=CumulativeNonVolatile_RamBlock_Core4, target-data-prototype=CumulativeNonVolatile_Ram_Core4/EeCHFR_b_ChrgSysFault}, written-nv-data=EeCHFR_b_ChrgSysFault_Rx.EeCHFR_b_ChrgSysFault}
          {nv-ram-block-element=autosar-variable-in-impl-datatype={root-variable-data-prototype=CumulativeNonVolatile_RamBlock_Core4, target-data-prototype=CumulativeNonVolatile_Ram_Core4/EeIMOR_y_MMKey1org22_Mem}, read-nv-data=EeIMOR_y_MMKey1org22_Mem.EeIMOR_y_MMKey1org22_Mem}
          {nv-ram-block-element=autosar-variable-in-impl-datatype={root-variable-data-prototype=CumulativeNonVolatile_RamBlock_Core4, target-data-prototype=CumulativeNonVolatile_Ram_Core4/EeIMOR_y_MMKey1org22_Mem}, written-nv-data=EeIMOR_y_MMKey1org22_Mem_Rx.EeIMOR_y_MMKey1org22_Mem}
          {nv-ram-block-element=autosar-variable-in-impl-datatype={root-variable-data-prototype=CumulativeNonVolatile_RamBlock_Core4, target-data-prototype=CumulativeNonVolatile_Ram_Core4/EeOBCR_b_PluggedIn}, read-nv-data=EeOBCR_b_PluggedIn.EeOBCR_b_PluggedIn}
          {nv-ram-block-element=autosar-variable-in-impl-datatype={root-variable-data-prototype=CumulativeNonVolatile_RamBlock_Core4, target-data-prototype=CumulativeNonVolatile_Ram_Core4/EeOBCR_b_PluggedIn}, written-nv-data=EeOBCR_b_PluggedIn_Rx.EeOBCR_b_PluggedIn}
          {nv-ram-block-element=autosar-variable-in-impl-datatype={root-variable-data-prototype=CumulativeNonVolatile_RamBlock_Core4, target-data-prototype=CumulativeNonVolatile_Ram_Core4/EePLTR_b_RTC_CurrentTimeFA}, read-nv-data=EePLTR_b_RTC_CurrentTimeFA.EePLTR_b_RTC_CurrentTimeFA}
          {nv-ram-block-element=autosar-variable-in-impl-datatype={root-variable-data-prototype=CumulativeNonVolatile_RamBlock_Core4, target-data-prototype=CumulativeNonVolatile_Ram_Core4/EePLTR_b_RTC_CurrentTimeFA}, written-nv-data=EePLTR_b_RTC_CurrentTimeFA_Rx.EePLTR_b_RTC_CurrentTimeFA}
          {nv-ram-block-element=autosar-variable-in-impl-datatype={root-variable-data-prototype=CumulativeNonVolatile_RamBlock_Core4, target-data-prototype=CumulativeNonVolatile_Ram_Core4/EeIMOR_b_AuthCmd08_InFlag}, read-nv-data=EeIMOR_b_AuthCmd08_InFlag.EeIMOR_b_AuthCmd08_InFlag}
          {nv-ram-block-element=autosar-variable-in-impl-datatype={root-variable-data-prototype=CumulativeNonVolatile_RamBlock_Core4, target-data-prototype=CumulativeNonVolatile_Ram_Core4/EeIMOR_b_AuthCmd08_InFlag}, written-nv-data=EeIMOR_b_AuthCmd08_InFlag_Rx.EeIMOR_b_AuthCmd08_InFlag}
          {nv-ram-block-element=autosar-variable-in-impl-datatype={root-variable-data-prototype=CumulativeNonVolatile_RamBlock_Core4, target-data-prototype=CumulativeNonVolatile_Ram_Core4/EeIMOR_b_AuthCmd07_InFlag}, read-nv-data=EeIMOR_b_AuthCmd07_InFlag.EeIMOR_b_AuthCmd07_InFlag}
          {nv-ram-block-element=autosar-variable-in-impl-datatype={root-variable-data-prototype=CumulativeNonVolatile_RamBlock_Core4, target-data-prototype=CumulativeNonVolatile_Ram_Core4/EeIMOR_b_AuthCmd07_InFlag}, written-nv-data=EeIMOR_b_AuthCmd07_InFlag_Rx.EeIMOR_b_AuthCmd07_InFlag}
          {nv-ram-block-element=autosar-variable-in-impl-datatype={root-variable-data-prototype=CumulativeNonVolatile_RamBlock_Core4, target-data-prototype=CumulativeNonVolatile_Ram_Core4/EeIMOR_b_AuthCmd06_InFlag}, read-nv-data=EeIMOR_b_AuthCmd06_InFlag.EeIMOR_b_AuthCmd06_InFlag}
          {nv-ram-block-element=autosar-variable-in-impl-datatype={root-variable-data-prototype=CumulativeNonVolatile_RamBlock_Core4, target-data-prototype=CumulativeNonVolatile_Ram_Core4/EeIMOR_b_AuthCmd06_InFlag}, written-nv-data=EeIMOR_b_AuthCmd06_InFlag_Rx.EeIMOR_b_AuthCmd06_InFlag}
          {nv-ram-block-element=autosar-variable-in-impl-datatype={root-variable-data-prototype=CumulativeNonVolatile_RamBlock_Core4, target-data-prototype=CumulativeNonVolatile_Ram_Core4/EeIMOR_b_AuthCmd05_InFlag}, read-nv-data=EeIMOR_b_AuthCmd05_InFlag.EeIMOR_b_AuthCmd05_InFlag}
          {nv-ram-block-element=autosar-variable-in-impl-datatype={root-variable-data-prototype=CumulativeNonVolatile_RamBlock_Core4, target-data-prototype=CumulativeNonVolatile_Ram_Core4/EeIMOR_b_AuthCmd05_InFlag}, written-nv-data=EeIMOR_b_AuthCmd05_InFlag_Rx.EeIMOR_b_AuthCmd05_InFlag}
          {nv-ram-block-element=autosar-variable-in-impl-datatype={root-variable-data-prototype=CumulativeNonVolatile_RamBlock_Core4, target-data-prototype=CumulativeNonVolatile_Ram_Core4/EeIMOR_b_AuthCmd04_InFlag}, read-nv-data=EeIMOR_b_AuthCmd04_InFlag.EeIMOR_b_AuthCmd04_InFlag}
          {nv-ram-block-element=autosar-variable-in-impl-datatype={root-variable-data-prototype=CumulativeNonVolatile_RamBlock_Core4, target-data-prototype=CumulativeNonVolatile_Ram_Core4/EeIMOR_b_AuthCmd04_InFlag}, written-nv-data=EeIMOR_b_AuthCmd04_InFlag_Rx.EeIMOR_b_AuthCmd04_InFlag}
          {nv-ram-block-element=autosar-variable-in-impl-datatype={root-variable-data-prototype=CumulativeNonVolatile_RamBlock_Core4, target-data-prototype=CumulativeNonVolatile_Ram_Core4/EeIMOR_b_AuthCmd03_InFlag}, read-nv-data=EeIMOR_b_AuthCmd03_InFlag.EeIMOR_b_AuthCmd03_InFlag}
          {nv-ram-block-element=autosar-variable-in-impl-datatype={root-variable-data-prototype=CumulativeNonVolatile_RamBlock_Core4, target-data-prototype=CumulativeNonVolatile_Ram_Core4/EeIMOR_b_AuthCmd03_InFlag}, written-nv-data=EeIMOR_b_AuthCmd03_InFlag_Rx.EeIMOR_b_AuthCmd03_InFlag}
          {nv-ram-block-element=autosar-variable-in-impl-datatype={root-variable-data-prototype=CumulativeNonVolatile_RamBlock_Core4, target-data-prototype=CumulativeNonVolatile_Ram_Core4/EeIMOR_b_AuthCmd02_InFlag}, read-nv-data=EeIMOR_b_AuthCmd02_InFlag.EeIMOR_b_AuthCmd02_InFlag}
          {nv-ram-block-element=autosar-variable-in-impl-datatype={root-variable-data-prototype=CumulativeNonVolatile_RamBlock_Core4, target-data-prototype=CumulativeNonVolatile_Ram_Core4/EeIMOR_b_AuthCmd02_InFlag}, written-nv-data=EeIMOR_b_AuthCmd02_InFlag_Rx.EeIMOR_b_AuthCmd02_InFlag}
          {nv-ram-block-element=autosar-variable-in-impl-datatype={root-variable-data-prototype=CumulativeNonVolatile_RamBlock_Core4, target-data-prototype=CumulativeNonVolatile_Ram_Core4/EeIMOR_b_AuthCmd09_InFlag}, read-nv-data=EeIMOR_b_AuthCmd09_InFlag.EeIMOR_b_AuthCmd09_InFlag}
          {nv-ram-block-element=autosar-variable-in-impl-datatype={root-variable-data-prototype=CumulativeNonVolatile_RamBlock_Core4, target-data-prototype=CumulativeNonVolatile_Ram_Core4/EeIMOR_b_AuthCmd09_InFlag}, written-nv-data=EeIMOR_b_AuthCmd09_InFlag_Rx.EeIMOR_b_AuthCmd09_InFlag}
          {nv-ram-block-element=autosar-variable-in-impl-datatype={root-variable-data-prototype=CumulativeNonVolatile_RamBlock_Core4, target-data-prototype=CumulativeNonVolatile_Ram_Core4/EeIMOR_y_MMKey_3_Mem}, read-nv-data=EeIMOR_y_MMKey_3_Mem.EeIMOR_y_MMKey_3_Mem}
          {nv-ram-block-element=autosar-variable-in-impl-datatype={root-variable-data-prototype=CumulativeNonVolatile_RamBlock_Core4, target-data-prototype=CumulativeNonVolatile_Ram_Core4/EeIMOR_y_MMKey_3_Mem}, written-nv-data=EeIMOR_y_MMKey_3_Mem_Rx.EeIMOR_y_MMKey_3_Mem}
          {nv-ram-block-element=autosar-variable-in-impl-datatype={root-variable-data-prototype=CumulativeNonVolatile_RamBlock_Core4, target-data-prototype=CumulativeNonVolatile_Ram_Core4/EeIMOR_b_VC_VehCfg6_Stat_rec}, read-nv-data=EeIMOR_b_VC_VehCfg6_Stat_rec.EeIMOR_b_VC_VehCfg6_Stat_rec}
          {nv-ram-block-element=autosar-variable-in-impl-datatype={root-variable-data-prototype=CumulativeNonVolatile_RamBlock_Core4, target-data-prototype=CumulativeNonVolatile_Ram_Core4/EeIMOR_b_VC_VehCfg6_Stat_rec}, written-nv-data=EeIMOR_b_VC_VehCfg6_Stat_rec_Rx.EeIMOR_b_VC_VehCfg6_Stat_rec}
          {nv-ram-block-element=autosar-variable-in-impl-datatype={root-variable-data-prototype=CumulativeNonVolatile_RamBlock_Core4, target-data-prototype=CumulativeNonVolatile_Ram_Core4/EeIMOR_b_VC_VehCfg4_Stat_rec}, read-nv-data=EeIMOR_b_VC_VehCfg4_Stat_rec.EeIMOR_b_VC_VehCfg4_Stat_rec}
          {nv-ram-block-element=autosar-variable-in-impl-datatype={root-variable-data-prototype=CumulativeNonVolatile_RamBlock_Core4, target-data-prototype=CumulativeNonVolatile_Ram_Core4/EeIMOR_b_VC_VehCfg4_Stat_rec}, written-nv-data=EeIMOR_b_VC_VehCfg4_Stat_rec_Rx.EeIMOR_b_VC_VehCfg4_Stat_rec}
          {nv-ram-block-element=autosar-variable-in-impl-datatype={root-variable-data-prototype=CumulativeNonVolatile_RamBlock_Core4, target-data-prototype=CumulativeNonVolatile_Ram_Core4/EeIMOR_b_VC_VehCfg3_Stat_rec}, read-nv-data=EeIMOR_b_VC_VehCfg3_Stat_rec.EeIMOR_b_VC_VehCfg3_Stat_rec}
          {nv-ram-block-element=autosar-variable-in-impl-datatype={root-variable-data-prototype=CumulativeNonVolatile_RamBlock_Core4, target-data-prototype=CumulativeNonVolatile_Ram_Core4/EeIMOR_b_VC_VehCfg3_Stat_rec}, written-nv-data=EeIMOR_b_VC_VehCfg3_Stat_rec_Rx.EeIMOR_b_VC_VehCfg3_Stat_rec}
          {nv-ram-block-element=autosar-variable-in-impl-datatype={root-variable-data-prototype=CumulativeNonVolatile_RamBlock_Core4, target-data-prototype=CumulativeNonVolatile_Ram_Core4/EeIMOR_b_VC_VehCfg2_Stat_rec}, read-nv-data=EeIMOR_b_VC_VehCfg2_Stat_rec.EeIMOR_b_VC_VehCfg2_Stat_rec}
          {nv-ram-block-element=autosar-variable-in-impl-datatype={root-variable-data-prototype=CumulativeNonVolatile_RamBlock_Core4, target-data-prototype=CumulativeNonVolatile_Ram_Core4/EeIMOR_b_VC_VehCfg2_Stat_rec}, written-nv-data=EeIMOR_b_VC_VehCfg2_Stat_rec_Rx.EeIMOR_b_VC_VehCfg2_Stat_rec}
          {nv-ram-block-element=autosar-variable-in-impl-datatype={root-variable-data-prototype=CumulativeNonVolatile_RamBlock_Core4, target-data-prototype=CumulativeNonVolatile_Ram_Core4/EeIMOR_b_ORC_Health_rec}, read-nv-data=EeIMOR_b_ORC_Health_rec.EeIMOR_b_ORC_Health_rec}
          {nv-ram-block-element=autosar-variable-in-impl-datatype={root-variable-data-prototype=CumulativeNonVolatile_RamBlock_Core4, target-data-prototype=CumulativeNonVolatile_Ram_Core4/EeIMOR_b_ORC_Health_rec}, written-nv-data=EeIMOR_b_ORC_Health_rec_Rx.EeIMOR_b_ORC_Health_rec}
          {nv-ram-block-element=autosar-variable-in-impl-datatype={root-variable-data-prototype=CumulativeNonVolatile_RamBlock_Core4, target-data-prototype=CumulativeNonVolatile_Ram_Core4/EeIMOR_b_MMKey_6Flag}, read-nv-data=EeIMOR_b_MMKey_6Flag.EeIMOR_b_MMKey_6Flag}
          {nv-ram-block-element=autosar-variable-in-impl-datatype={root-variable-data-prototype=CumulativeNonVolatile_RamBlock_Core4, target-data-prototype=CumulativeNonVolatile_Ram_Core4/EeIMOR_b_MMKey_6Flag}, written-nv-data=EeIMOR_b_MMKey_6Flag_Rx.EeIMOR_b_MMKey_6Flag}
          {nv-ram-block-element=autosar-variable-in-impl-datatype={root-variable-data-prototype=CumulativeNonVolatile_RamBlock_Core4, target-data-prototype=CumulativeNonVolatile_Ram_Core4/EeIMOR_b_MMKey_5Flag}, read-nv-data=EeIMOR_b_MMKey_5Flag.EeIMOR_b_MMKey_5Flag}
          {nv-ram-block-element=autosar-variable-in-impl-datatype={root-variable-data-prototype=CumulativeNonVolatile_RamBlock_Core4, target-data-prototype=CumulativeNonVolatile_Ram_Core4/EeIMOR_b_MMKey_5Flag}, written-nv-data=EeIMOR_b_MMKey_5Flag_Rx.EeIMOR_b_MMKey_5Flag}
          {nv-ram-block-element=autosar-variable-in-impl-datatype={root-variable-data-prototype=CumulativeNonVolatile_RamBlock_Core4, target-data-prototype=CumulativeNonVolatile_Ram_Core4/EeIMOR_b_MMKey_4Flag}, read-nv-data=EeIMOR_b_MMKey_4Flag.EeIMOR_b_MMKey_4Flag}
          {nv-ram-block-element=autosar-variable-in-impl-datatype={root-variable-data-prototype=CumulativeNonVolatile_RamBlock_Core4, target-data-prototype=CumulativeNonVolatile_Ram_Core4/EeIMOR_b_MMKey_4Flag}, written-nv-data=EeIMOR_b_MMKey_4Flag_Rx.EeIMOR_b_MMKey_4Flag}
          {nv-ram-block-element=autosar-variable-in-impl-datatype={root-variable-data-prototype=CumulativeNonVolatile_RamBlock_Core4, target-data-prototype=CumulativeNonVolatile_Ram_Core4/EeIMOR_b_MMKey_3Flag}, read-nv-data=EeIMOR_b_MMKey_3Flag.EeIMOR_b_MMKey_3Flag}
          {nv-ram-block-element=autosar-variable-in-impl-datatype={root-variable-data-prototype=CumulativeNonVolatile_RamBlock_Core4, target-data-prototype=CumulativeNonVolatile_Ram_Core4/EeIMOR_b_MMKey_3Flag}, written-nv-data=EeIMOR_b_MMKey_3Flag_Rx.EeIMOR_b_MMKey_3Flag}
          {nv-ram-block-element=autosar-variable-in-impl-datatype={root-variable-data-prototype=CumulativeNonVolatile_RamBlock_Core4, target-data-prototype=CumulativeNonVolatile_Ram_Core4/EeIMOR_b_MMKey1org22Flag}, read-nv-data=EeIMOR_b_MMKey1org22Flag.EeIMOR_b_MMKey1org22Flag}
          {nv-ram-block-element=autosar-variable-in-impl-datatype={root-variable-data-prototype=CumulativeNonVolatile_RamBlock_Core4, target-data-prototype=CumulativeNonVolatile_Ram_Core4/EeIMOR_b_MMKey1org22Flag}, written-nv-data=EeIMOR_b_MMKey1org22Flag_Rx.EeIMOR_b_MMKey1org22Flag}
          {nv-ram-block-element=autosar-variable-in-impl-datatype={root-variable-data-prototype=CumulativeNonVolatile_RamBlock_Core4, target-data-prototype=CumulativeNonVolatile_Ram_Core4/EeIMOR_b_MMKey1org21Flag}, read-nv-data=EeIMOR_b_MMKey1org21Flag.EeIMOR_b_MMKey1org21Flag}
          {nv-ram-block-element=autosar-variable-in-impl-datatype={root-variable-data-prototype=CumulativeNonVolatile_RamBlock_Core4, target-data-prototype=CumulativeNonVolatile_Ram_Core4/EeIMOR_b_MMKey1org21Flag}, written-nv-data=EeIMOR_b_MMKey1org21Flag_Rx.EeIMOR_b_MMKey1org21Flag}
          {nv-ram-block-element=autosar-variable-in-impl-datatype={root-variable-data-prototype=CumulativeNonVolatile_RamBlock_Core4, target-data-prototype=CumulativeNonVolatile_Ram_Core4/EeIMOR_b_MKeyStrToE2}, read-nv-data=EeIMOR_b_MKeyStrToE2.EeIMOR_b_MKeyStrToE2}
          {nv-ram-block-element=autosar-variable-in-impl-datatype={root-variable-data-prototype=CumulativeNonVolatile_RamBlock_Core4, target-data-prototype=CumulativeNonVolatile_Ram_Core4/EeIMOR_b_MKeyStrToE2}, written-nv-data=EeIMOR_b_MKeyStrToE2_Rx.EeIMOR_b_MKeyStrToE2}
          {nv-ram-block-element=autosar-variable-in-impl-datatype={root-variable-data-prototype=CumulativeNonVolatile_RamBlock_Core4, target-data-prototype=CumulativeNonVolatile_Ram_Core4/EeIMOR_b_ImmoAuthValid_Mem}, read-nv-data=EeIMOR_b_ImmoAuthValid_Mem.EeIMOR_b_ImmoAuthValid_Mem}
          {nv-ram-block-element=autosar-variable-in-impl-datatype={root-variable-data-prototype=CumulativeNonVolatile_RamBlock_Core4, target-data-prototype=CumulativeNonVolatile_Ram_Core4/EeIMOR_b_ImmoAuthValid_Mem}, written-nv-data=EeIMOR_b_ImmoAuthValid_Mem_Rx.EeIMOR_b_ImmoAuthValid_Mem}
          {nv-ram-block-element=autosar-variable-in-impl-datatype={root-variable-data-prototype=CumulativeNonVolatile_RamBlock_Core4, target-data-prototype=CumulativeNonVolatile_Ram_Core4/EeIMOR_b_ImmoAuthValid_ECMMem}, read-nv-data=EeIMOR_b_ImmoAuthValid_ECMMem.EeIMOR_b_ImmoAuthValid_ECMMem}
          {nv-ram-block-element=autosar-variable-in-impl-datatype={root-variable-data-prototype=CumulativeNonVolatile_RamBlock_Core4, target-data-prototype=CumulativeNonVolatile_Ram_Core4/EeIMOR_b_ImmoAuthValid_ECMMem}, written-nv-data=EeIMOR_b_ImmoAuthValid_ECMMem_Rx.EeIMOR_b_ImmoAuthValid_ECMMem}
          {nv-ram-block-element=autosar-variable-in-impl-datatype={root-variable-data-prototype=CumulativeNonVolatile_RamBlock_Core4, target-data-prototype=CumulativeNonVolatile_Ram_Core4/EeIMOR_b_CodeRecCmplt_Mem}, read-nv-data=EeIMOR_b_CodeRecCmplt_Mem.EeIMOR_b_CodeRecCmplt_Mem}
          {nv-ram-block-element=autosar-variable-in-impl-datatype={root-variable-data-prototype=CumulativeNonVolatile_RamBlock_Core4, target-data-prototype=CumulativeNonVolatile_Ram_Core4/EeIMOR_b_CodeRecCmplt_Mem}, written-nv-data=EeIMOR_b_CodeRecCmplt_Mem_Rx.EeIMOR_b_CodeRecCmplt_Mem}
          {nv-ram-block-element=autosar-variable-in-impl-datatype={root-variable-data-prototype=CumulativeNonVolatile_RamBlock_Core4, target-data-prototype=CumulativeNonVolatile_Ram_Core4/EeIMOR_b_CntrlEncdResFlag}, read-nv-data=EeIMOR_b_CntrlEncdResFlag.EeIMOR_b_CntrlEncdResFlag}
          {nv-ram-block-element=autosar-variable-in-impl-datatype={root-variable-data-prototype=CumulativeNonVolatile_RamBlock_Core4, target-data-prototype=CumulativeNonVolatile_Ram_Core4/EeIMOR_b_CntrlEncdResFlag}, written-nv-data=EeIMOR_b_CntrlEncdResFlag_Rx.EeIMOR_b_CntrlEncdResFlag}
          {nv-ram-block-element=autosar-variable-in-impl-datatype={root-variable-data-prototype=CumulativeNonVolatile_RamBlock_Core4, target-data-prototype=CumulativeNonVolatile_Ram_Core4/EeIMOR_b_AuthCmdCntrlEncdRespFlag}, read-nv-data=EeIMOR_b_AuthCmdCntrlEncdRespFlag.EeIMOR_b_AuthCmdCntrlEncdRespFlag}
          {nv-ram-block-element=autosar-variable-in-impl-datatype={root-variable-data-prototype=CumulativeNonVolatile_RamBlock_Core4, target-data-prototype=CumulativeNonVolatile_Ram_Core4/EeIMOR_b_AuthCmdCntrlEncdRespFlag}, written-nv-data=EeIMOR_b_AuthCmdCntrlEncdRespFlag_Rx.EeIMOR_b_AuthCmdCntrlEncdRespFlag}
          {nv-ram-block-element=autosar-variable-in-impl-datatype={root-variable-data-prototype=CumulativeNonVolatile_RamBlock_Core4, target-data-prototype=CumulativeNonVolatile_Ram_Core4/EeIMOR_b_AuthCmd15_InFlag}, read-nv-data=EeIMOR_b_AuthCmd15_InFlag.EeIMOR_b_AuthCmd15_InFlag}
          {nv-ram-block-element=autosar-variable-in-impl-datatype={root-variable-data-prototype=CumulativeNonVolatile_RamBlock_Core4, target-data-prototype=CumulativeNonVolatile_Ram_Core4/EeIMOR_b_AuthCmd15_InFlag}, written-nv-data=EeIMOR_b_AuthCmd15_InFlag_Rx.EeIMOR_b_AuthCmd15_InFlag}
          {nv-ram-block-element=autosar-variable-in-impl-datatype={root-variable-data-prototype=CumulativeNonVolatile_RamBlock_Core4, target-data-prototype=CumulativeNonVolatile_Ram_Core4/EeIMOR_b_AuthCmd14_InFlag}, read-nv-data=EeIMOR_b_AuthCmd14_InFlag.EeIMOR_b_AuthCmd14_InFlag}
          {nv-ram-block-element=autosar-variable-in-impl-datatype={root-variable-data-prototype=CumulativeNonVolatile_RamBlock_Core4, target-data-prototype=CumulativeNonVolatile_Ram_Core4/EeIMOR_b_AuthCmd14_InFlag}, written-nv-data=EeIMOR_b_AuthCmd14_InFlag_Rx.EeIMOR_b_AuthCmd14_InFlag}
          {nv-ram-block-element=autosar-variable-in-impl-datatype={root-variable-data-prototype=CumulativeNonVolatile_RamBlock_Core4, target-data-prototype=CumulativeNonVolatile_Ram_Core4/EeIMOR_b_AuthCmd13_InFlag}, read-nv-data=EeIMOR_b_AuthCmd13_InFlag.EeIMOR_b_AuthCmd13_InFlag}
          {nv-ram-block-element=autosar-variable-in-impl-datatype={root-variable-data-prototype=CumulativeNonVolatile_RamBlock_Core4, target-data-prototype=CumulativeNonVolatile_Ram_Core4/EeIMOR_b_AuthCmd13_InFlag}, written-nv-data=EeIMOR_b_AuthCmd13_InFlag_Rx.EeIMOR_b_AuthCmd13_InFlag}
          {nv-ram-block-element=autosar-variable-in-impl-datatype={root-variable-data-prototype=CumulativeNonVolatile_RamBlock_Core4, target-data-prototype=CumulativeNonVolatile_Ram_Core4/EeIMOR_b_AuthCmd12_InFlag}, read-nv-data=EeIMOR_b_AuthCmd12_InFlag.EeIMOR_b_AuthCmd12_InFlag}
          {nv-ram-block-element=autosar-variable-in-impl-datatype={root-variable-data-prototype=CumulativeNonVolatile_RamBlock_Core4, target-data-prototype=CumulativeNonVolatile_Ram_Core4/EeIMOR_b_AuthCmd12_InFlag}, written-nv-data=EeIMOR_b_AuthCmd12_InFlag_Rx.EeIMOR_b_AuthCmd12_InFlag}
          {nv-ram-block-element=autosar-variable-in-impl-datatype={root-variable-data-prototype=CumulativeNonVolatile_RamBlock_Core4, target-data-prototype=CumulativeNonVolatile_Ram_Core4/EeIMOR_b_AuthCmd11_InFlag}, read-nv-data=EeIMOR_b_AuthCmd11_InFlag.EeIMOR_b_AuthCmd11_InFlag}
          {nv-ram-block-element=autosar-variable-in-impl-datatype={root-variable-data-prototype=CumulativeNonVolatile_RamBlock_Core4, target-data-prototype=CumulativeNonVolatile_Ram_Core4/EeIMOR_b_AuthCmd11_InFlag}, written-nv-data=EeIMOR_b_AuthCmd11_InFlag_Rx.EeIMOR_b_AuthCmd11_InFlag}
          {nv-ram-block-element=autosar-variable-in-impl-datatype={root-variable-data-prototype=CumulativeNonVolatile_RamBlock_Core4, target-data-prototype=CumulativeNonVolatile_Ram_Core4/EeIMOR_b_AuthCmd10_InFlag}, read-nv-data=EeIMOR_b_AuthCmd10_InFlag.EeIMOR_b_AuthCmd10_InFlag}
          {nv-ram-block-element=autosar-variable-in-impl-datatype={root-variable-data-prototype=CumulativeNonVolatile_RamBlock_Core4, target-data-prototype=CumulativeNonVolatile_Ram_Core4/EeIMOR_b_AuthCmd10_InFlag}, written-nv-data=EeIMOR_b_AuthCmd10_InFlag_Rx.EeIMOR_b_AuthCmd10_InFlag}
          {nv-ram-block-element=autosar-variable-in-impl-datatype={root-variable-data-prototype=CumulativeNonVolatile_RamBlock_Core4, target-data-prototype=CumulativeNonVolatile_Ram_Core4/EeHPMR_b_ORC_LOCFA}, read-nv-data=EeHPMR_b_ORC_LOCFA.EeHPMR_b_ORC_LOCFA}
          {nv-ram-block-element=autosar-variable-in-impl-datatype={root-variable-data-prototype=CumulativeNonVolatile_RamBlock_Core4, target-data-prototype=CumulativeNonVolatile_Ram_Core4/EeHPMR_b_ORC_LOCFA}, written-nv-data=EeHPMR_b_ORC_LOCFA_Rx.EeHPMR_b_ORC_LOCFA}
          {nv-ram-block-element=autosar-variable-in-impl-datatype={root-variable-data-prototype=CumulativeNonVolatile_RamBlock_Core4, target-data-prototype=CumulativeNonVolatile_Ram_Core4/EeHMIR_e_HEV_LMP_RQ}, read-nv-data=EeHMIR_e_HEV_LMP_RQ.EeHMIR_e_HEV_LMP_RQ}
          {nv-ram-block-element=autosar-variable-in-impl-datatype={root-variable-data-prototype=CumulativeNonVolatile_RamBlock_Core4, target-data-prototype=CumulativeNonVolatile_Ram_Core4/EeHMIR_e_HEV_LMP_RQ}, written-nv-data=EeHMIR_e_HEV_LMP_RQ_Rx.EeHMIR_e_HEV_LMP_RQ}
          {nv-ram-block-element=autosar-variable-in-impl-datatype={root-variable-data-prototype=CumulativeNonVolatile_RamBlock_Core4, target-data-prototype=CumulativeNonVolatile_Ram_Core4/EePWDR_b_DAPFA_OpenCntctr}, read-nv-data=EePWDR_b_DAPFA_OpenCntctr.EePWDR_b_DAPFA_OpenCntctr}
          {nv-ram-block-element=autosar-variable-in-impl-datatype={root-variable-data-prototype=CumulativeNonVolatile_RamBlock_Core4, target-data-prototype=CumulativeNonVolatile_Ram_Core4/EePWDR_b_DAPFA_OpenCntctr}, written-nv-data=EePWDR_b_DAPFA_OpenCntctr_Rx.EePWDR_b_DAPFA_OpenCntctr}
          {nv-ram-block-element=autosar-variable-in-impl-datatype={root-variable-data-prototype=CumulativeNonVolatile_RamBlock_Core4, target-data-prototype=CumulativeNonVolatile_Ram_Core4/EePWDR_Cnt_WarmupCycle}, read-nv-data=EePWDR_Cnt_WarmupCycle.EePWDR_Cnt_WarmupCycle}
          {nv-ram-block-element=autosar-variable-in-impl-datatype={root-variable-data-prototype=CumulativeNonVolatile_RamBlock_Core4, target-data-prototype=CumulativeNonVolatile_Ram_Core4/EePWDR_Cnt_WarmupCycle}, written-nv-data=EePWDR_Cnt_WarmupCycle_Rx.EePWDR_Cnt_WarmupCycle}
          {nv-ram-block-element=autosar-variable-in-impl-datatype={root-variable-data-prototype=CumulativeNonVolatile_RamBlock_Core4, target-data-prototype=CumulativeNonVolatile_Ram_Core4/EePWDR_Cnt_DAP_FA_KeyCylCnt}, read-nv-data=EePWDR_Cnt_DAP_FA_KeyCylCnt.EePWDR_Cnt_DAP_FA_KeyCylCnt}
          {nv-ram-block-element=autosar-variable-in-impl-datatype={root-variable-data-prototype=CumulativeNonVolatile_RamBlock_Core4, target-data-prototype=CumulativeNonVolatile_Ram_Core4/EePWDR_Cnt_DAP_FA_KeyCylCnt}, written-nv-data=EePWDR_Cnt_DAP_FA_KeyCylCnt_Rx.EePWDR_Cnt_DAP_FA_KeyCylCnt}
          {nv-ram-block-element=autosar-variable-in-impl-datatype={root-variable-data-prototype=CumulativeNonVolatile_RamBlock_Core4, target-data-prototype=CumulativeNonVolatile_Ram_Core4/EeHCDR_b_InitDiag_Pass_Prev}, read-nv-data=EeHCDR_b_InitDiag_Pass_Prev.EeHCDR_b_InitDiag_Pass_Prev}
          {nv-ram-block-element=autosar-variable-in-impl-datatype={root-variable-data-prototype=CumulativeNonVolatile_RamBlock_Core4, target-data-prototype=CumulativeNonVolatile_Ram_Core4/EeHCDR_b_InitDiag_Pass_Prev}, written-nv-data=EeHCDR_b_InitDiag_Pass_Prev_Rx.EeHCDR_b_InitDiag_Pass_Prev}
          {nv-ram-block-element=autosar-variable-in-impl-datatype={root-variable-data-prototype=CumulativeNonVolatile_RamBlock_Core4, target-data-prototype=CumulativeNonVolatile_Ram_Core4/EeERER_e_TrailerConnectionSts}, read-nv-data=EeERER_e_TrailerConnectionSts.EeERER_e_TrailerConnectionSts}
          {nv-ram-block-element=autosar-variable-in-impl-datatype={root-variable-data-prototype=CumulativeNonVolatile_RamBlock_Core4, target-data-prototype=CumulativeNonVolatile_Ram_Core4/EeERER_e_TrailerConnectionSts}, written-nv-data=EeERER_e_TrailerConnectionSts_Rx.EeERER_e_TrailerConnectionSts}
          {nv-ram-block-element=autosar-variable-in-impl-datatype={root-variable-data-prototype=CumulativeNonVolatile_RamBlock_Core4, target-data-prototype=CumulativeNonVolatile_Ram_Core4/EeERER_b_EEPROM_WhperKM}, read-nv-data=EeERER_b_EEPROM_WhperKM.EeERER_b_EEPROM_WhperKM}
          {nv-ram-block-element=autosar-variable-in-impl-datatype={root-variable-data-prototype=CumulativeNonVolatile_RamBlock_Core4, target-data-prototype=CumulativeNonVolatile_Ram_Core4/EeERER_b_EEPROM_WhperKM}, written-nv-data=EeERER_b_EEPROM_WhperKM_Rx.EeERER_b_EEPROM_WhperKM}
          {nv-ram-block-element=autosar-variable-in-impl-datatype={root-variable-data-prototype=CumulativeNonVolatile_RamBlock_Core4, target-data-prototype=CumulativeNonVolatile_Ram_Core4/EeERER_b_EEPROM_EstRange}, read-nv-data=EeERER_b_EEPROM_EstRange.EeERER_b_EEPROM_EstRange}
          {nv-ram-block-element=autosar-variable-in-impl-datatype={root-variable-data-prototype=CumulativeNonVolatile_RamBlock_Core4, target-data-prototype=CumulativeNonVolatile_Ram_Core4/EeERER_b_EEPROM_EstRange}, written-nv-data=EeERER_b_EEPROM_EstRange_Rx.EeERER_b_EEPROM_EstRange}
          {nv-ram-block-element=autosar-variable-in-impl-datatype={root-variable-data-prototype=CumulativeNonVolatile_RamBlock_Core4, target-data-prototype=CumulativeNonVolatile_Ram_Core4/EEeERER_e_TrailerConnectionSts}, read-nv-data=EEeERER_e_TrailerConnectionSts.EEeERER_e_TrailerConnectionSts}
          {nv-ram-block-element=autosar-variable-in-impl-datatype={root-variable-data-prototype=CumulativeNonVolatile_RamBlock_Core4, target-data-prototype=CumulativeNonVolatile_Ram_Core4/EEeERER_e_TrailerConnectionSts}, written-nv-data=EEeERER_e_TrailerConnectionSts_Rx.EEeERER_e_TrailerConnectionSts}
          {nv-ram-block-element=autosar-variable-in-impl-datatype={root-variable-data-prototype=CumulativeNonVolatile_RamBlock_Core4, target-data-prototype=CumulativeNonVolatile_Ram_Core4/EeIMOR_y_MMKey1org21_Mem}, read-nv-data=EeIMOR_y_MMKey1org21_Mem.EeIMOR_y_MMKey1org21_Mem}
          {nv-ram-block-element=autosar-variable-in-impl-datatype={root-variable-data-prototype=CumulativeNonVolatile_RamBlock_Core4, target-data-prototype=CumulativeNonVolatile_Ram_Core4/EeIMOR_y_MMKey1org21_Mem}, written-nv-data=EeIMOR_y_MMKey1org21_Mem_Rx.EeIMOR_y_MMKey1org21_Mem}
          {nv-ram-block-element=autosar-variable-in-impl-datatype={root-variable-data-prototype=CumulativeNonVolatile_RamBlock_Core4, target-data-prototype=CumulativeNonVolatile_Ram_Core4/EeIMOR_b_AuthCmd01_InFlag}, read-nv-data=EeIMOR_b_AuthCmd01_InFlag.EeIMOR_b_AuthCmd01_InFlag}
          {nv-ram-block-element=autosar-variable-in-impl-datatype={root-variable-data-prototype=CumulativeNonVolatile_RamBlock_Core4, target-data-prototype=CumulativeNonVolatile_Ram_Core4/EeIMOR_b_AuthCmd01_InFlag}, written-nv-data=EeIMOR_b_AuthCmd01_InFlag_Rx.EeIMOR_b_AuthCmd01_InFlag}
          {nv-ram-block-element=autosar-variable-in-impl-datatype={root-variable-data-prototype=CumulativeNonVolatile_RamBlock_Core4, target-data-prototype=CumulativeNonVolatile_Ram_Core4/EeIMOR_b_AuthCmd00_InFlag}, read-nv-data=EeIMOR_b_AuthCmd00_InFlag.EeIMOR_b_AuthCmd00_InFlag}
          {nv-ram-block-element=autosar-variable-in-impl-datatype={root-variable-data-prototype=CumulativeNonVolatile_RamBlock_Core4, target-data-prototype=CumulativeNonVolatile_Ram_Core4/EeIMOR_b_AuthCmd00_InFlag}, written-nv-data=EeIMOR_b_AuthCmd00_InFlag_Rx.EeIMOR_b_AuthCmd00_InFlag}
          {nv-ram-block-element=autosar-variable-in-impl-datatype={root-variable-data-prototype=CumulativeNonVolatile_RamBlock_Core4, target-data-prototype=CumulativeNonVolatile_Ram_Core4/EeIMOR_y_MMKey_4_Mem}, read-nv-data=EeIMOR_y_MMKey_4_Mem.EeIMOR_y_MMKey_4_Mem}
          {nv-ram-block-element=autosar-variable-in-impl-datatype={root-variable-data-prototype=CumulativeNonVolatile_RamBlock_Core4, target-data-prototype=CumulativeNonVolatile_Ram_Core4/EeIMOR_y_MMKey_4_Mem}, written-nv-data=EeIMOR_y_MMKey_4_Mem_Rx.EeIMOR_y_MMKey_4_Mem}
          {nv-ram-block-element=autosar-variable-in-impl-datatype={root-variable-data-prototype=CumulativeNonVolatile_RamBlock_Core4, target-data-prototype=CumulativeNonVolatile_Ram_Core4/EeIMOR_y_MMKey_5_Mem}, read-nv-data=EeIMOR_y_MMKey_5_Mem.EeIMOR_y_MMKey_5_Mem}
          {nv-ram-block-element=autosar-variable-in-impl-datatype={root-variable-data-prototype=CumulativeNonVolatile_RamBlock_Core4, target-data-prototype=CumulativeNonVolatile_Ram_Core4/EeIMOR_y_MMKey_5_Mem}, written-nv-data=EeIMOR_y_MMKey_5_Mem_Rx.EeIMOR_y_MMKey_5_Mem}
          {nv-ram-block-element=autosar-variable-in-impl-datatype={root-variable-data-prototype=CumulativeNonVolatile_RamBlock_Core4, target-data-prototype=CumulativeNonVolatile_Ram_Core4/EeHVTR_b_OpnReq_SrvcProc1320}, read-nv-data=EeHVTR_b_OpnReq_SrvcProc1320.EeHVTR_b_OpnReq_SrvcProc1320}
          {nv-ram-block-element=autosar-variable-in-impl-datatype={root-variable-data-prototype=CumulativeNonVolatile_RamBlock_Core4, target-data-prototype=CumulativeNonVolatile_Ram_Core4/EeHVTR_b_OpnReq_SrvcProc1320}, written-nv-data=EeHVTR_b_OpnReq_SrvcProc1320_Rx.EeHVTR_b_OpnReq_SrvcProc1320}
          {nv-ram-block-element=autosar-variable-in-impl-datatype={root-variable-data-prototype=CumulativeNonVolatile_RamBlock_Core4, target-data-prototype=CumulativeNonVolatile_Ram_Core4/EeIMOR_y_MMKey_6_Mem}, read-nv-data=EeIMOR_y_MMKey_6_Mem.EeIMOR_y_MMKey_6_Mem}
          {nv-ram-block-element=autosar-variable-in-impl-datatype={root-variable-data-prototype=CumulativeNonVolatile_RamBlock_Core4, target-data-prototype=CumulativeNonVolatile_Ram_Core4/EeIMOR_y_MMKey_6_Mem}, written-nv-data=EeIMOR_y_MMKey_6_Mem_Rx.EeIMOR_y_MMKey_6_Mem}
          {nv-ram-block-element=autosar-variable-in-impl-datatype={root-variable-data-prototype=CumulativeNonVolatile_RamBlock_Core4, target-data-prototype=CumulativeNonVolatile_Ram_Core4/EePWDR_y_DID_B524}, read-nv-data=EePWDR_y_DID_B524.EePWDR_y_DID_B524}
          {nv-ram-block-element=autosar-variable-in-impl-datatype={root-variable-data-prototype=CumulativeNonVolatile_RamBlock_Core4, target-data-prototype=CumulativeNonVolatile_Ram_Core4/EePWDR_y_DID_B524}, written-nv-data=EePWDR_y_DID_B524_Rx.EePWDR_y_DID_B524}
          {nv-ram-block-element=autosar-variable-in-impl-datatype={root-variable-data-prototype=CumulativeNonVolatile_RamBlock_Core4, target-data-prototype=CumulativeNonVolatile_Ram_Core4/EeAADR_Cnt_AAD_PSACntrLastCal}, read-nv-data=EeAADR_Cnt_AAD_PSACntrLastCal.EeAADR_Cnt_AAD_PSACntrLastCal}
          {nv-ram-block-element=autosar-variable-in-impl-datatype={root-variable-data-prototype=CumulativeNonVolatile_RamBlock_Core4, target-data-prototype=CumulativeNonVolatile_Ram_Core4/EeAADR_Cnt_AAD_PSACntrLastCal}, written-nv-data=EeAADR_Cnt_AAD_PSACntrLastCal_Rx.EeAADR_Cnt_AAD_PSACntrLastCal}
        nv block needs NvBlockNeeds: calc-ram-block-crc=false, check-static-block-id=false, readonly=false, resistant-to-changed-sw=true, restore-at-start=true, store-at-shutdown=true, store-cyclic=false, store-emergency=false, store-immediate=false, use-auto-validation-at-shut-down=false, use-crc-comp-mechanism=true, write-only-once=false, write-verification=false
        ram block CumulativeNonVolatile_RamBlock_Core4: type=CumulativeNonVolatile_Ram_Core4, init-value={short-label=CumulativeNonVolatile_Ram_Core4, fields=[EePLTR_t_RTCTime:0, EeHCDR_t_RealTime_Comp_On:0, EeHCDR_t_RealTime_Comp_Off:0, EeERER_l_EEPROM_EstRange:0, EeDCCR_t_V2GPerfInhibTime:0, EeDCCR_t_V2GTime:0, EeERER_F_EEPROM_WhperKM:0, EeERER_k_Modify_Factor:0, EeERER_l_VehDist_Delta:0, 0, EePWDR_t_DAP_FA_ElapsedTime:0, EePWDR_l_DAP_FA_DistTravld:0, EeOBCR_t_EstTimeofChrg_Lv1:4294967295, EeOBCR_t_EstTimeofChrg_Lv2:4294967295, EeIMOR_M_Rand1_prev:4294967295, EeIMOR_M_Rand2_prev:4294967295, EeIMOR_M_Rand3_prev:4294967295, EeIMOR_M_Rand4_prev:4294967295, EePLTR_t_PowerdownTime:0, EeTPCR_e_HoldClusterMsg:32767, EeTPCR_e_HoldClusterMsg_KHC:32767, EePLTR_e_ShippingMode:0, EeDMIR_d_ChargeTypeCnf:0, EeDMIR_d_TgtSOCRngCnf:0, EeIMOR_e_BuildAssemblyModeStat:32767, EeHVTR_e_StrtCmd_SrvcProc1320:2, EePLTR_e_RTCStatus:0, EeERER_e_DriveMode:0, EeERER_e_TurtleMode:0, EeAECR_e_MaxRegenDsrdSt:0, EeOBCR_e_ChargingSystemSts:32767, EeOBCR_e_ChargingLevel:32767, EeCHFR_b_ChrgSysFault:0, EeIMOR_y_MMKey1org22_Mem:255, EeOBCR_b_PluggedIn:0, EePLTR_b_RTC_CurrentTimeFA:0, EeIMOR_b_AuthCmd08_InFlag:0, EeIMOR_b_AuthCmd07_InFlag:0, EeIMOR_b_AuthCmd06_InFlag:0, EeIMOR_b_AuthCmd05_InFlag:0, EeIMOR_b_AuthCmd04_InFlag:0, EeIMOR_b_AuthCmd03_InFlag:0, EeIMOR_b_AuthCmd02_InFlag:0, EeIMOR_b_AuthCmd09_InFlag:0, EeIMOR_y_MMKey_3_Mem:255, EeIMOR_b_VC_VehCfg6_Stat_rec:0, EeIMOR_b_VC_VehCfg4_Stat_rec:0, EeIMOR_b_VC_VehCfg3_Stat_rec:0, EeIMOR_b_VC_VehCfg2_Stat_rec:0, EeIMOR_b_ORC_Health_rec:0, EeIMOR_b_MMKey_6Flag:0, EeIMOR_b_MMKey_5Flag:0, EeIMOR_b_MMKey_4Flag:0, EeIMOR_b_MMKey_3Flag:0, EeIMOR_b_MMKey1org22Flag:0, EeIMOR_b_MMKey1org21Flag:0, EeIMOR_b_MKeyStrToE2:0, EeIMOR_b_ImmoAuthValid_Mem:0, EeIMOR_b_ImmoAuthValid_ECMMem:0, EeIMOR_b_CodeRecCmplt_Mem:0, EeIMOR_b_CntrlEncdResFlag:0, EeIMOR_b_AuthCmdCntrlEncdRespFlag:0, EeIMOR_b_AuthCmd15_InFlag:0, EeIMOR_b_AuthCmd14_InFlag:0, EeIMOR_b_AuthCmd13_InFlag:0, EeIMOR_b_AuthCmd12_InFlag:0, EeIMOR_b_AuthCmd11_InFlag:0, EeIMOR_b_AuthCmd10_InFlag:0, EeHPMR_b_ORC_LOCFA:0, EeHMIR_e_HEV_LMP_RQ:255, EePWDR_b_DAPFA_OpenCntctr:0, EePWDR_Cnt_WarmupCycle:0, EePWDR_Cnt_DAP_FA_KeyCylCnt:0, 0, EeERER_e_TrailerConnectionSts:0, EeERER_b_EEPROM_WhperKM:0, EeERER_b_EEPROM_EstRange:0, EEeERER_e_TrailerConnectionSts:0, EeIMOR_y_MMKey1org21_Mem:255, EeIMOR_b_AuthCmd01_InFlag:0, EeIMOR_b_AuthCmd00_InFlag:0, EeIMOR_y_MMKey_4_Mem:255, EeIMOR_y_MMKey_5_Mem:255, EeHVTR_b_OpnReq_SrvcProc1320:0, EeIMOR_y_MMKey_6_Mem:255, EePWDR_y_DID_B524:0, EeAADR_Cnt_AAD_PSACntrLastCal:0, Reserved1:0, Reserved2:0, Reserved3:0, Reserved4:0, Reserved5:0, Reserved6:0, Reserved7:0, Reserved8:0, Reserved9:0, Reserved10:0, Reserved11:0, Reserved12:0, Reserved13:0, Reserved14:0, Reserved15:0, Reserved16:0, Reserved17:0, Reserved18:0, Reserved19:0, Reserved20:0, Reserved21:0, Reserved22:0, Reserved23:0, Reserved24:0, Reserved25:0, Reserved26:0, Reserved27:0]}
        rom block CumulativeNonVolatile_RomBlock_Core4: type=CumulativeNonVolatile_Rom_Core4, init-value={short-label=CumulativeNonVolatile_Rom_Core4, fields=[EePLTR_t_RTCTime:0, EeHCDR_t_RealTime_Comp_On:0, EeHCDR_t_RealTime_Comp_Off:0, EeERER_l_EEPROM_EstRange:0, EeDCCR_t_V2GPerfInhibTime:0, EeDCCR_t_V2GTime:0, EeERER_F_EEPROM_WhperKM:0, EeERER_k_Modify_Factor:0, EeERER_l_VehDist_Delta:0, 0, EePWDR_t_DAP_FA_ElapsedTime:0, EePWDR_l_DAP_FA_DistTravld:0, EeOBCR_t_EstTimeofChrg_Lv1:4294967295, EeOBCR_t_EstTimeofChrg_Lv2:4294967295, EeIMOR_M_Rand1_prev:4294967295, EeIMOR_M_Rand2_prev:4294967295, EeIMOR_M_Rand3_prev:4294967295, EeIMOR_M_Rand4_prev:4294967295, EePLTR_t_PowerdownTime:0, EeTPCR_e_HoldClusterMsg:32767, EeTPCR_e_HoldClusterMsg_KHC:32767, EePLTR_e_ShippingMode:0, EeDMIR_d_ChargeTypeCnf:0, EeDMIR_d_TgtSOCRngCnf:0, EeIMOR_e_BuildAssemblyModeStat:32767, EeHVTR_e_StrtCmd_SrvcProc1320:2, EePLTR_e_RTCStatus:0, EeERER_e_DriveMode:0, EeERER_e_TurtleMode:0, EeAECR_e_MaxRegenDsrdSt:0, EeOBCR_e_ChargingSystemSts:32767, EeOBCR_e_ChargingLevel:32767, EeCHFR_b_ChrgSysFault:0, EeIMOR_y_MMKey1org22_Mem:255, EeOBCR_b_PluggedIn:0, EePLTR_b_RTC_CurrentTimeFA:0, EeIMOR_b_AuthCmd08_InFlag:0, EeIMOR_b_AuthCmd07_InFlag:0, EeIMOR_b_AuthCmd06_InFlag:0, EeIMOR_b_AuthCmd05_InFlag:0, EeIMOR_b_AuthCmd04_InFlag:0, EeIMOR_b_AuthCmd03_InFlag:0, EeIMOR_b_AuthCmd02_InFlag:0, EeIMOR_b_AuthCmd09_InFlag:0, EeIMOR_y_MMKey_3_Mem:255, EeIMOR_b_VC_VehCfg6_Stat_rec:0, EeIMOR_b_VC_VehCfg4_Stat_rec:0, EeIMOR_b_VC_VehCfg3_Stat_rec:0, EeIMOR_b_VC_VehCfg2_Stat_rec:0, EeIMOR_b_ORC_Health_rec:0, EeIMOR_b_MMKey_6Flag:0, EeIMOR_b_MMKey_5Flag:0, EeIMOR_b_MMKey_4Flag:0, EeIMOR_b_MMKey_3Flag:0, EeIMOR_b_MMKey1org22Flag:0, EeIMOR_b_MMKey1org21Flag:0, EeIMOR_b_MKeyStrToE2:0, EeIMOR_b_ImmoAuthValid_Mem:0, EeIMOR_b_ImmoAuthValid_ECMMem:0, EeIMOR_b_CodeRecCmplt_Mem:0, EeIMOR_b_CntrlEncdResFlag:0, EeIMOR_b_AuthCmdCntrlEncdRespFlag:0, EeIMOR_b_AuthCmd15_InFlag:0, EeIMOR_b_AuthCmd14_InFlag:0, EeIMOR_b_AuthCmd13_InFlag:0, EeIMOR_b_AuthCmd12_InFlag:0, EeIMOR_b_AuthCmd11_InFlag:0, EeIMOR_b_AuthCmd10_InFlag:0, EeHPMR_b_ORC_LOCFA:0, EeHMIR_e_HEV_LMP_RQ:255, EePWDR_b_DAPFA_OpenCntctr:0, EePWDR_Cnt_WarmupCycle:0, EePWDR_Cnt_DAP_FA_KeyCylCnt:0, 0, EeERER_e_TrailerConnectionSts:0, EeERER_b_EEPROM_WhperKM:0, EeERER_b_EEPROM_EstRange:0, EEeERER_e_TrailerConnectionSts:0, EeIMOR_y_MMKey1org21_Mem:255, EeIMOR_b_AuthCmd01_InFlag:0, EeIMOR_b_AuthCmd00_InFlag:0, EeIMOR_y_MMKey_4_Mem:255, EeIMOR_y_MMKey_5_Mem:255, EeHVTR_b_OpnReq_SrvcProc1320:0, EeIMOR_y_MMKey_6_Mem:255, EePWDR_y_DID_B524:0, EeAADR_Cnt_AAD_PSACntrLastCal:0, Reserved1:0, Reserved2:0, Reserved3:0, Reserved4:0, Reserved5:0, Reserved6:0, Reserved7:0, Reserved8:0, Reserved9:0, Reserved10:0, Reserved11:0, Reserved12:0, Reserved13:0, Reserved14:0, Reserved15:0, Reserved16:0, Reserved17:0, Reserved18:0, Reserved19:0, Reserved20:0, Reserved21:0, Reserved22:0, Reserved23:0, Reserved24:0, Reserved25:0, Reserved26:0, Reserved27:0]}
      StaticNonVolatile_Descr_Core4
        nv-block-data-mappings:
          {nv-ram-block-element=autosar-variable-in-impl-datatype={root-variable-data-prototype=StaticNonVolatile_RamBlock_Core4, target-data-prototype=StaticNonVolatile_Ram_Core4/BeFWDR_r_Axle_Ratio}, read-nv-data=BeFWDR_r_Axle_Ratio.BeFWDR_r_Axle_Ratio}
          {nv-ram-block-element=autosar-variable-in-impl-datatype={root-variable-data-prototype=StaticNonVolatile_RamBlock_Core4, target-data-prototype=StaticNonVolatile_Ram_Core4/BeFWDR_r_Axle_Ratio}, written-nv-data=BeFWDR_r_Axle_Ratio_Rx.BeFWDR_r_Axle_Ratio}
          {nv-ram-block-element=autosar-variable-in-impl-datatype={root-variable-data-prototype=StaticNonVolatile_RamBlock_Core4, target-data-prototype=StaticNonVolatile_Ram_Core4/BeFWDR_r_Tcase_Hi_Ratio}, read-nv-data=BeFWDR_r_Tcase_Hi_Ratio.BeFWDR_r_Tcase_Hi_Ratio}
          {nv-ram-block-element=autosar-variable-in-impl-datatype={root-variable-data-prototype=StaticNonVolatile_RamBlock_Core4, target-data-prototype=StaticNonVolatile_Ram_Core4/BeFWDR_r_Tcase_Hi_Ratio}, written-nv-data=BeFWDR_r_Tcase_Hi_Ratio_Rx.BeFWDR_r_Tcase_Hi_Ratio}
          {nv-ram-block-element=autosar-variable-in-impl-datatype={root-variable-data-prototype=StaticNonVolatile_RamBlock_Core4, target-data-prototype=StaticNonVolatile_Ram_Core4/BeFWDR_r_Tcase_Low_Ratio}, read-nv-data=BeFWDR_r_Tcase_Low_Ratio.BeFWDR_r_Tcase_Low_Ratio}
          {nv-ram-block-element=autosar-variable-in-impl-datatype={root-variable-data-prototype=StaticNonVolatile_RamBlock_Core4, target-data-prototype=StaticNonVolatile_Ram_Core4/BeFWDR_r_Tcase_Low_Ratio}, written-nv-data=BeFWDR_r_Tcase_Low_Ratio_Rx.BeFWDR_r_Tcase_Low_Ratio}
          {nv-ram-block-element=autosar-variable-in-impl-datatype={root-variable-data-prototype=StaticNonVolatile_RamBlock_Core4, target-data-prototype=StaticNonVolatile_Ram_Core4/BeRTMR_g_BSGRestartRsn}, read-nv-data=BeRTMR_g_BSGRestartRsn.BeRTMR_g_BSGRestartRsn}
          {nv-ram-block-element=autosar-variable-in-impl-datatype={root-variable-data-prototype=StaticNonVolatile_RamBlock_Core4, target-data-prototype=StaticNonVolatile_Ram_Core4/BeRTMR_g_BSGRestartRsn}, written-nv-data=BeRTMR_g_BSGRestartRsn_Rx.BeRTMR_g_BSGRestartRsn}
          {nv-ram-block-element=autosar-variable-in-impl-datatype={root-variable-data-prototype=StaticNonVolatile_RamBlock_Core4, target-data-prototype=StaticNonVolatile_Ram_Core4/BeTRGR_d_IP_PRNDLTestFlags}, read-nv-data=BeTRGR_d_IP_PRNDLTestFlags.BeTRGR_d_IP_PRNDLTestFlags}
          {nv-ram-block-element=autosar-variable-in-impl-datatype={root-variable-data-prototype=StaticNonVolatile_RamBlock_Core4, target-data-prototype=StaticNonVolatile_Ram_Core4/BeTRGR_d_IP_PRNDLTestFlags}, written-nv-data=BeTRGR_d_IP_PRNDLTestFlags_Rx.BeTRGR_d_IP_PRNDLTestFlags}
          {nv-ram-block-element=autosar-variable-in-impl-datatype={root-variable-data-prototype=StaticNonVolatile_RamBlock_Core4, target-data-prototype=StaticNonVolatile_Ram_Core4/BeFWDR_e_Tcase_Stat}, read-nv-data=BeFWDR_e_Tcase_Stat.BeFWDR_e_Tcase_Stat}
          {nv-ram-block-element=autosar-variable-in-impl-datatype={root-variable-data-prototype=StaticNonVolatile_RamBlock_Core4, target-data-prototype=StaticNonVolatile_Ram_Core4/BeFWDR_e_Tcase_Stat}, written-nv-data=BeFWDR_e_Tcase_Stat_Rx.BeFWDR_e_Tcase_Stat}
          {nv-ram-block-element=autosar-variable-in-impl-datatype={root-variable-data-prototype=StaticNonVolatile_RamBlock_Core4, target-data-prototype=StaticNonVolatile_Ram_Core4/BeRTMR_y_ClutchLrnTstCndtnCheck3_PID}, read-nv-data=BeRTMR_y_ClutchLrnTstCndtnCheck3_PID.BeRTMR_y_ClutchLrnTstCndtnCheck3_PID}
          {nv-ram-block-element=autosar-variable-in-impl-datatype={root-variable-data-prototype=StaticNonVolatile_RamBlock_Core4, target-data-prototype=StaticNonVolatile_Ram_Core4/BeRTMR_y_ClutchLrnTstCndtnCheck3_PID}, written-nv-data=BeRTMR_y_ClutchLrnTstCndtnCheck3_PID_Rx.BeRTMR_y_ClutchLrnTstCndtnCheck3_PID}
          {nv-ram-block-element=autosar-variable-in-impl-datatype={root-variable-data-prototype=StaticNonVolatile_RamBlock_Core4, target-data-prototype=StaticNonVolatile_Ram_Core4/BeRTMR_y_ElecOnlyTstCndtnCheck1_PID}, read-nv-data=BeRTMR_y_ElecOnlyTstCndtnCheck1_PID.BeRTMR_y_ElecOnlyTstCndtnCheck1_PID}
          {nv-ram-block-element=autosar-variable-in-impl-datatype={root-variable-data-prototype=StaticNonVolatile_RamBlock_Core4, target-data-prototype=StaticNonVolatile_Ram_Core4/BeRTMR_y_ElecOnlyTstCndtnCheck1_PID}, written-nv-data=BeRTMR_y_ElecOnlyTstCndtnCheck1_PID_Rx.BeRTMR_y_ElecOnlyTstCndtnCheck1_PID}
          {nv-ram-block-element=autosar-variable-in-impl-datatype={root-variable-data-prototype=StaticNonVolatile_RamBlock_Core4, target-data-prototype=StaticNonVolatile_Ram_Core4/BeRTMR_y_ElecOnlyTstCndtnCheck2_PID}, read-nv-data=BeRTMR_y_ElecOnlyTstCndtnCheck2_PID.BeRTMR_y_ElecOnlyTstCndtnCheck2_PID}
          {nv-ram-block-element=autosar-variable-in-impl-datatype={root-variable-data-prototype=StaticNonVolatile_RamBlock_Core4, target-data-prototype=StaticNonVolatile_Ram_Core4/BeRTMR_y_ElecOnlyTstCndtnCheck2_PID}, written-nv-data=BeRTMR_y_ElecOnlyTstCndtnCheck2_PID_Rx.BeRTMR_y_ElecOnlyTstCndtnCheck2_PID}
          {nv-ram-block-element=autosar-variable-in-impl-datatype={root-variable-data-prototype=StaticNonVolatile_RamBlock_Core4, target-data-prototype=StaticNonVolatile_Ram_Core4/BeRTMR_y_ReslvrOfsLrnCndtnCheck3_PID}, read-nv-data=BeRTMR_y_ReslvrOfsLrnCndtnCheck3_PID.BeRTMR_y_ReslvrOfsLrnCndtnCheck3_PID}
          {nv-ram-block-element=autosar-variable-in-impl-datatype={root-variable-data-prototype=StaticNonVolatile_RamBlock_Core4, target-data-prototype=StaticNonVolatile_Ram_Core4/BeRTMR_y_ReslvrOfsLrnCndtnCheck3_PID}, written-nv-data=BeRTMR_y_ReslvrOfsLrnCndtnCheck3_PID_Rx.BeRTMR_y_ReslvrOfsLrnCndtnCheck3_PID}
          {nv-ram-block-element=autosar-variable-in-impl-datatype={root-variable-data-prototype=StaticNonVolatile_RamBlock_Core4, target-data-prototype=StaticNonVolatile_Ram_Core4/BeRTMR_y_ReslvrOfsLrnFaultStatus3_PID}, read-nv-data=BeRTMR_y_ReslvrOfsLrnFaultStatus3_PID.BeRTMR_y_ReslvrOfsLrnFaultStatus3_PID}
          {nv-ram-block-element=autosar-variable-in-impl-datatype={root-variable-data-prototype=StaticNonVolatile_RamBlock_Core4, target-data-prototype=StaticNonVolatile_Ram_Core4/BeRTMR_y_ReslvrOfsLrnFaultStatus3_PID}, written-nv-data=BeRTMR_y_ReslvrOfsLrnFaultStatus3_PID_Rx.BeRTMR_y_ReslvrOfsLrnFaultStatus3_PID}
          {nv-ram-block-element=autosar-variable-in-impl-datatype={root-variable-data-prototype=StaticNonVolatile_RamBlock_Core4, target-data-prototype=StaticNonVolatile_Ram_Core4/BeRTMR_y_ReslvrOfsLrnFaultStatus4_PID}, read-nv-data=BeRTMR_y_ReslvrOfsLrnFaultStatus4_PID.BeRTMR_y_ReslvrOfsLrnFaultStatus4_PID}
          {nv-ram-block-element=autosar-variable-in-impl-datatype={root-variable-data-prototype=StaticNonVolatile_RamBlock_Core4, target-data-prototype=StaticNonVolatile_Ram_Core4/BeRTMR_y_ReslvrOfsLrnFaultStatus4_PID}, written-nv-data=BeRTMR_y_ReslvrOfsLrnFaultStatus4_PID_Rx.BeRTMR_y_ReslvrOfsLrnFaultStatus4_PID}
          {nv-ram-block-element=autosar-variable-in-impl-datatype={root-variable-data-prototype=StaticNonVolatile_RamBlock_Core4, target-data-prototype=StaticNonVolatile_Ram_Core4/BeRTMR_y_ReslvrOfsLrnFaultStatus5_PID}, read-nv-data=BeRTMR_y_ReslvrOfsLrnFaultStatus5_PID.BeRTMR_y_ReslvrOfsLrnFaultStatus5_PID}
          {nv-ram-block-element=autosar-variable-in-impl-datatype={root-variable-data-prototype=StaticNonVolatile_RamBlock_Core4, target-data-prototype=StaticNonVolatile_Ram_Core4/BeRTMR_y_ReslvrOfsLrnFaultStatus5_PID}, written-nv-data=BeRTMR_y_ReslvrOfsLrnFaultStatus5_PID_Rx.BeRTMR_y_ReslvrOfsLrnFaultStatus5_PID}
          {nv-ram-block-element=autosar-variable-in-impl-datatype={root-variable-data-prototype=StaticNonVolatile_RamBlock_Core4, target-data-prototype=StaticNonVolatile_Ram_Core4/BeRTMR_y_ClutchLrnTstCndtnCheck2_PID}, read-nv-data=BeRTMR_y_ClutchLrnTstCndtnCheck2_PID.BeRTMR_y_ClutchLrnTstCndtnCheck2_PID}
          {nv-ram-block-element=autosar-variable-in-impl-datatype={root-variable-data-prototype=StaticNonVolatile_RamBlock_Core4, target-data-prototype=StaticNonVolatile_Ram_Core4/BeRTMR_y_ClutchLrnTstCndtnCheck2_PID}, written-nv-data=BeRTMR_y_ClutchLrnTstCndtnCheck2_PID_Rx.BeRTMR_y_ClutchLrnTstCndtnCheck2_PID}
          {nv-ram-block-element=autosar-variable-in-impl-datatype={root-variable-data-prototype=StaticNonVolatile_RamBlock_Core4, target-data-prototype=StaticNonVolatile_Ram_Core4/BeRTMR_y_ClutchLrnTstCndtnCheck1_PID}, read-nv-data=BeRTMR_y_ClutchLrnTstCndtnCheck1_PID.BeRTMR_y_ClutchLrnTstCndtnCheck1_PID}
          {nv-ram-block-element=autosar-variable-in-impl-datatype={root-variable-data-prototype=StaticNonVolatile_RamBlock_Core4, target-data-prototype=StaticNonVolatile_Ram_Core4/BeRTMR_y_ClutchLrnTstCndtnCheck1_PID}, written-nv-data=BeRTMR_y_ClutchLrnTstCndtnCheck1_PID_Rx.BeRTMR_y_ClutchLrnTstCndtnCheck1_PID}
          {nv-ram-block-element=autosar-variable-in-impl-datatype={root-variable-data-prototype=StaticNonVolatile_RamBlock_Core4, target-data-prototype=StaticNonVolatile_Ram_Core4/BeRTMR_y_ClutchLrnTestStatus_PID}, read-nv-data=BeRTMR_y_ClutchLrnTestStatus_PID.BeRTMR_y_ClutchLrnTestStatus_PID}
          {nv-ram-block-element=autosar-variable-in-impl-datatype={root-variable-data-prototype=StaticNonVolatile_RamBlock_Core4, target-data-prototype=StaticNonVolatile_Ram_Core4/BeRTMR_y_ClutchLrnTestStatus_PID}, written-nv-data=BeRTMR_y_ClutchLrnTestStatus_PID_Rx.BeRTMR_y_ClutchLrnTestStatus_PID}
          {nv-ram-block-element=autosar-variable-in-impl-datatype={root-variable-data-prototype=StaticNonVolatile_RamBlock_Core4, target-data-prototype=StaticNonVolatile_Ram_Core4/BeHSWR_b_ECMHdStatSaved}, read-nv-data=BeHSWR_b_ECMHdStatSaved.BeHSWR_b_ECMHdStatSaved}
          {nv-ram-block-element=autosar-variable-in-impl-datatype={root-variable-data-prototype=StaticNonVolatile_RamBlock_Core4, target-data-prototype=StaticNonVolatile_Ram_Core4/BeHSWR_b_ECMHdStatSaved}, written-nv-data=BeHSWR_b_ECMHdStatSaved_Rx.BeHSWR_b_ECMHdStatSaved}
        nv block needs NvBlockNeeds: calc-ram-block-crc=false, check-static-block-id=false, readonly=false, resistant-to-changed-sw=true, restore-at-start=true, store-at-shutdown=true, store-cyclic=false, store-emergency=false, store-immediate=false, use-auto-validation-at-shut-down=false, use-crc-comp-mechanism=true, write-only-once=true, write-verification=false
        ram block StaticNonVolatile_RamBlock_Core4: type=StaticNonVolatile_Ram_Core4, init-value={short-label=StaticNonVolatile_Ram_Core4, fields=[BeFWDR_r_Axle_Ratio:4294967295, BeFWDR_r_Tcase_Hi_Ratio:4294967295, BeFWDR_r_Tcase_Low_Ratio:4294967295, BeRTMR_g_BSGRestartRsn:0, BeTRGR_d_IP_PRNDLTestFlags:0, BeFWDR_e_Tcase_Stat:32767, BeRTMR_y_ClutchLrnTstCndtnCheck3_PID:0, BeRTMR_y_ElecOnlyTstCndtnCheck1_PID:0, BeRTMR_y_ElecOnlyTstCndtnCheck2_PID:0, BeRTMR_y_ReslvrOfsLrnCndtnCheck3_PID:0, BeRTMR_y_ReslvrOfsLrnFaultStatus3_PID:0, BeRTMR_y_ReslvrOfsLrnFaultStatus4_PID:0, BeRTMR_y_ReslvrOfsLrnFaultStatus5_PID:0, BeRTMR_y_ClutchLrnTstCndtnCheck2_PID:0, BeRTMR_y_ClutchLrnTstCndtnCheck1_PID:0, BeRTMR_y_ClutchLrnTestStatus_PID:0, BeHSWR_b_ECMHdStatSaved:1, Reserved1:0, Reserved2:0, Reserved3:0, Reserved4:0, Reserved5:0, Reserved6:0, Reserved7:0, Reserved8:0, Reserved9:0, Reserved10:0, Reserved11:0, Reserved12:0, Reserved13:0, Reserved14:0, Reserved15:0, Reserved16:0, Reserved17:0, Reserved18:0, Reserved19:0, Reserved20:0, Reserved21:0, Reserved22:0, Reserved23:0, Reserved24:0, Reserved25:0]}
        rom block StaticNonVolatile_RomBlock_Core4: type=StaticNonVolatile_Rom_Core4, init-value={short-label=StaticNonVolatile_Rom_Core4, fields=[BeFWDR_r_Axle_Ratio:4294967295, BeFWDR_r_Tcase_Hi_Ratio:4294967295, BeFWDR_r_Tcase_Low_Ratio:4294967295, BeRTMR_g_BSGRestartRsn:0, BeTRGR_d_IP_PRNDLTestFlags:0, BeFWDR_e_Tcase_Stat:32767, BeRTMR_y_ClutchLrnTstCndtnCheck3_PID:0, BeRTMR_y_ElecOnlyTstCndtnCheck1_PID:0, BeRTMR_y_ElecOnlyTstCndtnCheck2_PID:0, BeRTMR_y_ReslvrOfsLrnCndtnCheck3_PID:0, BeRTMR_y_ReslvrOfsLrnFaultStatus3_PID:0, BeRTMR_y_ReslvrOfsLrnFaultStatus4_PID:0, BeRTMR_y_ReslvrOfsLrnFaultStatus5_PID:0, BeRTMR_y_ClutchLrnTstCndtnCheck2_PID:0, BeRTMR_y_ClutchLrnTstCndtnCheck1_PID:0, BeRTMR_y_ClutchLrnTestStatus_PID:0, BeHSWR_b_ECMHdStatSaved:1, Reserved1:0, Reserved2:0, Reserved3:0, Reserved4:0, Reserved5:0, Reserved6:0, Reserved7:0, Reserved8:0, Reserved9:0, Reserved10:0, Reserved11:0, Reserved12:0, Reserved13:0, Reserved14:0, Reserved15:0, Reserved16:0, Reserved17:0, Reserved18:0, Reserved19:0, Reserved20:0, Reserved21:0, Reserved22:0, Reserved23:0, Reserved24:0, Reserved25:0]}
      AdaptiveNonVolatile_Descr_Core4
        nv-block-data-mappings:
          {nv-ram-block-element=autosar-variable-in-impl-datatype={root-variable-data-prototype=AdaptiveNonVolatile_RamBlock_Core4, target-data-prototype=AdaptiveNonVolatile_Ram_Core4/DeESMR_P_HV_BatChrgPwrLTArb}, read-nv-data=DeESMR_P_HV_BatChrgPwrLTArb.DeESMR_P_HV_BatChrgPwrLTArb}
          {nv-ram-block-element=autosar-variable-in-impl-datatype={root-variable-data-prototype=AdaptiveNonVolatile_RamBlock_Core4, target-data-prototype=AdaptiveNonVolatile_Ram_Core4/DeESMR_P_HV_BatChrgPwrLTArb}, written-nv-data=DeESMR_P_HV_BatChrgPwrLTArb_Rx.DeESMR_P_HV_BatChrgPwrLTArb}
          {nv-ram-block-element=autosar-variable-in-impl-datatype={root-variable-data-prototype=AdaptiveNonVolatile_RamBlock_Core4, target-data-prototype=AdaptiveNonVolatile_Ram_Core4/DeESMR_P_HV_BatChrgPwrSTArb}, read-nv-data=DeESMR_P_HV_BatChrgPwrSTArb.DeESMR_P_HV_BatChrgPwrSTArb}
          {nv-ram-block-element=autosar-variable-in-impl-datatype={root-variable-data-prototype=AdaptiveNonVolatile_RamBlock_Core4, target-data-prototype=AdaptiveNonVolatile_Ram_Core4/DeESMR_P_HV_BatChrgPwrSTArb}, written-nv-data=DeESMR_P_HV_BatChrgPwrSTArb_Rx.DeESMR_P_HV_BatChrgPwrSTArb}
          {nv-ram-block-element=autosar-variable-in-impl-datatype={root-variable-data-prototype=AdaptiveNonVolatile_RamBlock_Core4, target-data-prototype=AdaptiveNonVolatile_Ram_Core4/DeESMR_P_HV_BatDschrgPwrLTArb}, read-nv-data=DeESMR_P_HV_BatDschrgPwrLTArb.DeESMR_P_HV_BatDschrgPwrLTArb}
          {nv-ram-block-element=autosar-variable-in-impl-datatype={root-variable-data-prototype=AdaptiveNonVolatile_RamBlock_Core4, target-data-prototype=AdaptiveNonVolatile_Ram_Core4/DeESMR_P_HV_BatDschrgPwrLTArb}, written-nv-data=DeESMR_P_HV_BatDschrgPwrLTArb_Rx.DeESMR_P_HV_BatDschrgPwrLTArb}
          {nv-ram-block-element=autosar-variable-in-impl-datatype={root-variable-data-prototype=AdaptiveNonVolatile_RamBlock_Core4, target-data-prototype=AdaptiveNonVolatile_Ram_Core4/DeESMC_P_AccumChrgEnergy}, read-nv-data=DeESMC_P_AccumChrgEnergy.DeESMC_P_AccumChrgEnergy}
          {nv-ram-block-element=autosar-variable-in-impl-datatype={root-variable-data-prototype=AdaptiveNonVolatile_RamBlock_Core4, target-data-prototype=AdaptiveNonVolatile_Ram_Core4/DeESMC_P_AccumChrgEnergy}, written-nv-data=DeESMC_P_AccumChrgEnergy_Rx.DeESMC_P_AccumChrgEnergy}
          {nv-ram-block-element=autosar-variable-in-impl-datatype={root-variable-data-prototype=AdaptiveNonVolatile_RamBlock_Core4, target-data-prototype=AdaptiveNonVolatile_Ram_Core4/DeESMC_P_AccumDisChgEnergy}, read-nv-data=DeESMC_P_AccumDisChgEnergy.DeESMC_P_AccumDisChgEnergy}
          {nv-ram-block-element=autosar-variable-in-impl-datatype={root-variable-data-prototype=AdaptiveNonVolatile_RamBlock_Core4, target-data-prototype=AdaptiveNonVolatile_Ram_Core4/DeESMC_P_AccumDisChgEnergy}, written-nv-data=DeESMC_P_AccumDisChgEnergy_Rx.DeESMC_P_AccumDisChgEnergy}
          {nv-ram-block-element=autosar-variable-in-impl-datatype={root-variable-data-prototype=AdaptiveNonVolatile_RamBlock_Core4, target-data-prototype=AdaptiveNonVolatile_Ram_Core4/DeESMC_I_AccumDisChrgCurr}, read-nv-data=DeESMC_I_AccumDisChrgCurr.DeESMC_I_AccumDisChrgCurr}
          {nv-ram-block-element=autosar-variable-in-impl-datatype={root-variable-data-prototype=AdaptiveNonVolatile_RamBlock_Core4, target-data-prototype=AdaptiveNonVolatile_Ram_Core4/DeESMC_I_AccumDisChrgCurr}, written-nv-data=DeESMC_I_AccumDisChrgCurr_Rx.DeESMC_I_AccumDisChrgCurr}
          {nv-ram-block-element=autosar-variable-in-impl-datatype={root-variable-data-prototype=AdaptiveNonVolatile_RamBlock_Core4, target-data-prototype=AdaptiveNonVolatile_Ram_Core4/DeESMC_I_AccumChrgCurr}, read-nv-data=DeESMC_I_AccumChrgCurr.DeESMC_I_AccumChrgCurr}
          {nv-ram-block-element=autosar-variable-in-impl-datatype={root-variable-data-prototype=AdaptiveNonVolatile_RamBlock_Core4, target-data-prototype=AdaptiveNonVolatile_Ram_Core4/DeESMC_I_AccumChrgCurr}, written-nv-data=DeESMC_I_AccumChrgCurr_Rx.DeESMC_I_AccumChrgCurr}
          {nv-ram-block-element=autosar-variable-in-impl-datatype={root-variable-data-prototype=AdaptiveNonVolatile_RamBlock_Core4, target-data-prototype=AdaptiveNonVolatile_Ram_Core4/DeESMR_P_HV_BatDschrgPwrSTArb}, read-nv-data=DeESMR_P_HV_BatDschrgPwrSTArb.DeESMR_P_HV_BatDschrgPwrSTArb}
          {nv-ram-block-element=autosar-variable-in-impl-datatype={root-variable-data-prototype=AdaptiveNonVolatile_RamBlock_Core4, target-data-prototype=AdaptiveNonVolatile_Ram_Core4/DeESMR_P_HV_BatDschrgPwrSTArb}, written-nv-data=DeESMR_P_HV_BatDschrgPwrSTArb_Rx.DeESMR_P_HV_BatDschrgPwrSTArb}
          {nv-ram-block-element=autosar-variable-in-impl-datatype={root-variable-data-prototype=AdaptiveNonVolatile_RamBlock_Core4, target-data-prototype=AdaptiveNonVolatile_Ram_Core4/DeBPCR_P_HV_BatChrgPwrET}, read-nv-data=DeBPCR_P_HV_BatChrgPwrET.DeBPCR_P_HV_BatChrgPwrET}
          {nv-ram-block-element=autosar-variable-in-impl-datatype={root-variable-data-prototype=AdaptiveNonVolatile_RamBlock_Core4, target-data-prototype=AdaptiveNonVolatile_Ram_Core4/DeBPCR_P_HV_BatChrgPwrET}, written-nv-data=DeBPCR_P_HV_BatChrgPwrET_Rx.DeBPCR_P_HV_BatChrgPwrET}
          {nv-ram-block-element=autosar-variable-in-impl-datatype={root-variable-data-prototype=AdaptiveNonVolatile_RamBlock_Core4, target-data-prototype=AdaptiveNonVolatile_Ram_Core4/DeBPCR_P_HV_BatChrgPwrST}, read-nv-data=DeBPCR_P_HV_BatChrgPwrST.DeBPCR_P_HV_BatChrgPwrST}
          {nv-ram-block-element=autosar-variable-in-impl-datatype={root-variable-data-prototype=AdaptiveNonVolatile_RamBlock_Core4, target-data-prototype=AdaptiveNonVolatile_Ram_Core4/DeBPCR_P_HV_BatChrgPwrST}, written-nv-data=DeBPCR_P_HV_BatChrgPwrST_Rx.DeBPCR_P_HV_BatChrgPwrST}
          {nv-ram-block-element=autosar-variable-in-impl-datatype={root-variable-data-prototype=AdaptiveNonVolatile_RamBlock_Core4, target-data-prototype=AdaptiveNonVolatile_Ram_Core4/DeBPCR_P_HV_BatDschrgPwrET}, read-nv-data=DeBPCR_P_HV_BatDschrgPwrET.DeBPCR_P_HV_BatDschrgPwrET}
          {nv-ram-block-element=autosar-variable-in-impl-datatype={root-variable-data-prototype=AdaptiveNonVolatile_RamBlock_Core4, target-data-prototype=AdaptiveNonVolatile_Ram_Core4/DeBPCR_P_HV_BatDschrgPwrET}, written-nv-data=DeBPCR_P_HV_BatDschrgPwrET_Rx.DeBPCR_P_HV_BatDschrgPwrET}
          {nv-ram-block-element=autosar-variable-in-impl-datatype={root-variable-data-prototype=AdaptiveNonVolatile_RamBlock_Core4, target-data-prototype=AdaptiveNonVolatile_Ram_Core4/DeBPCR_P_HV_BatDschrgPwrLT}, read-nv-data=DeBPCR_P_HV_BatDschrgPwrLT.DeBPCR_P_HV_BatDschrgPwrLT}
          {nv-ram-block-element=autosar-variable-in-impl-datatype={root-variable-data-prototype=AdaptiveNonVolatile_RamBlock_Core4, target-data-prototype=AdaptiveNonVolatile_Ram_Core4/DeBPCR_P_HV_BatDschrgPwrLT}, written-nv-data=DeBPCR_P_HV_BatDschrgPwrLT_Rx.DeBPCR_P_HV_BatDschrgPwrLT}
          {nv-ram-block-element=autosar-variable-in-impl-datatype={root-variable-data-prototype=AdaptiveNonVolatile_RamBlock_Core4, target-data-prototype=AdaptiveNonVolatile_Ram_Core4/DeBPCR_Pct_HV_BatSOC_DS}, read-nv-data=DeBPCR_Pct_HV_BatSOC_DS.DeBPCR_Pct_HV_BatSOC_DS}
          {nv-ram-block-element=autosar-variable-in-impl-datatype={root-variable-data-prototype=AdaptiveNonVolatile_RamBlock_Core4, target-data-prototype=AdaptiveNonVolatile_Ram_Core4/DeBPCR_Pct_HV_BatSOC_DS}, written-nv-data=DeBPCR_Pct_HV_BatSOC_DS_Rx.DeBPCR_Pct_HV_BatSOC_DS}
          {nv-ram-block-element=autosar-variable-in-impl-datatype={root-variable-data-prototype=AdaptiveNonVolatile_RamBlock_Core4, target-data-prototype=AdaptiveNonVolatile_Ram_Core4/DeBPCR_P_HV_BatChrgPwrLT}, read-nv-data=DeBPCR_P_HV_BatChrgPwrLT.DeBPCR_P_HV_BatChrgPwrLT}
          {nv-ram-block-element=autosar-variable-in-impl-datatype={root-variable-data-prototype=AdaptiveNonVolatile_RamBlock_Core4, target-data-prototype=AdaptiveNonVolatile_Ram_Core4/DeBPCR_P_HV_BatChrgPwrLT}, written-nv-data=DeBPCR_P_HV_BatChrgPwrLT_Rx.DeBPCR_P_HV_BatChrgPwrLT}
          {nv-ram-block-element=autosar-variable-in-impl-datatype={root-variable-data-prototype=AdaptiveNonVolatile_RamBlock_Core4, target-data-prototype=AdaptiveNonVolatile_Ram_Core4/DeBPCR_P_HV_BatDschrgPwrST}, read-nv-data=DeBPCR_P_HV_BatDschrgPwrST.DeBPCR_P_HV_BatDschrgPwrST}
          {nv-ram-block-element=autosar-variable-in-impl-datatype={root-variable-data-prototype=AdaptiveNonVolatile_RamBlock_Core4, target-data-prototype=AdaptiveNonVolatile_Ram_Core4/DeBPCR_P_HV_BatDschrgPwrST}, written-nv-data=DeBPCR_P_HV_BatDschrgPwrST_Rx.DeBPCR_P_HV_BatDschrgPwrST}
        nv block needs NvBlockNeeds: calc-ram-block-crc=false, check-static-block-id=false, readonly=false, resistant-to-changed-sw=false, restore-at-start=true, store-at-shutdown=true, store-cyclic=false, store-emergency=false, store-immediate=false, use-auto-validation-at-shut-down=false, use-crc-comp-mechanism=true, write-only-once=false, write-verification=false
        ram block AdaptiveNonVolatile_RamBlock_Core4: type=AdaptiveNonVolatile_Ram_Core4, init-value={short-label=AdaptiveNonVolatile_Ram_Core4, fields=[DeESMR_P_HV_BatChrgPwrLTArb:-26, DeESMR_P_HV_BatChrgPwrSTArb:-31, DeESMR_P_HV_BatDschrgPwrLTArb:31, DeESMC_P_AccumChrgEnergy:0, DeESMC_P_AccumDisChgEnergy:0, DeESMC_I_AccumDisChrgCurr:0, DeESMC_I_AccumChrgCurr:0, DeESMR_P_HV_BatDschrgPwrSTArb:36, DeBPCR_P_HV_BatChrgPwrET:0, DeBPCR_P_HV_BatChrgPwrST:0, DeBPCR_P_HV_BatDschrgPwrET:0, DeBPCR_P_HV_BatDschrgPwrLT:0, DeBPCR_Pct_HV_BatSOC_DS:0, DeBPCR_P_HV_BatChrgPwrLT:0, DeBPCR_P_HV_BatDschrgPwrST:0, Reserved1:0, Reserved2:0, Reserved3:0, Reserved4:0, Reserved5:0, Reserved6:0, Reserved7:0, Reserved8:0, Reserved9:0, Reserved10:0, Reserved11:0, Reserved12:0, Reserved13:0, Reserved14:0, Reserved15:0, Reserved16:0, Reserved17:0, Reserved18:0, Reserved19:0, Reserved20:0, Reserved21:0, Reserved22:0, Reserved23:0, Reserved24:0]}
        rom block AdaptiveNonVolatile_RomBlock_Core4: type=AdaptiveNonVolatile_Rom_Core4, init-value={short-label=AdaptiveNonVolatile_Rom_Core4, fields=[DeESMR_P_HV_BatChrgPwrLTArb:-26, DeESMR_P_HV_BatChrgPwrSTArb:-31, DeESMR_P_HV_BatDschrgPwrLTArb:31, DeESMC_P_AccumChrgEnergy:0, DeESMC_P_AccumDisChgEnergy:0, DeESMC_I_AccumDisChrgCurr:0, DeESMC_I_AccumChrgCurr:0, DeESMR_P_HV_BatDschrgPwrSTArb:36, DeBPCR_P_HV_BatChrgPwrET:0, DeBPCR_P_HV_BatChrgPwrST:0, DeBPCR_P_HV_BatDschrgPwrET:0, DeBPCR_P_HV_BatDschrgPwrLT:0, DeBPCR_Pct_HV_BatSOC_DS:0, DeBPCR_P_HV_BatChrgPwrLT:0, DeBPCR_P_HV_BatDschrgPwrST:0, Reserved1:0, Reserved2:0, Reserved3:0, Reserved4:0, Reserved5:0, Reserved6:0, Reserved7:0, Reserved8:0, Reserved9:0, Reserved10:0, Reserved11:0, Reserved12:0, Reserved13:0, Reserved14:0, Reserved15:0, Reserved16:0, Reserved17:0, Reserved18:0, Reserved19:0, Reserved20:0, Reserved21:0, Reserved22:0, Reserved23:0, Reserved24:0]}
