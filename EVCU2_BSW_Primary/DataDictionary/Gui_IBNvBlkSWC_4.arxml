[part 3 of 5: package /IBNvBlkSWC_4]
AUTOSAR XML (schema 00050)
package /IBNvBlkSWC_4  (continued)
  nv block sw component type IBNvBlkSWC_4  (continued)
    10 x nv block descriptor, all with support-dirty-flag=true:
      ExpendableNonVolatile_Descr_Core4
        nv-block-data-mappings:
          {nv-ram-block-element=autosar-variable-in-impl-datatype={root-variable-data-prototype=ExpendableNonVolatile_RamBlock_Core4, target-data-prototype=ExpendableNonVolatile_Ram_Core4/NeESMC_I_Ahrperhr_DS}, read-nv-data=NeESMC_I_Ahrperhr_DS.NeESMC_I_Ahrperhr_DS}
          {nv-ram-block-element=autosar-variable-in-impl-datatype={root-variable-data-prototype=ExpendableNonVolatile_RamBlock_Core4, target-data-prototype=ExpendableNonVolatile_Ram_Core4/NeESMC_I_Ahrperhr_DS}, written-nv-data=NeESMC_I_Ahrperhr_DS_Rx.NeESMC_I_Ahrperhr_DS}
          {nv-ram-block-element=autosar-variable-in-impl-datatype={root-variable-data-prototype=ExpendableNonVolatile_RamBlock_Core4, target-data-prototype=ExpendableNonVolatile_Ram_Core4/NeSCPR_g_DoNotRepeatValSch1}, read-nv-data=NeSCPR_g_DoNotRepeatValSch1.NeSCPR_g_DoNotRepeatValSch1}
          {nv-ram-block-element=autosar-variable-in-impl-datatype={root-variable-data-prototype=ExpendableNonVolatile_RamBlock_Core4, target-data-prototype=ExpendableNonVolatile_Ram_Core4/NeSCPR_g_DoNotRepeatValSch1}, written-nv-data=NeSCPR_g_DoNotRepeatValSch1_Rx.NeSCPR_g_DoNotRepeatValSch1}
          {nv-ram-block-element=autosar-variable-in-impl-datatype={root-variable-data-prototype=ExpendableNonVolatile_RamBlock_Core4, target-data-prototype=ExpendableNonVolatile_Ram_Core4/NeSCPR_Pct_Sch1CoCH_ImmSOCtrgt}, read-nv-data=NeSCPR_Pct_Sch1CoCH_ImmSOCtrgt.NeSCPR_Pct_Sch1CoCH_ImmSOCtrgt}
          {nv-ram-block-element=autosar-variable-in-impl-datatype={root-variable-data-prototype=ExpendableNonVolatile_RamBlock_Core4, target-data-prototype=ExpendableNonVolatile_Ram_Core4/NeSCPR_Pct_Sch1CoCH_ImmSOCtrgt}, written-nv-data=NeSCPR_Pct_Sch1CoCH_ImmSOCtrgt_Rx.NeSCPR_Pct_Sch1CoCH_ImmSOCtrgt}
          {nv-ram-block-element=autosar-variable-in-impl-datatype={root-variable-data-prototype=ExpendableNonVolatile_RamBlock_Core4, target-data-prototype=ExpendableNonVolatile_Ram_Core4/NeSCPR_Pct_Sch2CoCH_ExtSOCtrgt}, read-nv-data=NeSCPR_Pct_Sch2CoCH_ExtSOCtrgt.NeSCPR_Pct_Sch2CoCH_ExtSOCtrgt}
          {nv-ram-block-element=autosar-variable-in-impl-datatype={root-variable-data-prototype=ExpendableNonVolatile_RamBlock_Core4, target-data-prototype=ExpendableNonVolatile_Ram_Core4/NeSCPR_Pct_Sch2CoCH_ExtSOCtrgt}, written-nv-data=NeSCPR_Pct_Sch2CoCH_ExtSOCtrgt_Rx.NeSCPR_Pct_Sch2CoCH_ExtSOCtrgt}
          {nv-ram-block-element=autosar-variable-in-impl-datatype={root-variable-data-prototype=ExpendableNonVolatile_RamBlock_Core4, target-data-prototype=ExpendableNonVolatile_Ram_Core4/NeSCPR_Pct_Sch2CoCH_ImmSOCtrgt}, read-nv-data=NeSCPR_Pct_Sch2CoCH_ImmSOCtrgt.NeSCPR_Pct_Sch2CoCH_ImmSOCtrgt}
          {nv-ram-block-element=autosar-variable-in-impl-datatype={root-variable-data-prototype=ExpendableNonVolatile_RamBlock_Core4, target-data-prototype=ExpendableNonVolatile_Ram_Core4/NeSCPR_Pct_Sch2CoCH_ImmSOCtrgt}, written-nv-data=NeSCPR_Pct_Sch2CoCH_ImmSOCtrgt_Rx.NeSCPR_Pct_Sch2CoCH_ImmSOCtrgt}
          {nv-ram-block-element=autosar-variable-in-impl-datatype={root-variable-data-prototype=ExpendableNonVolatile_RamBlock_Core4, target-data-prototype=ExpendableNonVolatile_Ram_Core4/NeDCCR_E_TECharge}, read-nv-data=NeDCCR_E_TECharge.NeDCCR_E_TECharge}
          {nv-ram-block-element=autosar-variable-in-impl-datatype={root-variable-data-prototype=ExpendableNonVolatile_RamBlock_Core4, target-data-prototype=ExpendableNonVolatile_Ram_Core4/NeDCCR_E_TECharge}, written-nv-data=NeDCCR_E_TECharge_Rx.NeDCCR_E_TECharge}
          {nv-ram-block-element=autosar-variable-in-impl-datatype={root-variable-data-prototype=ExpendableNonVolatile_RamBlock_Core4, target-data-prototype=ExpendableNonVolatile_Ram_Core4/NeDCCR_E_TEDischarge}, read-nv-data=NeDCCR_E_TEDischarge.NeDCCR_E_TEDischarge}
          {nv-ram-block-element=autosar-variable-in-impl-datatype={root-variable-data-prototype=ExpendableNonVolatile_RamBlock_Core4, target-data-prototype=ExpendableNonVolatile_Ram_Core4/NeDCCR_E_TEDischarge}, written-nv-data=NeDCCR_E_TEDischarge_Rx.NeDCCR_E_TEDischarge}
          {nv-ram-block-element=autosar-variable-in-impl-datatype={root-variable-data-prototype=ExpendableNonVolatile_RamBlock_Core4, target-data-prototype=ExpendableNonVolatile_Ram_Core4/NeSCPR_k_LastSecond}, read-nv-data=NeSCPR_k_LastSecond.NeSCPR_k_LastSecond}
          {nv-ram-block-element=autosar-variable-in-impl-datatype={root-variable-data-prototype=ExpendableNonVolatile_RamBlock_Core4, target-data-prototype=ExpendableNonVolatile_Ram_Core4/NeSCPR_k_LastSecond}, written-nv-data=NeSCPR_k_LastSecond_Rx.NeSCPR_k_LastSecond}
          {nv-ram-block-element=autosar-variable-in-impl-datatype={root-variable-data-prototype=ExpendableNonVolatile_RamBlock_Core4, target-data-prototype=ExpendableNonVolatile_Ram_Core4/NeSCPR_k_LastRTC}, read-nv-data=NeSCPR_k_LastRTC.NeSCPR_k_LastRTC}
          {nv-ram-block-element=autosar-variable-in-impl-datatype={root-variable-data-prototype=ExpendableNonVolatile_RamBlock_Core4, target-data-prototype=ExpendableNonVolatile_Ram_Core4/NeSCPR_k_LastRTC}, written-nv-data=NeSCPR_k_LastRTC_Rx.NeSCPR_k_LastRTC}
          {nv-ram-block-element=autosar-variable-in-impl-datatype={root-variable-data-prototype=ExpendableNonVolatile_RamBlock_Core4, target-data-prototype=ExpendableNonVolatile_Ram_Core4/NeSCPR_k_CancOverlapTrack}, read-nv-data=NeSCPR_k_CancOverlapTrack.NeSCPR_k_CancOverlapTrack}
          {nv-ram-block-element=autosar-variable-in-impl-datatype={root-variable-data-prototype=ExpendableNonVolatile_RamBlock_Core4, target-data-prototype=ExpendableNonVolatile_Ram_Core4/NeSCPR_k_CancOverlapTrack}, written-nv-data=NeSCPR_k_CancOverlapTrack_Rx.NeSCPR_k_CancOverlapTrack}
          {nv-ram-block-element=autosar-variable-in-impl-datatype={root-variable-data-prototype=ExpendableNonVolatile_RamBlock_Core4, target-data-prototype=ExpendableNonVolatile_Ram_Core4/NeSCPR_k_CancGlStartTrack}, read-nv-data=NeSCPR_k_CancGlStartTrack.NeSCPR_k_CancGlStartTrack}
          {nv-ram-block-element=autosar-variable-in-impl-datatype={root-variable-data-prototype=ExpendableNonVolatile_RamBlock_Core4, target-data-prototype=ExpendableNonVolatile_Ram_Core4/NeSCPR_k_CancGlStartTrack}, written-nv-data=NeSCPR_k_CancGlStartTrack_Rx.NeSCPR_k_CancGlStartTrack}
          {nv-ram-block-element=autosar-variable-in-impl-datatype={root-variable-data-prototype=ExpendableNonVolatile_RamBlock_Core4, target-data-prototype=ExpendableNonVolatile_Ram_Core4/NeSCPR_k_CancGlEndTrack}, read-nv-data=NeSCPR_k_CancGlEndTrack.NeSCPR_k_CancGlEndTrack}
          {nv-ram-block-element=autosar-variable-in-impl-datatype={root-variable-data-prototype=ExpendableNonVolatile_RamBlock_Core4, target-data-prototype=ExpendableNonVolatile_Ram_Core4/NeSCPR_k_CancGlEndTrack}, written-nv-data=NeSCPR_k_CancGlEndTrack_Rx.NeSCPR_k_CancGlEndTrack}
          {nv-ram-block-element=autosar-variable-in-impl-datatype={root-variable-data-prototype=ExpendableNonVolatile_RamBlock_Core4, target-data-prototype=ExpendableNonVolatile_Ram_Core4/NeSCPR_k_CabinTempSetPoint}, read-nv-data=NeSCPR_k_CabinTempSetPoint.NeSCPR_k_CabinTempSetPoint}
          {nv-ram-block-element=autosar-variable-in-impl-datatype={root-variable-data-prototype=ExpendableNonVolatile_RamBlock_Core4, target-data-prototype=ExpendableNonVolatile_Ram_Core4/NeSCPR_k_CabinTempSetPoint}, written-nv-data=NeSCPR_k_CabinTempSetPoint_Rx.NeSCPR_k_CabinTempSetPoint}
          {nv-ram-block-element=autosar-variable-in-impl-datatype={root-variable-data-prototype=ExpendableNonVolatile_RamBlock_Core4, target-data-prototype=ExpendableNonVolatile_Ram_Core4/NeSCPR_g_Sch2CoCH_DNRvalue}, read-nv-data=NeSCPR_g_Sch2CoCH_DNRvalue.NeSCPR_g_Sch2CoCH_DNRvalue}
          {nv-ram-block-element=autosar-variable-in-impl-datatype={root-variable-data-prototype=ExpendableNonVolatile_RamBlock_Core4, target-data-prototype=ExpendableNonVolatile_Ram_Core4/NeSCPR_g_Sch2CoCH_DNRvalue}, written-nv-data=NeSCPR_g_Sch2CoCH_DNRvalue_Rx.NeSCPR_g_Sch2CoCH_DNRvalue}
          {nv-ram-block-element=autosar-variable-in-impl-datatype={root-variable-data-prototype=ExpendableNonVolatile_RamBlock_Core4, target-data-prototype=ExpendableNonVolatile_Ram_Core4/NeSCPR_g_Sch2CP_DNRvalue}, read-nv-data=NeSCPR_g_Sch2CP_DNRvalue.NeSCPR_g_Sch2CP_DNRvalue}
          {nv-ram-block-element=autosar-variable-in-impl-datatype={root-variable-data-prototype=ExpendableNonVolatile_RamBlock_Core4, target-data-prototype=ExpendableNonVolatile_Ram_Core4/NeSCPR_g_Sch2CP_DNRvalue}, written-nv-data=NeSCPR_g_Sch2CP_DNRvalue_Rx.NeSCPR_g_Sch2CP_DNRvalue}
          {nv-ram-block-element=autosar-variable-in-impl-datatype={root-variable-data-prototype=ExpendableNonVolatile_RamBlock_Core4, target-data-prototype=ExpendableNonVolatile_Ram_Core4/NeSCPR_g_Sch1CoCH_DNRvalue}, read-nv-data=NeSCPR_g_Sch1CoCH_DNRvalue.NeSCPR_g_Sch1CoCH_DNRvalue}
          {nv-ram-block-element=autosar-variable-in-impl-datatype={root-variable-data-prototype=ExpendableNonVolatile_RamBlock_Core4, target-data-prototype=ExpendableNonVolatile_Ram_Core4/NeSCPR_g_Sch1CoCH_DNRvalue}, written-nv-data=NeSCPR_g_Sch1CoCH_DNRvalue_Rx.NeSCPR_g_Sch1CoCH_DNRvalue}
          {nv-ram-block-element=autosar-variable-in-impl-datatype={root-variable-data-prototype=ExpendableNonVolatile_RamBlock_Core4, target-data-prototype=ExpendableNonVolatile_Ram_Core4/NeSCPR_g_Sch1CP_DNRvalue}, read-nv-data=NeSCPR_g_Sch1CP_DNRvalue.NeSCPR_g_Sch1CP_DNRvalue}
          {nv-ram-block-element=autosar-variable-in-impl-datatype={root-variable-data-prototype=ExpendableNonVolatile_RamBlock_Core4, target-data-prototype=ExpendableNonVolatile_Ram_Core4/NeSCPR_g_Sch1CP_DNRvalue}, written-nv-data=NeSCPR_g_Sch1CP_DNRvalue_Rx.NeSCPR_g_Sch1CP_DNRvalue}
          {nv-ram-block-element=autosar-variable-in-impl-datatype={root-variable-data-prototype=ExpendableNonVolatile_RamBlock_Core4, target-data-prototype=ExpendableNonVolatile_Ram_Core4/NeSCPR_g_DoNotRepeatValSch2}, read-nv-data=NeSCPR_g_DoNotRepeatValSch2.NeSCPR_g_DoNotRepeatValSch2}
          {nv-ram-block-element=autosar-variable-in-impl-datatype={root-variable-data-prototype=ExpendableNonVolatile_RamBlock_Core4, target-data-prototype=ExpendableNonVolatile_Ram_Core4/NeSCPR_g_DoNotRepeatValSch2}, written-nv-data=NeSCPR_g_DoNotRepeatValSch2_Rx.NeSCPR_g_DoNotRepeatValSch2}
          {nv-ram-block-element=autosar-variable-in-impl-datatype={root-variable-data-prototype=ExpendableNonVolatile_RamBlock_Core4, target-data-prototype=ExpendableNonVolatile_Ram_Core4/NeSCPR_Pct_SOCArb}, read-nv-data=NeSCPR_Pct_SOCArb.NeSCPR_Pct_SOCArb}
          {nv-ram-block-element=autosar-variable-in-impl-datatype={root-variable-data-prototype=ExpendableNonVolatile_RamBlock_Core4, target-data-prototype=ExpendableNonVolatile_Ram_Core4/NeSCPR_Pct_SOCArb}, written-nv-data=NeSCPR_Pct_SOCArb_Rx.NeSCPR_Pct_SOCArb}
          {nv-ram-block-element=autosar-variable-in-impl-datatype={root-variable-data-prototype=ExpendableNonVolatile_RamBlock_Core4, target-data-prototype=ExpendableNonVolatile_Ram_Core4/NeSCPR_Pct_Sch1CoCH_ExtSOCtrgt}, read-nv-data=NeSCPR_Pct_Sch1CoCH_ExtSOCtrgt.NeSCPR_Pct_Sch1CoCH_ExtSOCtrgt}
          {nv-ram-block-element=autosar-variable-in-impl-datatype={root-variable-data-prototype=ExpendableNonVolatile_RamBlock_Core4, target-data-prototype=ExpendableNonVolatile_Ram_Core4/NeSCPR_Pct_Sch1CoCH_ExtSOCtrgt}, written-nv-data=NeSCPR_Pct_Sch1CoCH_ExtSOCtrgt_Rx.NeSCPR_Pct_Sch1CoCH_ExtSOCtrgt}
          {nv-ram-block-element=autosar-variable-in-impl-datatype={root-variable-data-prototype=ExpendableNonVolatile_RamBlock_Core4, target-data-prototype=ExpendableNonVolatile_Ram_Core4/NeITIR_t_TimeToResetRecentVar}, read-nv-data=NeITIR_t_TimeToResetRecentVar.NeITIR_t_TimeToResetRecentVar}
          {nv-ram-block-element=autosar-variable-in-impl-datatype={root-variable-data-prototype=ExpendableNonVolatile_RamBlock_Core4, target-data-prototype=ExpendableNonVolatile_Ram_Core4/NeITIR_t_TimeToResetRecentVar}, written-nv-data=NeITIR_t_TimeToResetRecentVar_Rx.NeITIR_t_TimeToResetRecentVar}
          {nv-ram-block-element=autosar-variable-in-impl-datatype={root-variable-data-prototype=ExpendableNonVolatile_RamBlock_Core4, target-data-prototype=ExpendableNonVolatile_Ram_Core4/NeITIR_E_MtrATotalTractionEnergy_Lifetime}, read-nv-data=NeITIR_E_MtrATotalTractionEnergy_Lifetime.NeITIR_E_MtrATotalTractionEnergy_Lifetime}
          {nv-ram-block-element=autosar-variable-in-impl-datatype={root-variable-data-prototype=ExpendableNonVolatile_RamBlock_Core4, target-data-prototype=ExpendableNonVolatile_Ram_Core4/NeITIR_E_MtrATotalTractionEnergy_Lifetime}, written-nv-data=NeITIR_E_MtrATotalTractionEnergy_Lifetime_Rx.NeITIR_E_MtrATotalTractionEnergy_Lifetime}
          {nv-ram-block-element=autosar-variable-in-impl-datatype={root-variable-data-prototype=ExpendableNonVolatile_RamBlock_Core4, target-data-prototype=ExpendableNonVolatile_Ram_Core4/NeITIR_E_MtrATotalTractionEnergy_Recent}, read-nv-data=NeITIR_E_MtrATotalTractionEnergy_Recent.NeITIR_E_MtrATotalTractionEnergy_Recent}
          {nv-ram-block-element=autosar-variable-in-impl-datatype={root-variable-data-prototype=ExpendableNonVolatile_RamBlock_Core4, target-data-prototype=ExpendableNonVolatile_Ram_Core4/NeITIR_E_MtrATotalTractionEnergy_Recent}, written-nv-data=NeITIR_E_MtrATotalTractionEnergy_Recent_Rx.NeITIR_E_MtrATotalTractionEnergy_Recent}
          {nv-ram-block-element=autosar-variable-in-impl-datatype={root-variable-data-prototype=ExpendableNonVolatile_RamBlock_Core4, target-data-prototype=ExpendableNonVolatile_Ram_Core4/NeITIR_E_MtrBTotalTractionEnergy_Lifetime}, read-nv-data=NeITIR_E_MtrBTotalTractionEnergy_Lifetime.NeITIR_E_MtrBTotalTractionEnergy_Lifetime}
          {nv-ram-block-element=autosar-variable-in-impl-datatype={root-variable-data-prototype=ExpendableNonVolatile_RamBlock_Core4, target-data-prototype=ExpendableNonVolatile_Ram_Core4/NeITIR_E_MtrBTotalTractionEnergy_Lifetime}, written-nv-data=NeITIR_E_MtrBTotalTractionEnergy_Lifetime_Rx.NeITIR_E_MtrBTotalTractionEnergy_Lifetime}
          {nv-ram-block-element=autosar-variable-in-impl-datatype={root-variable-data-prototype=ExpendableNonVolatile_RamBlock_Core4, target-data-prototype=ExpendableNonVolatile_Ram_Core4/NeITIR_E_MtrBTotalTractionEnergy_Recent}, read-nv-data=NeITIR_E_MtrBTotalTractionEnergy_Recent.NeITIR_E_MtrBTotalTractionEnergy_Recent}
          {nv-ram-block-element=autosar-variable-in-impl-datatype={root-variable-data-prototype=ExpendableNonVolatile_RamBlock_Core4, target-data-prototype=ExpendableNonVolatile_Ram_Core4/NeITIR_E_MtrBTotalTractionEnergy_Recent}, written-nv-data=NeITIR_E_MtrBTotalTractionEnergy_Recent_Rx.NeITIR_E_MtrBTotalTractionEnergy_Recent}
          {nv-ram-block-element=autosar-variable-in-impl-datatype={root-variable-data-prototype=ExpendableNonVolatile_RamBlock_Core4, target-data-prototype=ExpendableNonVolatile_Ram_Core4/NeITIR_E_NonGrdEnrgy_Lifetime}, read-nv-data=NeITIR_E_NonGrdEnrgy_Lifetime.NeITIR_E_NonGrdEnrgy_Lifetime}
          {nv-ram-block-element=autosar-variable-in-impl-datatype={root-variable-data-prototype=ExpendableNonVolatile_RamBlock_Core4, target-data-prototype=ExpendableNonVolatile_Ram_Core4/NeITIR_E_NonGrdEnrgy_Lifetime}, written-nv-data=NeITIR_E_NonGrdEnrgy_Lifetime_Rx.NeITIR_E_NonGrdEnrgy_Lifetime}
          {nv-ram-block-element=autosar-variable-in-impl-datatype={root-variable-data-prototype=ExpendableNonVolatile_RamBlock_Core4, target-data-prototype=ExpendableNonVolatile_Ram_Core4/NeITIR_E_NonGrdEnrgy_Recent}, read-nv-data=NeITIR_E_NonGrdEnrgy_Recent.NeITIR_E_NonGrdEnrgy_Recent}
          {nv-ram-block-element=autosar-variable-in-impl-datatype={root-variable-data-prototype=ExpendableNonVolatile_RamBlock_Core4, target-data-prototype=ExpendableNonVolatile_Ram_Core4/NeITIR_E_NonGrdEnrgy_Recent}, written-nv-data=NeITIR_E_NonGrdEnrgy_Recent_Rx.NeITIR_E_NonGrdEnrgy_Recent}
          {nv-ram-block-element=autosar-variable-in-impl-datatype={root-variable-data-prototype=ExpendableNonVolatile_RamBlock_Core4, target-data-prototype=ExpendableNonVolatile_Ram_Core4/NeITIR_l_DistTravelChrgDepEngOff_Lifetime}, read-nv-data=NeITIR_l_DistTravelChrgDepEngOff_Lifetime.NeITIR_l_DistTravelChrgDepEngOff_Lifetime}
          {nv-ram-block-element=autosar-variable-in-impl-datatype={root-variable-data-prototype=ExpendableNonVolatile_RamBlock_Core4, target-data-prototype=ExpendableNonVolatile_Ram_Core4/NeITIR_l_DistTravelChrgDepEngOff_Lifetime}, written-nv-data=NeITIR_l_DistTravelChrgDepEngOff_Lifetime_Rx.NeITIR_l_DistTravelChrgDepEngOff_Lifetime}
          {nv-ram-block-element=autosar-variable-in-impl-datatype={root-variable-data-prototype=ExpendableNonVolatile_RamBlock_Core4, target-data-prototype=ExpendableNonVolatile_Ram_Core4/NeITIR_l_DistTravelChrgDepEngOff_Recent}, read-nv-data=NeITIR_l_DistTravelChrgDepEngOff_Recent.NeITIR_l_DistTravelChrgDepEngOff_Recent}
          {nv-ram-block-element=autosar-variable-in-impl-datatype={root-variable-data-prototype=ExpendableNonVolatile_RamBlock_Core4, target-data-prototype=ExpendableNonVolatile_Ram_Core4/NeITIR_l_DistTravelChrgDepEngOff_Recent}, written-nv-data=NeITIR_l_DistTravelChrgDepEngOff_Recent_Rx.NeITIR_l_DistTravelChrgDepEngOff_Recent}
          {nv-ram-block-element=autosar-variable-in-impl-datatype={root-variable-data-prototype=ExpendableNonVolatile_RamBlock_Core4, target-data-prototype=ExpendableNonVolatile_Ram_Core4/NeITIR_l_DistTravelChrgDepEngOn_Lifetime}, read-nv-data=NeITIR_l_DistTravelChrgDepEngOn_Lifetime.NeITIR_l_DistTravelChrgDepEngOn_Lifetime}
          {nv-ram-block-element=autosar-variable-in-impl-datatype={root-variable-data-prototype=ExpendableNonVolatile_RamBlock_Core4, target-data-prototype=ExpendableNonVolatile_Ram_Core4/NeITIR_l_DistTravelChrgDepEngOn_Lifetime}, written-nv-data=NeITIR_l_DistTravelChrgDepEngOn_Lifetime_Rx.NeITIR_l_DistTravelChrgDepEngOn_Lifetime}
          {nv-ram-block-element=autosar-variable-in-impl-datatype={root-variable-data-prototype=ExpendableNonVolatile_RamBlock_Core4, target-data-prototype=ExpendableNonVolatile_Ram_Core4/NeITIR_l_DistTravelChrgDepEngOn_Recent}, read-nv-data=NeITIR_l_DistTravelChrgDepEngOn_Recent.NeITIR_l_DistTravelChrgDepEngOn_Recent}
          {nv-ram-block-element=autosar-variable-in-impl-datatype={root-variable-data-prototype=ExpendableNonVolatile_RamBlock_Core4, target-data-prototype=ExpendableNonVolatile_Ram_Core4/NeITIR_l_DistTravelChrgDepEngOn_Recent}, written-nv-data=NeITIR_l_DistTravelChrgDepEngOn_Recent_Rx.NeITIR_l_DistTravelChrgDepEngOn_Recent}
          {nv-ram-block-element=autosar-variable-in-impl-datatype={root-variable-data-prototype=ExpendableNonVolatile_RamBlock_Core4, target-data-prototype=ExpendableNonVolatile_Ram_Core4/NeITIR_l_DistTravelChrgIncrease_Recent}, read-nv-data=NeITIR_l_DistTravelChrgIncrease_Recent.NeITIR_l_DistTravelChrgIncrease_Recent}
          {nv-ram-block-element=autosar-variable-in-impl-datatype={root-variable-data-prototype=ExpendableNonVolatile_RamBlock_Core4, target-data-prototype=ExpendableNonVolatile_Ram_Core4/NeITIR_l_DistTravelChrgIncrease_Recent}, written-nv-data=NeITIR_l_DistTravelChrgIncrease_Recent_Rx.NeITIR_l_DistTravelChrgIncrease_Recent}
          {nv-ram-block-element=autosar-variable-in-impl-datatype={root-variable-data-prototype=ExpendableNonVolatile_RamBlock_Core4, target-data-prototype=ExpendableNonVolatile_Ram_Core4/NeITIR_l_DistTrvlChrgIncrease_Lifetime}, read-nv-data=NeITIR_l_DistTrvlChrgIncrease_Lifetime.NeITIR_l_DistTrvlChrgIncrease_Lifetime}
          {nv-ram-block-element=autosar-variable-in-impl-datatype={root-variable-data-prototype=ExpendableNonVolatile_RamBlock_Core4, target-data-prototype=ExpendableNonVolatile_Ram_Core4/NeITIR_l_DistTrvlChrgIncrease_Lifetime}, written-nv-data=NeITIR_l_DistTrvlChrgIncrease_Lifetime_Rx.NeITIR_l_DistTrvlChrgIncrease_Lifetime}
          {nv-ram-block-element=autosar-variable-in-impl-datatype={root-variable-data-prototype=ExpendableNonVolatile_RamBlock_Core4, target-data-prototype=ExpendableNonVolatile_Ram_Core4/NeITIR_l_TotalDistTravelled_Lifetime}, read-nv-data=NeITIR_l_TotalDistTravelled_Lifetime.NeITIR_l_TotalDistTravelled_Lifetime}
          {nv-ram-block-element=autosar-variable-in-impl-datatype={root-variable-data-prototype=ExpendableNonVolatile_RamBlock_Core4, target-data-prototype=ExpendableNonVolatile_Ram_Core4/NeITIR_l_TotalDistTravelled_Lifetime}, written-nv-data=NeITIR_l_TotalDistTravelled_Lifetime_Rx.NeITIR_l_TotalDistTravelled_Lifetime}
          {nv-ram-block-element=autosar-variable-in-impl-datatype={root-variable-data-prototype=ExpendableNonVolatile_RamBlock_Core4, target-data-prototype=ExpendableNonVolatile_Ram_Core4/NeITIR_l_TotalDistTravelled_Recent}, read-nv-data=NeITIR_l_TotalDistTravelled_Recent.NeITIR_l_TotalDistTravelled_Recent}
          {nv-ram-block-element=autosar-variable-in-impl-datatype={root-variable-data-prototype=ExpendableNonVolatile_RamBlock_Core4, target-data-prototype=ExpendableNonVolatile_Ram_Core4/NeITIR_l_TotalDistTravelled_Recent}, written-nv-data=NeITIR_l_TotalDistTravelled_Recent_Rx.NeITIR_l_TotalDistTravelled_Recent}
          {nv-ram-block-element=autosar-variable-in-impl-datatype={root-variable-data-prototype=ExpendableNonVolatile_RamBlock_Core4, target-data-prototype=ExpendableNonVolatile_Ram_Core4/NeITIR_E_GrdEnrgyIntoBatt_Lifetime}, read-nv-data=NeITIR_E_GrdEnrgyIntoBatt_Lifetime.NeITIR_E_GrdEnrgyIntoBatt_Lifetime}
          {nv-ram-block-element=autosar-variable-in-impl-datatype={root-variable-data-prototype=ExpendableNonVolatile_RamBlock_Core4, target-data-prototype=ExpendableNonVolatile_Ram_Core4/NeITIR_E_GrdEnrgyIntoBatt_Lifetime}, written-nv-data=NeITIR_E_GrdEnrgyIntoBatt_Lifetime_Rx.NeITIR_E_GrdEnrgyIntoBatt_Lifetime}
          {nv-ram-block-element=autosar-variable-in-impl-datatype={root-variable-data-prototype=ExpendableNonVolatile_RamBlock_Core4, target-data-prototype=ExpendableNonVolatile_Ram_Core4/NeITIR_E_GrdEnrgyIntoBatt_Recent}, read-nv-data=NeITIR_E_GrdEnrgyIntoBatt_Recent.NeITIR_E_GrdEnrgyIntoBatt_Recent}
          {nv-ram-block-element=autosar-variable-in-impl-datatype={root-variable-data-prototype=ExpendableNonVolatile_RamBlock_Core4, target-data-prototype=ExpendableNonVolatile_Ram_Core4/NeITIR_E_GrdEnrgyIntoBatt_Recent}, written-nv-data=NeITIR_E_GrdEnrgyIntoBatt_Recent_Rx.NeITIR_E_GrdEnrgyIntoBatt_Recent}
          {nv-ram-block-element=autosar-variable-in-impl-datatype={root-variable-data-prototype=ExpendableNonVolatile_RamBlock_Core4, target-data-prototype=ExpendableNonVolatile_Ram_Core4/NeITIR_E_GrdEnrgyChrgDepEngOn_Recent}, read-nv-data=NeITIR_E_GrdEnrgyChrgDepEngOn_Recent.NeITIR_E_GrdEnrgyChrgDepEngOn_Recent}
          {nv-ram-block-element=autosar-variable-in-impl-datatype={root-variable-data-prototype=ExpendableNonVolatile_RamBlock_Core4, target-data-prototype=ExpendableNonVolatile_Ram_Core4/NeITIR_E_GrdEnrgyChrgDepEngOn_Recent}, written-nv-data=NeITIR_E_GrdEnrgyChrgDepEngOn_Recent_Rx.NeITIR_E_GrdEnrgyChrgDepEngOn_Recent}
          {nv-ram-block-element=autosar-variable-in-impl-datatype={root-variable-data-prototype=ExpendableNonVolatile_RamBlock_Core4, target-data-prototype=ExpendableNonVolatile_Ram_Core4/NeCSVR_l_DistSinceCodeClr}, read-nv-data=NeCSVR_l_DistSinceCodeClr.NeCSVR_l_DistSinceCodeClr}
          {nv-ram-block-element=autosar-variable-in-impl-datatype={root-variable-data-prototype=ExpendableNonVolatile_RamBlock_Core4, target-data-prototype=ExpendableNonVolatile_Ram_Core4/NeCSVR_l_DistSinceCodeClr}, written-nv-data=NeCSVR_l_DistSinceCodeClr_Rx.NeCSVR_l_DistSinceCodeClr}
          {nv-ram-block-element=autosar-variable-in-impl-datatype={root-variable-data-prototype=ExpendableNonVolatile_RamBlock_Core4, target-data-prototype=ExpendableNonVolatile_Ram_Core4/NeITIR_Cnt_FuelConsChrgDep_Lifetime}, read-nv-data=NeITIR_Cnt_FuelConsChrgDep_Lifetime.NeITIR_Cnt_FuelConsChrgDep_Lifetime}
          {nv-ram-block-element=autosar-variable-in-impl-datatype={root-variable-data-prototype=ExpendableNonVolatile_RamBlock_Core4, target-data-prototype=ExpendableNonVolatile_Ram_Core4/NeITIR_Cnt_FuelConsChrgDep_Lifetime}, written-nv-data=NeITIR_Cnt_FuelConsChrgDep_Lifetime_Rx.NeITIR_Cnt_FuelConsChrgDep_Lifetime}
          {nv-ram-block-element=autosar-variable-in-impl-datatype={root-variable-data-prototype=ExpendableNonVolatile_RamBlock_Core4, target-data-prototype=ExpendableNonVolatile_Ram_Core4/NeRTMR_t_BattChrgTimer_PID}, read-nv-data=NeRTMR_t_BattChrgTimer_PID.NeRTMR_t_BattChrgTimer_PID}
          {nv-ram-block-element=autosar-variable-in-impl-datatype={root-variable-data-prototype=ExpendableNonVolatile_RamBlock_Core4, target-data-prototype=ExpendableNonVolatile_Ram_Core4/NeRTMR_t_BattChrgTimer_PID}, written-nv-data=NeRTMR_t_BattChrgTimer_PID_Rx.NeRTMR_t_BattChrgTimer_PID}
          {nv-ram-block-element=autosar-variable-in-impl-datatype={root-variable-data-prototype=ExpendableNonVolatile_RamBlock_Core4, target-data-prototype=ExpendableNonVolatile_Ram_Core4/NeRTMR_P_BattChrgPwrOffset_PID}, read-nv-data=NeRTMR_P_BattChrgPwrOffset_PID.NeRTMR_P_BattChrgPwrOffset_PID}
          {nv-ram-block-element=autosar-variable-in-impl-datatype={root-variable-data-prototype=ExpendableNonVolatile_RamBlock_Core4, target-data-prototype=ExpendableNonVolatile_Ram_Core4/NeRTMR_P_BattChrgPwrOffset_PID}, written-nv-data=NeRTMR_P_BattChrgPwrOffset_PID_Rx.NeRTMR_P_BattChrgPwrOffset_PID}
          {nv-ram-block-element=autosar-variable-in-impl-datatype={root-variable-data-prototype=ExpendableNonVolatile_RamBlock_Core4, target-data-prototype=ExpendableNonVolatile_Ram_Core4/NeRTMR_It_BattChrgTarget_PID}, read-nv-data=NeRTMR_It_BattChrgTarget_PID.NeRTMR_It_BattChrgTarget_PID}
          {nv-ram-block-element=autosar-variable-in-impl-datatype={root-variable-data-prototype=ExpendableNonVolatile_RamBlock_Core4, target-data-prototype=ExpendableNonVolatile_Ram_Core4/NeRTMR_It_BattChrgTarget_PID}, written-nv-data=NeRTMR_It_BattChrgTarget_PID_Rx.NeRTMR_It_BattChrgTarget_PID}
          {nv-ram-block-element=autosar-variable-in-impl-datatype={root-variable-data-prototype=ExpendableNonVolatile_RamBlock_Core4, target-data-prototype=ExpendableNonVolatile_Ram_Core4/NeRTMR_It_BattChrgInitDiff_PID}, read-nv-data=NeRTMR_It_BattChrgInitDiff_PID.NeRTMR_It_BattChrgInitDiff_PID}
          {nv-ram-block-element=autosar-variable-in-impl-datatype={root-variable-data-prototype=ExpendableNonVolatile_RamBlock_Core4, target-data-prototype=ExpendableNonVolatile_Ram_Core4/NeRTMR_It_BattChrgInitDiff_PID}, written-nv-data=NeRTMR_It_BattChrgInitDiff_PID_Rx.NeRTMR_It_BattChrgInitDiff_PID}
          {nv-ram-block-element=autosar-variable-in-impl-datatype={root-variable-data-prototype=ExpendableNonVolatile_RamBlock_Core4, target-data-prototype=ExpendableNonVolatile_Ram_Core4/NeRTMR_It_BattChargedAmnt_PID}, read-nv-data=NeRTMR_It_BattChargedAmnt_PID.NeRTMR_It_BattChargedAmnt_PID}
          {nv-ram-block-element=autosar-variable-in-impl-datatype={root-variable-data-prototype=ExpendableNonVolatile_RamBlock_Core4, target-data-prototype=ExpendableNonVolatile_Ram_Core4/NeRTMR_It_BattChargedAmnt_PID}, written-nv-data=NeRTMR_It_BattChargedAmnt_PID_Rx.NeRTMR_It_BattChargedAmnt_PID}
          {nv-ram-block-element=autosar-variable-in-impl-datatype={root-variable-data-prototype=ExpendableNonVolatile_RamBlock_Core4, target-data-prototype=ExpendableNonVolatile_Ram_Core4/NeITIR_Cnt_FuelConsChrgDep_Recent}, read-nv-data=NeITIR_Cnt_FuelConsChrgDep_Recent.NeITIR_Cnt_FuelConsChrgDep_Recent}
          {nv-ram-block-element=autosar-variable-in-impl-datatype={root-variable-data-prototype=ExpendableNonVolatile_RamBlock_Core4, target-data-prototype=ExpendableNonVolatile_Ram_Core4/NeITIR_Cnt_FuelConsChrgDep_Recent}, written-nv-data=NeITIR_Cnt_FuelConsChrgDep_Recent_Rx.NeITIR_Cnt_FuelConsChrgDep_Recent}
          {nv-ram-block-element=autosar-variable-in-impl-datatype={root-variable-data-prototype=ExpendableNonVolatile_RamBlock_Core4, target-data-prototype=ExpendableNonVolatile_Ram_Core4/NeITIR_E_GrdEnrgyChrgDepEngOn_Lifetime}, read-nv-data=NeITIR_E_GrdEnrgyChrgDepEngOn_Lifetime.NeITIR_E_GrdEnrgyChrgDepEngOn_Lifetime}
          {nv-ram-block-element=autosar-variable-in-impl-datatype={root-variable-data-prototype=ExpendableNonVolatile_RamBlock_Core4, target-data-prototype=ExpendableNonVolatile_Ram_Core4/NeITIR_E_GrdEnrgyChrgDepEngOn_Lifetime}, written-nv-data=NeITIR_E_GrdEnrgyChrgDepEngOn_Lifetime_Rx.NeITIR_E_GrdEnrgyChrgDepEngOn_Lifetime}
          {nv-ram-block-element=autosar-variable-in-impl-datatype={root-variable-data-prototype=ExpendableNonVolatile_RamBlock_Core4, target-data-prototype=ExpendableNonVolatile_Ram_Core4/NeITIR_Cnt_FuelConsChrgIncrease_Lifetime}, read-nv-data=NeITIR_Cnt_FuelConsChrgIncrease_Lifetime.NeITIR_Cnt_FuelConsChrgIncrease_Lifetime}
          {nv-ram-block-element=autosar-variable-in-impl-datatype={root-variable-data-prototype=ExpendableNonVolatile_RamBlock_Core4, target-data-prototype=ExpendableNonVolatile_Ram_Core4/NeITIR_Cnt_FuelConsChrgIncrease_Lifetime}, written-nv-data=NeITIR_Cnt_FuelConsChrgIncrease_Lifetime_Rx.NeITIR_Cnt_FuelConsChrgIncrease_Lifetime}
          {nv-ram-block-element=autosar-variable-in-impl-datatype={root-variable-data-prototype=ExpendableNonVolatile_RamBlock_Core4, target-data-prototype=ExpendableNonVolatile_Ram_Core4/NeITIR_Cnt_FuelConsChrgIncrease_Recent}, read-nv-data=NeITIR_Cnt_FuelConsChrgIncrease_Recent.NeITIR_Cnt_FuelConsChrgIncrease_Recent}
          {nv-ram-block-element=autosar-variable-in-impl-datatype={root-variable-data-prototype=ExpendableNonVolatile_RamBlock_Core4, target-data-prototype=ExpendableNonVolatile_Ram_Core4/NeITIR_Cnt_FuelConsChrgIncrease_Recent}, written-nv-data=NeITIR_Cnt_FuelConsChrgIncrease_Recent_Rx.NeITIR_Cnt_FuelConsChrgIncrease_Recent}
          {nv-ram-block-element=autosar-variable-in-impl-datatype={root-variable-data-prototype=ExpendableNonVolatile_RamBlock_Core4, target-data-prototype=ExpendableNonVolatile_Ram_Core4/NeITIR_Cnt_FuelEngIgnCycl_Lifetime}, read-nv-data=NeITIR_Cnt_FuelEngIgnCycl_Lifetime.NeITIR_Cnt_FuelEngIgnCycl_Lifetime}
          {nv-ram-block-element=autosar-variable-in-impl-datatype={root-variable-data-prototype=ExpendableNonVolatile_RamBlock_Core4, target-data-prototype=ExpendableNonVolatile_Ram_Core4/NeITIR_Cnt_FuelEngIgnCycl_Lifetime}, written-nv-data=NeITIR_Cnt_FuelEngIgnCycl_Lifetime_Rx.NeITIR_Cnt_FuelEngIgnCycl_Lifetime}
          {nv-ram-block-element=autosar-variable-in-impl-datatype={root-variable-data-prototype=ExpendableNonVolatile_RamBlock_Core4, target-data-prototype=ExpendableNonVolatile_Ram_Core4/NeITIR_Cnt_FuelEngIgnCycl_Recent}, read-nv-data=NeITIR_Cnt_FuelEngIgnCycl_Recent.NeITIR_Cnt_FuelEngIgnCycl_Recent}
          {nv-ram-block-element=autosar-variable-in-impl-datatype={root-variable-data-prototype=ExpendableNonVolatile_RamBlock_Core4, target-data-prototype=ExpendableNonVolatile_Ram_Core4/NeITIR_Cnt_FuelEngIgnCycl_Recent}, written-nv-data=NeITIR_Cnt_FuelEngIgnCycl_Recent_Rx.NeITIR_Cnt_FuelEngIgnCycl_Recent}
          {nv-ram-block-element=autosar-variable-in-impl-datatype={root-variable-data-prototype=ExpendableNonVolatile_RamBlock_Core4, target-data-prototype=ExpendableNonVolatile_Ram_Core4/NeITIR_Cnt_IgnCycl_Lifetime}, read-nv-data=NeITIR_Cnt_IgnCycl_Lifetime.NeITIR_Cnt_IgnCycl_Lifetime}
          {nv-ram-block-element=autosar-variable-in-impl-datatype={root-variable-data-prototype=ExpendableNonVolatile_RamBlock_Core4, target-data-prototype=ExpendableNonVolatile_Ram_Core4/NeITIR_Cnt_IgnCycl_Lifetime}, written-nv-data=NeITIR_Cnt_IgnCycl_Lifetime_Rx.NeITIR_Cnt_IgnCycl_Lifetime}
          {nv-ram-block-element=autosar-variable-in-impl-datatype={root-variable-data-prototype=ExpendableNonVolatile_RamBlock_Core4, target-data-prototype=ExpendableNonVolatile_Ram_Core4/NeITIR_Cnt_IgnCycl_Recent}, read-nv-data=NeITIR_Cnt_IgnCycl_Recent.NeITIR_Cnt_IgnCycl_Recent}
          {nv-ram-block-element=autosar-variable-in-impl-datatype={root-variable-data-prototype=ExpendableNonVolatile_RamBlock_Core4, target-data-prototype=ExpendableNonVolatile_Ram_Core4/NeITIR_Cnt_IgnCycl_Recent}, written-nv-data=NeITIR_Cnt_IgnCycl_Recent_Rx.NeITIR_Cnt_IgnCycl_Recent}
          {nv-ram-block-element=autosar-variable-in-impl-datatype={root-variable-data-prototype=ExpendableNonVolatile_RamBlock_Core4, target-data-prototype=ExpendableNonVolatile_Ram_Core4/NeITIR_Cnt_Total_City_PSA_Time_Lifetime}, read-nv-data=NeITIR_Cnt_Total_City_PSA_Time_Lifetime.NeITIR_Cnt_Total_City_PSA_Time_Lifetime}
          {nv-ram-block-element=autosar-variable-in-impl-datatype={root-variable-data-prototype=ExpendableNonVolatile_RamBlock_Core4, target-data-prototype=ExpendableNonVolatile_Ram_Core4/NeITIR_Cnt_Total_City_PSA_Time_Lifetime}, written-nv-data=NeITIR_Cnt_Total_City_PSA_Time_Lifetime_Rx.NeITIR_Cnt_Total_City_PSA_Time_Lifetime}
          {nv-ram-block-element=autosar-variable-in-impl-datatype={root-variable-data-prototype=ExpendableNonVolatile_RamBlock_Core4, target-data-prototype=ExpendableNonVolatile_Ram_Core4/NeITIR_Cnt_Total_City_PSA_Time_Recent}, read-nv-data=NeITIR_Cnt_Total_City_PSA_Time_Recent.NeITIR_Cnt_Total_City_PSA_Time_Recent}
          {nv-ram-block-element=autosar-variable-in-impl-datatype={root-variable-data-prototype=ExpendableNonVolatile_RamBlock_Core4, target-data-prototype=ExpendableNonVolatile_Ram_Core4/NeITIR_Cnt_Total_City_PSA_Time_Recent}, written-nv-data=NeITIR_Cnt_Total_City_PSA_Time_Recent_Rx.NeITIR_Cnt_Total_City_PSA_Time_Recent}
          {nv-ram-block-element=autosar-variable-in-impl-datatype={root-variable-data-prototype=ExpendableNonVolatile_RamBlock_Core4, target-data-prototype=ExpendableNonVolatile_Ram_Core4/NeITIR_Cnt_Total_Idle_PSA_Time_Lifetime}, read-nv-data=NeITIR_Cnt_Total_Idle_PSA_Time_Lifetime.NeITIR_Cnt_Total_Idle_PSA_Time_Lifetime}
          {nv-ram-block-element=autosar-variable-in-impl-datatype={root-variable-data-prototype=ExpendableNonVolatile_RamBlock_Core4, target-data-prototype=ExpendableNonVolatile_Ram_Core4/NeITIR_Cnt_Total_Idle_PSA_Time_Lifetime}, written-nv-data=NeITIR_Cnt_Total_Idle_PSA_Time_Lifetime_Rx.NeITIR_Cnt_Total_Idle_PSA_Time_Lifetime}
          {nv-ram-block-element=autosar-variable-in-impl-datatype={root-variable-data-prototype=ExpendableNonVolatile_RamBlock_Core4, target-data-prototype=ExpendableNonVolatile_Ram_Core4/NeITIR_Cnt_Total_Idle_PSA_Time_Recent}, read-nv-data=NeITIR_Cnt_Total_Idle_PSA_Time_Recent.NeITIR_Cnt_Total_Idle_PSA_Time_Recent}
          {nv-ram-block-element=autosar-variable-in-impl-datatype={root-variable-data-prototype=ExpendableNonVolatile_RamBlock_Core4, target-data-prototype=ExpendableNonVolatile_Ram_Core4/NeITIR_Cnt_Total_Idle_PSA_Time_Recent}, written-nv-data=NeITIR_Cnt_Total_Idle_PSA_Time_Recent_Rx.NeITIR_Cnt_Total_Idle_PSA_Time_Recent}
          {nv-ram-block-element=autosar-variable-in-impl-datatype={root-variable-data-prototype=ExpendableNonVolatile_RamBlock_Core4, target-data-prototype=ExpendableNonVolatile_Ram_Core4/NeITIR_Cnt_Total_PSA_Time_Lifetime}, read-nv-data=NeITIR_Cnt_Total_PSA_Time_Lifetime.NeITIR_Cnt_Total_PSA_Time_Lifetime}
          {nv-ram-block-element=autosar-variable-in-impl-datatype={root-variable-data-prototype=ExpendableNonVolatile_RamBlock_Core4, target-data-prototype=ExpendableNonVolatile_Ram_Core4/NeITIR_Cnt_Total_PSA_Time_Lifetime}, written-nv-data=NeITIR_Cnt_Total_PSA_Time_Lifetime_Rx.NeITIR_Cnt_Total_PSA_Time_Lifetime}
          {nv-ram-block-element=autosar-variable-in-impl-datatype={root-variable-data-prototype=ExpendableNonVolatile_RamBlock_Core4, target-data-prototype=ExpendableNonVolatile_Ram_Core4/NeITIR_Cnt_Total_PSA_Time_Recent}, read-nv-data=NeITIR_Cnt_Total_PSA_Time_Recent.NeITIR_Cnt_Total_PSA_Time_Recent}
          {nv-ram-block-element=autosar-variable-in-impl-datatype={root-variable-data-prototype=ExpendableNonVolatile_RamBlock_Core4, target-data-prototype=ExpendableNonVolatile_Ram_Core4/NeITIR_Cnt_Total_PSA_Time_Recent}, written-nv-data=NeITIR_Cnt_Total_PSA_Time_Recent_Rx.NeITIR_Cnt_Total_PSA_Time_Recent}
          {nv-ram-block-element=autosar-variable-in-impl-datatype={root-variable-data-prototype=ExpendableNonVolatile_RamBlock_Core4, target-data-prototype=ExpendableNonVolatile_Ram_Core4/NeITIR_E_GrdEnrgyChrgDepEngOff_Lifetime}, read-nv-data=NeITIR_E_GrdEnrgyChrgDepEngOff_Lifetime.NeITIR_E_GrdEnrgyChrgDepEngOff_Lifetime}
          {nv-ram-block-element=autosar-variable-in-impl-datatype={root-variable-data-prototype=ExpendableNonVolatile_RamBlock_Core4, target-data-prototype=ExpendableNonVolatile_Ram_Core4/NeITIR_E_GrdEnrgyChrgDepEngOff_Lifetime}, written-nv-data=NeITIR_E_GrdEnrgyChrgDepEngOff_Lifetime_Rx.NeITIR_E_GrdEnrgyChrgDepEngOff_Lifetime}
          {nv-ram-block-element=autosar-variable-in-impl-datatype={root-variable-data-prototype=ExpendableNonVolatile_RamBlock_Core4, target-data-prototype=ExpendableNonVolatile_Ram_Core4/NeITIR_E_GrdEnrgyChrgDepEngOff_Recent}, read-nv-data=NeITIR_E_GrdEnrgyChrgDepEngOff_Recent.NeITIR_E_GrdEnrgyChrgDepEngOff_Recent}
          {nv-ram-block-element=autosar-variable-in-impl-datatype={root-variable-data-prototype=ExpendableNonVolatile_RamBlock_Core4, target-data-prototype=ExpendableNonVolatile_Ram_Core4/NeITIR_E_GrdEnrgyChrgDepEngOff_Recent}, written-nv-data=NeITIR_E_GrdEnrgyChrgDepEngOff_Recent_Rx.NeITIR_E_GrdEnrgyChrgDepEngOff_Recent}
          {nv-ram-block-element=autosar-variable-in-impl-datatype={root-variable-data-prototype=ExpendableNonVolatile_RamBlock_Core4, target-data-prototype=ExpendableNonVolatile_Ram_Core4/NeCSVR_l_DistTravelMIL_On}, read-nv-data=NeCSVR_l_DistTravelMIL_On.NeCSVR_l_DistTravelMIL_On}
          {nv-ram-block-element=autosar-variable-in-impl-datatype={root-variable-data-prototype=ExpendableNonVolatile_RamBlock_Core4, target-data-prototype=ExpendableNonVolatile_Ram_Core4/NeCSVR_l_DistTravelMIL_On}, written-nv-data=NeCSVR_l_DistTravelMIL_On_Rx.NeCSVR_l_DistTravelMIL_On}
          {nv-ram-block-element=autosar-variable-in-impl-datatype={root-variable-data-prototype=ExpendableNonVolatile_RamBlock_Core4, target-data-prototype=ExpendableNonVolatile_Ram_Core4/NeBPCR_T_BatModTmp}, read-nv-data=NeBPCR_T_BatModTmp.NeBPCR_T_BatModTmp}
          {nv-ram-block-element=autosar-variable-in-impl-datatype={root-variable-data-prototype=ExpendableNonVolatile_RamBlock_Core4, target-data-prototype=ExpendableNonVolatile_Ram_Core4/NeBPCR_T_BatModTmp}, written-nv-data=NeBPCR_T_BatModTmp_Rx.NeBPCR_T_BatModTmp}
          {nv-ram-block-element=autosar-variable-in-impl-datatype={root-variable-data-prototype=ExpendableNonVolatile_RamBlock_Core4, target-data-prototype=ExpendableNonVolatile_Ram_Core4/NeTPCR_Pct_WupSOC}, read-nv-data=NeTPCR_Pct_WupSOC.NeTPCR_Pct_WupSOC}
          {nv-ram-block-element=autosar-variable-in-impl-datatype={root-variable-data-prototype=ExpendableNonVolatile_RamBlock_Core4, target-data-prototype=ExpendableNonVolatile_Ram_Core4/NeTPCR_Pct_WupSOC}, written-nv-data=NeTPCR_Pct_WupSOC_Rx.NeTPCR_Pct_WupSOC}
          {nv-ram-block-element=autosar-variable-in-impl-datatype={root-variable-data-prototype=ExpendableNonVolatile_RamBlock_Core4, target-data-prototype=ExpendableNonVolatile_Ram_Core4/NeCCCR_P_PLSMaxPower}, read-nv-data=NeCCCR_P_PLSMaxPower.NeCCCR_P_PLSMaxPower}
          {nv-ram-block-element=autosar-variable-in-impl-datatype={root-variable-data-prototype=ExpendableNonVolatile_RamBlock_Core4, target-data-prototype=ExpendableNonVolatile_Ram_Core4/NeCCCR_P_PLSMaxPower}, written-nv-data=NeCCCR_P_PLSMaxPower_Rx.NeCCCR_P_PLSMaxPower}
          {nv-ram-block-element=autosar-variable-in-impl-datatype={root-variable-data-prototype=ExpendableNonVolatile_RamBlock_Core4, target-data-prototype=ExpendableNonVolatile_Ram_Core4/NeCCCR_T_AmbTemp_CntrlrOff}, read-nv-data=NeCCCR_T_AmbTemp_CntrlrOff.NeCCCR_T_AmbTemp_CntrlrOff}
          {nv-ram-block-element=autosar-variable-in-impl-datatype={root-variable-data-prototype=ExpendableNonVolatile_RamBlock_Core4, target-data-prototype=ExpendableNonVolatile_Ram_Core4/NeCCCR_T_AmbTemp_CntrlrOff}, written-nv-data=NeCCCR_T_AmbTemp_CntrlrOff_Rx.NeCCCR_T_AmbTemp_CntrlrOff}
          {nv-ram-block-element=autosar-variable-in-impl-datatype={root-variable-data-prototype=ExpendableNonVolatile_RamBlock_Core4, target-data-prototype=ExpendableNonVolatile_Ram_Core4/NeCCCR_T_EngTemp_CntrlrOff}, read-nv-data=NeCCCR_T_EngTemp_CntrlrOff.NeCCCR_T_EngTemp_CntrlrOff}
          {nv-ram-block-element=autosar-variable-in-impl-datatype={root-variable-data-prototype=ExpendableNonVolatile_RamBlock_Core4, target-data-prototype=ExpendableNonVolatile_Ram_Core4/NeCCCR_T_EngTemp_CntrlrOff}, written-nv-data=NeCCCR_T_EngTemp_CntrlrOff_Rx.NeCCCR_T_EngTemp_CntrlrOff}
          {nv-ram-block-element=autosar-variable-in-impl-datatype={root-variable-data-prototype=ExpendableNonVolatile_RamBlock_Core4, target-data-prototype=ExpendableNonVolatile_Ram_Core4/NeCCCR_t_CntrlrOnTime}, read-nv-data=NeCCCR_t_CntrlrOnTime.NeCCCR_t_CntrlrOnTime}
          {nv-ram-block-element=autosar-variable-in-impl-datatype={root-variable-data-prototype=ExpendableNonVolatile_RamBlock_Core4, target-data-prototype=ExpendableNonVolatile_Ram_Core4/NeCCCR_t_CntrlrOnTime}, written-nv-data=NeCCCR_t_CntrlrOnTime_Rx.NeCCCR_t_CntrlrOnTime}
          {nv-ram-block-element=autosar-variable-in-impl-datatype={root-variable-data-prototype=ExpendableNonVolatile_RamBlock_Core4, target-data-prototype=ExpendableNonVolatile_Ram_Core4/NeASLR_v_InitVehSpdLim}, read-nv-data=NeASLR_v_InitVehSpdLim.NeASLR_v_InitVehSpdLim}
          {nv-ram-block-element=autosar-variable-in-impl-datatype={root-variable-data-prototype=ExpendableNonVolatile_RamBlock_Core4, target-data-prototype=ExpendableNonVolatile_Ram_Core4/NeASLR_v_InitVehSpdLim}, written-nv-data=NeASLR_v_InitVehSpdLim_Rx.NeASLR_v_InitVehSpdLim}
          {nv-ram-block-element=autosar-variable-in-impl-datatype={root-variable-data-prototype=ExpendableNonVolatile_RamBlock_Core4, target-data-prototype=ExpendableNonVolatile_Ram_Core4/NeAATR_T_AmbAirTempPred_Prev}, read-nv-data=NeAATR_T_AmbAirTempPred_Prev.NeAATR_T_AmbAirTempPred_Prev}
          {nv-ram-block-element=autosar-variable-in-impl-datatype={root-variable-data-prototype=ExpendableNonVolatile_RamBlock_Core4, target-data-prototype=ExpendableNonVolatile_Ram_Core4/NeAATR_T_AmbAirTempPred_Prev}, written-nv-data=NeAATR_T_AmbAirTempPred_Prev_Rx.NeAATR_T_AmbAirTempPred_Prev}
          {nv-ram-block-element=autosar-variable-in-impl-datatype={root-variable-data-prototype=ExpendableNonVolatile_RamBlock_Core4, target-data-prototype=ExpendableNonVolatile_Ram_Core4/NeCCCR_t_CntrlrOffTime}, read-nv-data=NeCCCR_t_CntrlrOffTime.NeCCCR_t_CntrlrOffTime}
          {nv-ram-block-element=autosar-variable-in-impl-datatype={root-variable-data-prototype=ExpendableNonVolatile_RamBlock_Core4, target-data-prototype=ExpendableNonVolatile_Ram_Core4/NeCCCR_t_CntrlrOffTime}, written-nv-data=NeCCCR_t_CntrlrOffTime_Rx.NeCCCR_t_CntrlrOffTime}
          {nv-ram-block-element=autosar-variable-in-impl-datatype={root-variable-data-prototype=ExpendableNonVolatile_RamBlock_Core4, target-data-prototype=ExpendableNonVolatile_Ram_Core4/NePWDR_Cnt_HVFuseEMFOP}, read-nv-data=NePWDR_Cnt_HVFuseEMFOP.NePWDR_Cnt_HVFuseEMFOP}
          {nv-ram-block-element=autosar-variable-in-impl-datatype={root-variable-data-prototype=ExpendableNonVolatile_RamBlock_Core4, target-data-prototype=ExpendableNonVolatile_Ram_Core4/NePWDR_Cnt_HVFuseEMFOP}, written-nv-data=NePWDR_Cnt_HVFuseEMFOP_Rx.NePWDR_Cnt_HVFuseEMFOP}
          {nv-ram-block-element=autosar-variable-in-impl-datatype={root-variable-data-prototype=ExpendableNonVolatile_RamBlock_Core4, target-data-prototype=ExpendableNonVolatile_Ram_Core4/NeVLDR_Cnt_CPV2_PerfDiag_MFOP}, read-nv-data=NeVLDR_Cnt_CPV2_PerfDiag_MFOP.NeVLDR_Cnt_CPV2_PerfDiag_MFOP}
          {nv-ram-block-element=autosar-variable-in-impl-datatype={root-variable-data-prototype=ExpendableNonVolatile_RamBlock_Core4, target-data-prototype=ExpendableNonVolatile_Ram_Core4/NeVLDR_Cnt_CPV2_PerfDiag_MFOP}, written-nv-data=NeVLDR_Cnt_CPV2_PerfDiag_MFOP_Rx.NeVLDR_Cnt_CPV2_PerfDiag_MFOP}
          {nv-ram-block-element=autosar-variable-in-impl-datatype={root-variable-data-prototype=ExpendableNonVolatile_RamBlock_Core4, target-data-prototype=ExpendableNonVolatile_Ram_Core4/NeVLDR_Cnt_BHV_PerfDiag_MFOP}, read-nv-data=NeVLDR_Cnt_BHV_PerfDiag_MFOP.NeVLDR_Cnt_BHV_PerfDiag_MFOP}
          {nv-ram-block-element=autosar-variable-in-impl-datatype={root-variable-data-prototype=ExpendableNonVolatile_RamBlock_Core4, target-data-prototype=ExpendableNonVolatile_Ram_Core4/NeVLDR_Cnt_BHV_PerfDiag_MFOP}, written-nv-data=NeVLDR_Cnt_BHV_PerfDiag_MFOP_Rx.NeVLDR_Cnt_BHV_PerfDiag_MFOP}
          {nv-ram-block-element=autosar-variable-in-impl-datatype={root-variable-data-prototype=ExpendableNonVolatile_RamBlock_Core4, target-data-prototype=ExpendableNonVolatile_Ram_Core4/NeVLDR_Cnt_CPV_PerfDiag_MFOP}, read-nv-data=NeVLDR_Cnt_CPV_PerfDiag_MFOP.NeVLDR_Cnt_CPV_PerfDiag_MFOP}
          {nv-ram-block-element=autosar-variable-in-impl-datatype={root-variable-data-prototype=ExpendableNonVolatile_RamBlock_Core4, target-data-prototype=ExpendableNonVolatile_Ram_Core4/NeVLDR_Cnt_CPV_PerfDiag_MFOP}, written-nv-data=NeVLDR_Cnt_CPV_PerfDiag_MFOP_Rx.NeVLDR_Cnt_CPV_PerfDiag_MFOP}
          {nv-ram-block-element=autosar-variable-in-impl-datatype={root-variable-data-prototype=ExpendableNonVolatile_RamBlock_Core4, target-data-prototype=ExpendableNonVolatile_Ram_Core4/NePWDR_Cnt_HVOverVoltFailureMSOF}, read-nv-data=NePWDR_Cnt_HVOverVoltFailureMSOF.NePWDR_Cnt_HVOverVoltFailureMSOF}
          {nv-ram-block-element=autosar-variable-in-impl-datatype={root-variable-data-prototype=ExpendableNonVolatile_RamBlock_Core4, target-data-prototype=ExpendableNonVolatile_Ram_Core4/NePWDR_Cnt_HVOverVoltFailureMSOF}, written-nv-data=NePWDR_Cnt_HVOverVoltFailureMSOF_Rx.NePWDR_Cnt_HVOverVoltFailureMSOF}
          {nv-ram-block-element=autosar-variable-in-impl-datatype={root-variable-data-prototype=ExpendableNonVolatile_RamBlock_Core4, target-data-prototype=ExpendableNonVolatile_Ram_Core4/NeVLDR_Cnt_CabVlvOpeng_Err_MFOP}, read-nv-data=NeVLDR_Cnt_CabVlvOpeng_Err_MFOP.NeVLDR_Cnt_CabVlvOpeng_Err_MFOP}
          {nv-ram-block-element=autosar-variable-in-impl-datatype={root-variable-data-prototype=ExpendableNonVolatile_RamBlock_Core4, target-data-prototype=ExpendableNonVolatile_Ram_Core4/NeVLDR_Cnt_CabVlvOpeng_Err_MFOP}, written-nv-data=NeVLDR_Cnt_CabVlvOpeng_Err_MFOP_Rx.NeVLDR_Cnt_CabVlvOpeng_Err_MFOP}
          {nv-ram-block-element=autosar-variable-in-impl-datatype={root-variable-data-prototype=ExpendableNonVolatile_RamBlock_Core4, target-data-prototype=ExpendableNonVolatile_Ram_Core4/NePWDR_Cnt_HVOverVoltWarnMFOP}, read-nv-data=NePWDR_Cnt_HVOverVoltWarnMFOP.NePWDR_Cnt_HVOverVoltWarnMFOP}
          {nv-ram-block-element=autosar-variable-in-impl-datatype={root-variable-data-prototype=ExpendableNonVolatile_RamBlock_Core4, target-data-prototype=ExpendableNonVolatile_Ram_Core4/NePWDR_Cnt_HVOverVoltWarnMFOP}, written-nv-data=NePWDR_Cnt_HVOverVoltWarnMFOP_Rx.NePWDR_Cnt_HVOverVoltWarnMFOP}
          {nv-ram-block-element=autosar-variable-in-impl-datatype={root-variable-data-prototype=ExpendableNonVolatile_RamBlock_Core4, target-data-prototype=ExpendableNonVolatile_Ram_Core4/NeVLDR_Cnt_EEXV_PerfDiag_MFOP}, read-nv-data=NeVLDR_Cnt_EEXV_PerfDiag_MFOP.NeVLDR_Cnt_EEXV_PerfDiag_MFOP}
          {nv-ram-block-element=autosar-variable-in-impl-datatype={root-variable-data-prototype=ExpendableNonVolatile_RamBlock_Core4, target-data-prototype=ExpendableNonVolatile_Ram_Core4/NeVLDR_Cnt_EEXV_PerfDiag_MFOP}, written-nv-data=NeVLDR_Cnt_EEXV_PerfDiag_MFOP_Rx.NeVLDR_Cnt_EEXV_PerfDiag_MFOP}
          {nv-ram-block-element=autosar-variable-in-impl-datatype={root-variable-data-prototype=ExpendableNonVolatile_RamBlock_Core4, target-data-prototype=ExpendableNonVolatile_Ram_Core4/NeVLDR_Cnt_EEXV_PressElctrFlt_MFOP}, read-nv-data=NeVLDR_Cnt_EEXV_PressElctrFlt_MFOP.NeVLDR_Cnt_EEXV_PressElctrFlt_MFOP}
          {nv-ram-block-element=autosar-variable-in-impl-datatype={root-variable-data-prototype=ExpendableNonVolatile_RamBlock_Core4, target-data-prototype=ExpendableNonVolatile_Ram_Core4/NeVLDR_Cnt_EEXV_PressElctrFlt_MFOP}, written-nv-data=NeVLDR_Cnt_EEXV_PressElctrFlt_MFOP_Rx.NeVLDR_Cnt_EEXV_PressElctrFlt_MFOP}
          {nv-ram-block-element=autosar-variable-in-impl-datatype={root-variable-data-prototype=ExpendableNonVolatile_RamBlock_Core4, target-data-prototype=ExpendableNonVolatile_Ram_Core4/NePWDR_Cnt_HVFuseDMFOP}, read-nv-data=NePWDR_Cnt_HVFuseDMFOP.NePWDR_Cnt_HVFuseDMFOP}
          {nv-ram-block-element=autosar-variable-in-impl-datatype={root-variable-data-prototype=ExpendableNonVolatile_RamBlock_Core4, target-data-prototype=ExpendableNonVolatile_Ram_Core4/NePWDR_Cnt_HVFuseDMFOP}, written-nv-data=NePWDR_Cnt_HVFuseDMFOP_Rx.NePWDR_Cnt_HVFuseDMFOP}
          {nv-ram-block-element=autosar-variable-in-impl-datatype={root-variable-data-prototype=ExpendableNonVolatile_RamBlock_Core4, target-data-prototype=ExpendableNonVolatile_Ram_Core4/NePWDR_Cnt_HVFuseCMFOP}, read-nv-data=NePWDR_Cnt_HVFuseCMFOP.NePWDR_Cnt_HVFuseCMFOP}
          {nv-ram-block-element=autosar-variable-in-impl-datatype={root-variable-data-prototype=ExpendableNonVolatile_RamBlock_Core4, target-data-prototype=ExpendableNonVolatile_Ram_Core4/NePWDR_Cnt_HVFuseCMFOP}, written-nv-data=NePWDR_Cnt_HVFuseCMFOP_Rx.NePWDR_Cnt_HVFuseCMFOP}
          {nv-ram-block-element=autosar-variable-in-impl-datatype={root-variable-data-prototype=ExpendableNonVolatile_RamBlock_Core4, target-data-prototype=ExpendableNonVolatile_Ram_Core4/NePWDR_Cnt_HVILCkt_MFOP}, read-nv-data=NePWDR_Cnt_HVILCkt_MFOP.NePWDR_Cnt_HVILCkt_MFOP}
          {nv-ram-block-element=autosar-variable-in-impl-datatype={root-variable-data-prototype=ExpendableNonVolatile_RamBlock_Core4, target-data-prototype=ExpendableNonVolatile_Ram_Core4/NePWDR_Cnt_HVILCkt_MFOP}, written-nv-data=NePWDR_Cnt_HVILCkt_MFOP_Rx.NePWDR_Cnt_HVILCkt_MFOP}
          {nv-ram-block-element=autosar-variable-in-impl-datatype={root-variable-data-prototype=ExpendableNonVolatile_RamBlock_Core4, target-data-prototype=ExpendableNonVolatile_Ram_Core4/NePWDR_Cnt_HVFuseBMFOP}, read-nv-data=NePWDR_Cnt_HVFuseBMFOP.NePWDR_Cnt_HVFuseBMFOP}
          {nv-ram-block-element=autosar-variable-in-impl-datatype={root-variable-data-prototype=ExpendableNonVolatile_RamBlock_Core4, target-data-prototype=ExpendableNonVolatile_Ram_Core4/NePWDR_Cnt_HVFuseBMFOP}, written-nv-data=NePWDR_Cnt_HVFuseBMFOP_Rx.NePWDR_Cnt_HVFuseBMFOP}
          {nv-ram-block-element=autosar-variable-in-impl-datatype={root-variable-data-prototype=ExpendableNonVolatile_RamBlock_Core4, target-data-prototype=ExpendableNonVolatile_Ram_Core4/NePWDR_Cnt_HVFuseAMFOP}, read-nv-data=NePWDR_Cnt_HVFuseAMFOP.NePWDR_Cnt_HVFuseAMFOP}
          {nv-ram-block-element=autosar-variable-in-impl-datatype={root-variable-data-prototype=ExpendableNonVolatile_RamBlock_Core4, target-data-prototype=ExpendableNonVolatile_Ram_Core4/NePWDR_Cnt_HVFuseAMFOP}, written-nv-data=NePWDR_Cnt_HVFuseAMFOP_Rx.NePWDR_Cnt_HVFuseAMFOP}
          {nv-ram-block-element=autosar-variable-in-impl-datatype={root-variable-data-prototype=ExpendableNonVolatile_RamBlock_Core4, target-data-prototype=ExpendableNonVolatile_Ram_Core4/NePWDR_Cnt_HVDAPMFOP}, read-nv-data=NePWDR_Cnt_HVDAPMFOP.NePWDR_Cnt_HVDAPMFOP}
          {nv-ram-block-element=autosar-variable-in-impl-datatype={root-variable-data-prototype=ExpendableNonVolatile_RamBlock_Core4, target-data-prototype=ExpendableNonVolatile_Ram_Core4/NePWDR_Cnt_HVDAPMFOP}, written-nv-data=NePWDR_Cnt_HVDAPMFOP_Rx.NePWDR_Cnt_HVDAPMFOP}
          {nv-ram-block-element=autosar-variable-in-impl-datatype={root-variable-data-prototype=ExpendableNonVolatile_RamBlock_Core4, target-data-prototype=ExpendableNonVolatile_Ram_Core4/NePWDR_Cnt_HVOverVoltFailureMFOP}, read-nv-data=NePWDR_Cnt_HVOverVoltFailureMFOP.NePWDR_Cnt_HVOverVoltFailureMFOP}
          {nv-ram-block-element=autosar-variable-in-impl-datatype={root-variable-data-prototype=ExpendableNonVolatile_RamBlock_Core4, target-data-prototype=ExpendableNonVolatile_Ram_Core4/NePWDR_Cnt_HVOverVoltFailureMFOP}, written-nv-data=NePWDR_Cnt_HVOverVoltFailureMFOP_Rx.NePWDR_Cnt_HVOverVoltFailureMFOP}
          {nv-ram-block-element=autosar-variable-in-impl-datatype={root-variable-data-prototype=ExpendableNonVolatile_RamBlock_Core4, target-data-prototype=ExpendableNonVolatile_Ram_Core4/NeVLDR_Cnt_EEXV_TempElctrFlt_MFOP}, read-nv-data=NeVLDR_Cnt_EEXV_TempElctrFlt_MFOP.NeVLDR_Cnt_EEXV_TempElctrFlt_MFOP}
          {nv-ram-block-element=autosar-variable-in-impl-datatype={root-variable-data-prototype=ExpendableNonVolatile_RamBlock_Core4, target-data-prototype=ExpendableNonVolatile_Ram_Core4/NeVLDR_Cnt_EEXV_TempElctrFlt_MFOP}, written-nv-data=NeVLDR_Cnt_EEXV_TempElctrFlt_MFOP_Rx.NeVLDR_Cnt_EEXV_TempElctrFlt_MFOP}
          {nv-ram-block-element=autosar-variable-in-impl-datatype={root-variable-data-prototype=ExpendableNonVolatile_RamBlock_Core4, target-data-prototype=ExpendableNonVolatile_Ram_Core4/NePWDR_Cnt_BattOverTempFailureMFOP}, read-nv-data=NePWDR_Cnt_BattOverTempFailureMFOP.NePWDR_Cnt_BattOverTempFailureMFOP}
          {nv-ram-block-element=autosar-variable-in-impl-datatype={root-variable-data-prototype=ExpendableNonVolatile_RamBlock_Core4, target-data-prototype=ExpendableNonVolatile_Ram_Core4/NePWDR_Cnt_BattOverTempFailureMFOP}, written-nv-data=NePWDR_Cnt_BattOverTempFailureMFOP_Rx.NePWDR_Cnt_BattOverTempFailureMFOP}
          {nv-ram-block-element=autosar-variable-in-impl-datatype={root-variable-data-prototype=ExpendableNonVolatile_RamBlock_Core4, target-data-prototype=ExpendableNonVolatile_Ram_Core4/NeVLDR_Cnt_EEXV_PressSens_MFOP}, read-nv-data=NeVLDR_Cnt_EEXV_PressSens_MFOP.NeVLDR_Cnt_EEXV_PressSens_MFOP}
          {nv-ram-block-element=autosar-variable-in-impl-datatype={root-variable-data-prototype=ExpendableNonVolatile_RamBlock_Core4, target-data-prototype=ExpendableNonVolatile_Ram_Core4/NeVLDR_Cnt_EEXV_PressSens_MFOP}, written-nv-data=NeVLDR_Cnt_EEXV_PressSens_MFOP_Rx.NeVLDR_Cnt_EEXV_PressSens_MFOP}
          {nv-ram-block-element=autosar-variable-in-impl-datatype={root-variable-data-prototype=ExpendableNonVolatile_RamBlock_Core4, target-data-prototype=ExpendableNonVolatile_Ram_Core4/NeVLDR_Cnt_EXV_PerfDiag_MFOP}, read-nv-data=NeVLDR_Cnt_EXV_PerfDiag_MFOP.NeVLDR_Cnt_EXV_PerfDiag_MFOP}
          {nv-ram-block-element=autosar-variable-in-impl-datatype={root-variable-data-prototype=ExpendableNonVolatile_RamBlock_Core4, target-data-prototype=ExpendableNonVolatile_Ram_Core4/NeVLDR_Cnt_EXV_PerfDiag_MFOP}, written-nv-data=NeVLDR_Cnt_EXV_PerfDiag_MFOP_Rx.NeVLDR_Cnt_EXV_PerfDiag_MFOP}
          {nv-ram-block-element=autosar-variable-in-impl-datatype={root-variable-data-prototype=ExpendableNonVolatile_RamBlock_Core4, target-data-prototype=ExpendableNonVolatile_Ram_Core4/NePMDR_Cnt_BF1SysVoltHi_MFOP}, read-nv-data=NePMDR_Cnt_BF1SysVoltHi_MFOP.NePMDR_Cnt_BF1SysVoltHi_MFOP}
          {nv-ram-block-element=autosar-variable-in-impl-datatype={root-variable-data-prototype=ExpendableNonVolatile_RamBlock_Core4, target-data-prototype=ExpendableNonVolatile_Ram_Core4/NePMDR_Cnt_BF1SysVoltHi_MFOP}, written-nv-data=NePMDR_Cnt_BF1SysVoltHi_MFOP_Rx.NePMDR_Cnt_BF1SysVoltHi_MFOP}
          {nv-ram-block-element=autosar-variable-in-impl-datatype={root-variable-data-prototype=ExpendableNonVolatile_RamBlock_Core4, target-data-prototype=ExpendableNonVolatile_Ram_Core4/NePMDR_Cnt_BFHBSpareSysVoltHi_MFOP}, read-nv-data=NePMDR_Cnt_BFHBSpareSysVoltHi_MFOP.NePMDR_Cnt_BFHBSpareSysVoltHi_MFOP}
          {nv-ram-block-element=autosar-variable-in-impl-datatype={root-variable-data-prototype=ExpendableNonVolatile_RamBlock_Core4, target-data-prototype=ExpendableNonVolatile_Ram_Core4/NePMDR_Cnt_BFHBSpareSysVoltHi_MFOP}, written-nv-data=NePMDR_Cnt_BFHBSpareSysVoltHi_MFOP_Rx.NePMDR_Cnt_BFHBSpareSysVoltHi_MFOP}
          {nv-ram-block-element=autosar-variable-in-impl-datatype={root-variable-data-prototype=ExpendableNonVolatile_RamBlock_Core4, target-data-prototype=ExpendableNonVolatile_Ram_Core4/NePMDR_Cnt_BF3SysVoltLow_MFOP}, read-nv-data=NePMDR_Cnt_BF3SysVoltLow_MFOP.NePMDR_Cnt_BF3SysVoltLow_MFOP}
          {nv-ram-block-element=autosar-variable-in-impl-datatype={root-variable-data-prototype=ExpendableNonVolatile_RamBlock_Core4, target-data-prototype=ExpendableNonVolatile_Ram_Core4/NePMDR_Cnt_BF3SysVoltLow_MFOP}, written-nv-data=NePMDR_Cnt_BF3SysVoltLow_MFOP_Rx.NePMDR_Cnt_BF3SysVoltLow_MFOP}
          {nv-ram-block-element=autosar-variable-in-impl-datatype={root-variable-data-prototype=ExpendableNonVolatile_RamBlock_Core4, target-data-prototype=ExpendableNonVolatile_Ram_Core4/NeVLDR_Cnt_OEXV_PressElctrFlt_MFOP}, read-nv-data=NeVLDR_Cnt_OEXV_PressElctrFlt_MFOP.NeVLDR_Cnt_OEXV_PressElctrFlt_MFOP}
          {nv-ram-block-element=autosar-variable-in-impl-datatype={root-variable-data-prototype=ExpendableNonVolatile_RamBlock_Core4, target-data-prototype=ExpendableNonVolatile_Ram_Core4/NeVLDR_Cnt_OEXV_PressElctrFlt_MFOP}, written-nv-data=NeVLDR_Cnt_OEXV_PressElctrFlt_MFOP_Rx.NeVLDR_Cnt_OEXV_PressElctrFlt_MFOP}
          {nv-ram-block-element=autosar-variable-in-impl-datatype={root-variable-data-prototype=ExpendableNonVolatile_RamBlock_Core4, target-data-prototype=ExpendableNonVolatile_Ram_Core4/NeVLDR_Cnt_OEXV_PressSens_MFOP}, read-nv-data=NeVLDR_Cnt_OEXV_PressSens_MFOP.NeVLDR_Cnt_OEXV_PressSens_MFOP}
          {nv-ram-block-element=autosar-variable-in-impl-datatype={root-variable-data-prototype=ExpendableNonVolatile_RamBlock_Core4, target-data-prototype=ExpendableNonVolatile_Ram_Core4/NeVLDR_Cnt_OEXV_PressSens_MFOP}, written-nv-data=NeVLDR_Cnt_OEXV_PressSens_MFOP_Rx.NeVLDR_Cnt_OEXV_PressSens_MFOP}
          {nv-ram-block-element=autosar-variable-in-impl-datatype={root-variable-data-prototype=ExpendableNonVolatile_RamBlock_Core4, target-data-prototype=ExpendableNonVolatile_Ram_Core4/NePMDR_Cnt_BF3SysVoltHi_MFOP}, read-nv-data=NePMDR_Cnt_BF3SysVoltHi_MFOP.NePMDR_Cnt_BF3SysVoltHi_MFOP}
          {nv-ram-block-element=autosar-variable-in-impl-datatype={root-variable-data-prototype=ExpendableNonVolatile_RamBlock_Core4, target-data-prototype=ExpendableNonVolatile_Ram_Core4/NePMDR_Cnt_BF3SysVoltHi_MFOP}, written-nv-data=NePMDR_Cnt_BF3SysVoltHi_MFOP_Rx.NePMDR_Cnt_BF3SysVoltHi_MFOP}
          {nv-ram-block-element=autosar-variable-in-impl-datatype={root-variable-data-prototype=ExpendableNonVolatile_RamBlock_Core4, target-data-prototype=ExpendableNonVolatile_Ram_Core4/NePMDR_Cnt_BF2SysVoltLow_MFOP}, read-nv-data=NePMDR_Cnt_BF2SysVoltLow_MFOP.NePMDR_Cnt_BF2SysVoltLow_MFOP}
          {nv-ram-block-element=autosar-variable-in-impl-datatype={root-variable-data-prototype=ExpendableNonVolatile_RamBlock_Core4, target-data-prototype=ExpendableNonVolatile_Ram_Core4/NePMDR_Cnt_BF2SysVoltLow_MFOP}, written-nv-data=NePMDR_Cnt_BF2SysVoltLow_MFOP_Rx.NePMDR_Cnt_BF2SysVoltLow_MFOP}
          {nv-ram-block-element=autosar-variable-in-impl-datatype={root-variable-data-prototype=ExpendableNonVolatile_RamBlock_Core4, target-data-prototype=ExpendableNonVolatile_Ram_Core4/NePMDR_Cnt_BF2SysVoltHi_MFOP}, read-nv-data=NePMDR_Cnt_BF2SysVoltHi_MFOP.NePMDR_Cnt_BF2SysVoltHi_MFOP}
          {nv-ram-block-element=autosar-variable-in-impl-datatype={root-variable-data-prototype=ExpendableNonVolatile_RamBlock_Core4, target-data-prototype=ExpendableNonVolatile_Ram_Core4/NePMDR_Cnt_BF2SysVoltHi_MFOP}, written-nv-data=NePMDR_Cnt_BF2SysVoltHi_MFOP_Rx.NePMDR_Cnt_BF2SysVoltHi_MFOP}
          {nv-ram-block-element=autosar-variable-in-impl-datatype={root-variable-data-prototype=ExpendableNonVolatile_RamBlock_Core4, target-data-prototype=ExpendableNonVolatile_Ram_Core4/NePMDR_Cnt_BF1SysVoltLow_MFOP}, read-nv-data=NePMDR_Cnt_BF1SysVoltLow_MFOP.NePMDR_Cnt_BF1SysVoltLow_MFOP}
          {nv-ram-block-element=autosar-variable-in-impl-datatype={root-variable-data-prototype=ExpendableNonVolatile_RamBlock_Core4, target-data-prototype=ExpendableNonVolatile_Ram_Core4/NePMDR_Cnt_BF1SysVoltLow_MFOP}, written-nv-data=NePMDR_Cnt_BF1SysVoltLow_MFOP_Rx.NePMDR_Cnt_BF1SysVoltLow_MFOP}
          {nv-ram-block-element=autosar-variable-in-impl-datatype={root-variable-data-prototype=ExpendableNonVolatile_RamBlock_Core4, target-data-prototype=ExpendableNonVolatile_Ram_Core4/NePMDD_Cnt_RunLoMaxFOP}, read-nv-data=NePMDD_Cnt_RunLoMaxFOP.NePMDD_Cnt_RunLoMaxFOP}
          {nv-ram-block-element=autosar-variable-in-impl-datatype={root-variable-data-prototype=ExpendableNonVolatile_RamBlock_Core4, target-data-prototype=ExpendableNonVolatile_Ram_Core4/NePMDD_Cnt_RunLoMaxFOP}, written-nv-data=NePMDD_Cnt_RunLoMaxFOP_Rx.NePMDD_Cnt_RunLoMaxFOP}
          {nv-ram-block-element=autosar-variable-in-impl-datatype={root-variable-data-prototype=ExpendableNonVolatile_RamBlock_Core4, target-data-prototype=ExpendableNonVolatile_Ram_Core4/NeVLDR_Cnt_EXV_PressElctrFlt_MFOP}, read-nv-data=NeVLDR_Cnt_EXV_PressElctrFlt_MFOP.NeVLDR_Cnt_EXV_PressElctrFlt_MFOP}
          {nv-ram-block-element=autosar-variable-in-impl-datatype={root-variable-data-prototype=ExpendableNonVolatile_RamBlock_Core4, target-data-prototype=ExpendableNonVolatile_Ram_Core4/NeVLDR_Cnt_EXV_PressElctrFlt_MFOP}, written-nv-data=NeVLDR_Cnt_EXV_PressElctrFlt_MFOP_Rx.NeVLDR_Cnt_EXV_PressElctrFlt_MFOP}
          {nv-ram-block-element=autosar-variable-in-impl-datatype={root-variable-data-prototype=ExpendableNonVolatile_RamBlock_Core4, target-data-prototype=ExpendableNonVolatile_Ram_Core4/NeVLDR_Cnt_OEXV_TempElctrFlt_MFOP}, read-nv-data=NeVLDR_Cnt_OEXV_TempElctrFlt_MFOP.NeVLDR_Cnt_OEXV_TempElctrFlt_MFOP}
          {nv-ram-block-element=autosar-variable-in-impl-datatype={root-variable-data-prototype=ExpendableNonVolatile_RamBlock_Core4, target-data-prototype=ExpendableNonVolatile_Ram_Core4/NeVLDR_Cnt_OEXV_TempElctrFlt_MFOP}, written-nv-data=NeVLDR_Cnt_OEXV_TempElctrFlt_MFOP_Rx.NeVLDR_Cnt_OEXV_TempElctrFlt_MFOP}
          {nv-ram-block-element=autosar-variable-in-impl-datatype={root-variable-data-prototype=ExpendableNonVolatile_RamBlock_Core4, target-data-prototype=ExpendableNonVolatile_Ram_Core4/NeAADR_Cnt_AAD_PerfDiag_MFOP}, read-nv-data=NeAADR_Cnt_AAD_PerfDiag_MFOP.NeAADR_Cnt_AAD_PerfDiag_MFOP}
          {nv-ram-block-element=autosar-variable-in-impl-datatype={root-variable-data-prototype=ExpendableNonVolatile_RamBlock_Core4, target-data-prototype=ExpendableNonVolatile_Ram_Core4/NeAADR_Cnt_AAD_PerfDiag_MFOP}, written-nv-data=NeAADR_Cnt_AAD_PerfDiag_MFOP_Rx.NeAADR_Cnt_AAD_PerfDiag_MFOP}
          {nv-ram-block-element=autosar-variable-in-impl-datatype={root-variable-data-prototype=ExpendableNonVolatile_RamBlock_Core4, target-data-prototype=ExpendableNonVolatile_Ram_Core4/NePMDD_Cnt_RunCrankOpenMaxFOP}, read-nv-data=NePMDD_Cnt_RunCrankOpenMaxFOP.NePMDD_Cnt_RunCrankOpenMaxFOP}
          {nv-ram-block-element=autosar-variable-in-impl-datatype={root-variable-data-prototype=ExpendableNonVolatile_RamBlock_Core4, target-data-prototype=ExpendableNonVolatile_Ram_Core4/NePMDD_Cnt_RunCrankOpenMaxFOP}, written-nv-data=NePMDD_Cnt_RunCrankOpenMaxFOP_Rx.NePMDD_Cnt_RunCrankOpenMaxFOP}
          {nv-ram-block-element=autosar-variable-in-impl-datatype={root-variable-data-prototype=ExpendableNonVolatile_RamBlock_Core4, target-data-prototype=ExpendableNonVolatile_Ram_Core4/NePMDD_Cnt_RunCrankHiMaxFOP}, read-nv-data=NePMDD_Cnt_RunCrankHiMaxFOP.NePMDD_Cnt_RunCrankHiMaxFOP}
          {nv-ram-block-element=autosar-variable-in-impl-datatype={root-variable-data-prototype=ExpendableNonVolatile_RamBlock_Core4, target-data-prototype=ExpendableNonVolatile_Ram_Core4/NePMDD_Cnt_RunCrankHiMaxFOP}, written-nv-data=NePMDD_Cnt_RunCrankHiMaxFOP_Rx.NePMDD_Cnt_RunCrankHiMaxFOP}
          {nv-ram-block-element=autosar-variable-in-impl-datatype={root-variable-data-prototype=ExpendableNonVolatile_RamBlock_Core4, target-data-prototype=ExpendableNonVolatile_Ram_Core4/NePMDD_Cnt_AccLoMaxFOP}, read-nv-data=NePMDD_Cnt_AccLoMaxFOP.NePMDD_Cnt_AccLoMaxFOP}
          {nv-ram-block-element=autosar-variable-in-impl-datatype={root-variable-data-prototype=ExpendableNonVolatile_RamBlock_Core4, target-data-prototype=ExpendableNonVolatile_Ram_Core4/NePMDD_Cnt_AccLoMaxFOP}, written-nv-data=NePMDD_Cnt_AccLoMaxFOP_Rx.NePMDD_Cnt_AccLoMaxFOP}
          {nv-ram-block-element=autosar-variable-in-impl-datatype={root-variable-data-prototype=ExpendableNonVolatile_RamBlock_Core4, target-data-prototype=ExpendableNonVolatile_Ram_Core4/NePMDD_Cnt_AccHiMaxFOP}, read-nv-data=NePMDD_Cnt_AccHiMaxFOP.NePMDD_Cnt_AccHiMaxFOP}
          {nv-ram-block-element=autosar-variable-in-impl-datatype={root-variable-data-prototype=ExpendableNonVolatile_RamBlock_Core4, target-data-prototype=ExpendableNonVolatile_Ram_Core4/NePMDD_Cnt_AccHiMaxFOP}, written-nv-data=NePMDD_Cnt_AccHiMaxFOP_Rx.NePMDD_Cnt_AccHiMaxFOP}
          {nv-ram-block-element=autosar-variable-in-impl-datatype={root-variable-data-prototype=ExpendableNonVolatile_RamBlock_Core4, target-data-prototype=ExpendableNonVolatile_Ram_Core4/NePMDR_Cnt_BFHBSysVoltHi_MFOP}, read-nv-data=NePMDR_Cnt_BFHBSysVoltHi_MFOP.NePMDR_Cnt_BFHBSysVoltHi_MFOP}
          {nv-ram-block-element=autosar-variable-in-impl-datatype={root-variable-data-prototype=ExpendableNonVolatile_RamBlock_Core4, target-data-prototype=ExpendableNonVolatile_Ram_Core4/NePMDR_Cnt_BFHBSysVoltHi_MFOP}, written-nv-data=NePMDR_Cnt_BFHBSysVoltHi_MFOP_Rx.NePMDR_Cnt_BFHBSysVoltHi_MFOP}
          {nv-ram-block-element=autosar-variable-in-impl-datatype={root-variable-data-prototype=ExpendableNonVolatile_RamBlock_Core4, target-data-prototype=ExpendableNonVolatile_Ram_Core4/NePMDR_Cnt_HBSpareSysVoltLow_MFOP}, read-nv-data=NePMDR_Cnt_HBSpareSysVoltLow_MFOP.NePMDR_Cnt_HBSpareSysVoltLow_MFOP}
          {nv-ram-block-element=autosar-variable-in-impl-datatype={root-variable-data-prototype=ExpendableNonVolatile_RamBlock_Core4, target-data-prototype=ExpendableNonVolatile_Ram_Core4/NePMDR_Cnt_HBSpareSysVoltLow_MFOP}, written-nv-data=NePMDR_Cnt_HBSpareSysVoltLow_MFOP_Rx.NePMDR_Cnt_HBSpareSysVoltLow_MFOP}
          {nv-ram-block-element=autosar-variable-in-impl-datatype={root-variable-data-prototype=ExpendableNonVolatile_RamBlock_Core4, target-data-prototype=ExpendableNonVolatile_Ram_Core4/NePMDR_Cnt_HBSysVoltLow_MFOP}, read-nv-data=NePMDR_Cnt_HBSysVoltLow_MFOP.NePMDR_Cnt_HBSysVoltLow_MFOP}
          {nv-ram-block-element=autosar-variable-in-impl-datatype={root-variable-data-prototype=ExpendableNonVolatile_RamBlock_Core4, target-data-prototype=ExpendableNonVolatile_Ram_Core4/NePMDR_Cnt_HBSysVoltLow_MFOP}, written-nv-data=NePMDR_Cnt_HBSysVoltLow_MFOP_Rx.NePMDR_Cnt_HBSysVoltLow_MFOP}
          {nv-ram-block-element=autosar-variable-in-impl-datatype={root-variable-data-prototype=ExpendableNonVolatile_RamBlock_Core4, target-data-prototype=ExpendableNonVolatile_Ram_Core4/NePWDR_Cnt_HVUnderVoltFailureMFOP}, read-nv-data=NePWDR_Cnt_HVUnderVoltFailureMFOP.NePWDR_Cnt_HVUnderVoltFailureMFOP}
          {nv-ram-block-element=autosar-variable-in-impl-datatype={root-variable-data-prototype=ExpendableNonVolatile_RamBlock_Core4, target-data-prototype=ExpendableNonVolatile_Ram_Core4/NePWDR_Cnt_HVUnderVoltFailureMFOP}, written-nv-data=NePWDR_Cnt_HVUnderVoltFailureMFOP_Rx.NePWDR_Cnt_HVUnderVoltFailureMFOP}
          {nv-ram-block-element=autosar-variable-in-impl-datatype={root-variable-data-prototype=ExpendableNonVolatile_RamBlock_Core4, target-data-prototype=ExpendableNonVolatile_Ram_Core4/NeVLDR_Cnt_EXV_PressSens_MFOP}, read-nv-data=NeVLDR_Cnt_EXV_PressSens_MFOP.NeVLDR_Cnt_EXV_PressSens_MFOP}
          {nv-ram-block-element=autosar-variable-in-impl-datatype={root-variable-data-prototype=ExpendableNonVolatile_RamBlock_Core4, target-data-prototype=ExpendableNonVolatile_Ram_Core4/NeVLDR_Cnt_EXV_PressSens_MFOP}, written-nv-data=NeVLDR_Cnt_EXV_PressSens_MFOP_Rx.NeVLDR_Cnt_EXV_PressSens_MFOP}
          {nv-ram-block-element=autosar-variable-in-impl-datatype={root-variable-data-prototype=ExpendableNonVolatile_RamBlock_Core4, target-data-prototype=ExpendableNonVolatile_Ram_Core4/NeVLDR_Cnt_EXV_TempElctrFlt_MFOP}, read-nv-data=NeVLDR_Cnt_EXV_TempElctrFlt_MFOP.NeVLDR_Cnt_EXV_TempElctrFlt_MFOP}
          {nv-ram-block-element=autosar-variable-in-impl-datatype={root-variable-data-prototype=ExpendableNonVolatile_RamBlock_Core4, target-data-prototype=ExpendableNonVolatile_Ram_Core4/NeVLDR_Cnt_EXV_TempElctrFlt_MFOP}, written-nv-data=NeVLDR_Cnt_EXV_TempElctrFlt_MFOP_Rx.NeVLDR_Cnt_EXV_TempElctrFlt_MFOP}
          {nv-ram-block-element=autosar-variable-in-impl-datatype={root-variable-data-prototype=ExpendableNonVolatile_RamBlock_Core4, target-data-prototype=ExpendableNonVolatile_Ram_Core4/NeVLDR_Cnt_EXV_TempSens_MFOP}, read-nv-data=NeVLDR_Cnt_EXV_TempSens_MFOP.NeVLDR_Cnt_EXV_TempSens_MFOP}
          {nv-ram-block-element=autosar-variable-in-impl-datatype={root-variable-data-prototype=ExpendableNonVolatile_RamBlock_Core4, target-data-prototype=ExpendableNonVolatile_Ram_Core4/NeVLDR_Cnt_EXV_TempSens_MFOP}, written-nv-data=NeVLDR_Cnt_EXV_TempSens_MFOP_Rx.NeVLDR_Cnt_EXV_TempSens_MFOP}
          {nv-ram-block-element=autosar-variable-in-impl-datatype={root-variable-data-prototype=ExpendableNonVolatile_RamBlock_Core4, target-data-prototype=ExpendableNonVolatile_Ram_Core4/NeVLDR_Cnt_HCTV_Leak_MFOP}, read-nv-data=NeVLDR_Cnt_HCTV_Leak_MFOP.NeVLDR_Cnt_HCTV_Leak_MFOP}
          {nv-ram-block-element=autosar-variable-in-impl-datatype={root-variable-data-prototype=ExpendableNonVolatile_RamBlock_Core4, target-data-prototype=ExpendableNonVolatile_Ram_Core4/NeVLDR_Cnt_HCTV_Leak_MFOP}, written-nv-data=NeVLDR_Cnt_HCTV_Leak_MFOP_Rx.NeVLDR_Cnt_HCTV_Leak_MFOP}
          {nv-ram-block-element=autosar-variable-in-impl-datatype={root-variable-data-prototype=ExpendableNonVolatile_RamBlock_Core4, target-data-prototype=ExpendableNonVolatile_Ram_Core4/NeVLDR_Cnt_HTL_PerfDiag_MFOP}, read-nv-data=NeVLDR_Cnt_HTL_PerfDiag_MFOP.NeVLDR_Cnt_HTL_PerfDiag_MFOP}
          {nv-ram-block-element=autosar-variable-in-impl-datatype={root-variable-data-prototype=ExpendableNonVolatile_RamBlock_Core4, target-data-prototype=ExpendableNonVolatile_Ram_Core4/NeVLDR_Cnt_HTL_PerfDiag_MFOP}, written-nv-data=NeVLDR_Cnt_HTL_PerfDiag_MFOP_Rx.NeVLDR_Cnt_HTL_PerfDiag_MFOP}
          {nv-ram-block-element=autosar-variable-in-impl-datatype={root-variable-data-prototype=ExpendableNonVolatile_RamBlock_Core4, target-data-prototype=ExpendableNonVolatile_Ram_Core4/NeVLDR_Cnt_HTSoV_StkCls_MFOP}, read-nv-data=NeVLDR_Cnt_HTSoV_StkCls_MFOP.NeVLDR_Cnt_HTSoV_StkCls_MFOP}
          {nv-ram-block-element=autosar-variable-in-impl-datatype={root-variable-data-prototype=ExpendableNonVolatile_RamBlock_Core4, target-data-prototype=ExpendableNonVolatile_Ram_Core4/NeVLDR_Cnt_HTSoV_StkCls_MFOP}, written-nv-data=NeVLDR_Cnt_HTSoV_StkCls_MFOP_Rx.NeVLDR_Cnt_HTSoV_StkCls_MFOP}
          {nv-ram-block-element=autosar-variable-in-impl-datatype={root-variable-data-prototype=ExpendableNonVolatile_RamBlock_Core4, target-data-prototype=ExpendableNonVolatile_Ram_Core4/NePWDR_Cnt_BPCM_MFOP}, read-nv-data=NePWDR_Cnt_BPCM_MFOP.NePWDR_Cnt_BPCM_MFOP}
          {nv-ram-block-element=autosar-variable-in-impl-datatype={root-variable-data-prototype=ExpendableNonVolatile_RamBlock_Core4, target-data-prototype=ExpendableNonVolatile_Ram_Core4/NePWDR_Cnt_BPCM_MFOP}, written-nv-data=NePWDR_Cnt_BPCM_MFOP_Rx.NePWDR_Cnt_BPCM_MFOP}
          {nv-ram-block-element=autosar-variable-in-impl-datatype={root-variable-data-prototype=ExpendableNonVolatile_RamBlock_Core4, target-data-prototype=ExpendableNonVolatile_Ram_Core4/NeVLDR_Cnt_HTSoV_StkOpn_MFOP}, read-nv-data=NeVLDR_Cnt_HTSoV_StkOpn_MFOP.NeVLDR_Cnt_HTSoV_StkOpn_MFOP}
          {nv-ram-block-element=autosar-variable-in-impl-datatype={root-variable-data-prototype=ExpendableNonVolatile_RamBlock_Core4, target-data-prototype=ExpendableNonVolatile_Ram_Core4/NeVLDR_Cnt_HTSoV_StkOpn_MFOP}, written-nv-data=NeVLDR_Cnt_HTSoV_StkOpn_MFOP_Rx.NeVLDR_Cnt_HTSoV_StkOpn_MFOP}
          {nv-ram-block-element=autosar-variable-in-impl-datatype={root-variable-data-prototype=ExpendableNonVolatile_RamBlock_Core4, target-data-prototype=ExpendableNonVolatile_Ram_Core4/NeVLDR_Cnt_LTR_PerfDiag_MFOP}, read-nv-data=NeVLDR_Cnt_LTR_PerfDiag_MFOP.NeVLDR_Cnt_LTR_PerfDiag_MFOP}
          {nv-ram-block-element=autosar-variable-in-impl-datatype={root-variable-data-prototype=ExpendableNonVolatile_RamBlock_Core4, target-data-prototype=ExpendableNonVolatile_Ram_Core4/NeVLDR_Cnt_LTR_PerfDiag_MFOP}, written-nv-data=NeVLDR_Cnt_LTR_PerfDiag_MFOP_Rx.NeVLDR_Cnt_LTR_PerfDiag_MFOP}
          {nv-ram-block-element=autosar-variable-in-impl-datatype={root-variable-data-prototype=ExpendableNonVolatile_RamBlock_Core4, target-data-prototype=ExpendableNonVolatile_Ram_Core4/NeVLDR_Cnt_LTSOV_StkOff_MFOP}, read-nv-data=NeVLDR_Cnt_LTSOV_StkOff_MFOP.NeVLDR_Cnt_LTSOV_StkOff_MFOP}
          {nv-ram-block-element=autosar-variable-in-impl-datatype={root-variable-data-prototype=ExpendableNonVolatile_RamBlock_Core4, target-data-prototype=ExpendableNonVolatile_Ram_Core4/NeVLDR_Cnt_LTSOV_StkOff_MFOP}, written-nv-data=NeVLDR_Cnt_LTSOV_StkOff_MFOP_Rx.NeVLDR_Cnt_LTSOV_StkOff_MFOP}
          {nv-ram-block-element=autosar-variable-in-impl-datatype={root-variable-data-prototype=ExpendableNonVolatile_RamBlock_Core4, target-data-prototype=ExpendableNonVolatile_Ram_Core4/NeVLDR_Cnt_LTSOV_StkOn_MFOP}, read-nv-data=NeVLDR_Cnt_LTSOV_StkOn_MFOP.NeVLDR_Cnt_LTSOV_StkOn_MFOP}
          {nv-ram-block-element=autosar-variable-in-impl-datatype={root-variable-data-prototype=ExpendableNonVolatile_RamBlock_Core4, target-data-prototype=ExpendableNonVolatile_Ram_Core4/NeVLDR_Cnt_LTSOV_StkOn_MFOP}, written-nv-data=NeVLDR_Cnt_LTSOV_StkOn_MFOP_Rx.NeVLDR_Cnt_LTSOV_StkOn_MFOP}
          {nv-ram-block-element=autosar-variable-in-impl-datatype={root-variable-data-prototype=ExpendableNonVolatile_RamBlock_Core4, target-data-prototype=ExpendableNonVolatile_Ram_Core4/NeVLDR_Cnt_OEXV_PerfDiag_MFOP}, read-nv-data=NeVLDR_Cnt_OEXV_PerfDiag_MFOP.NeVLDR_Cnt_OEXV_PerfDiag_MFOP}
          {nv-ram-block-element=autosar-variable-in-impl-datatype={root-variable-data-prototype=ExpendableNonVolatile_RamBlock_Core4, target-data-prototype=ExpendableNonVolatile_Ram_Core4/NeVLDR_Cnt_OEXV_PerfDiag_MFOP}, written-nv-data=NeVLDR_Cnt_OEXV_PerfDiag_MFOP_Rx.NeVLDR_Cnt_OEXV_PerfDiag_MFOP}
          {nv-ram-block-element=autosar-variable-in-impl-datatype={root-variable-data-prototype=ExpendableNonVolatile_RamBlock_Core4, target-data-prototype=ExpendableNonVolatile_Ram_Core4/NePWDR_Cnt_HVOverVoltWarnMSOF}, read-nv-data=NePWDR_Cnt_HVOverVoltWarnMSOF.NePWDR_Cnt_HVOverVoltWarnMSOF}
          {nv-ram-block-element=autosar-variable-in-impl-datatype={root-variable-data-prototype=ExpendableNonVolatile_RamBlock_Core4, target-data-prototype=ExpendableNonVolatile_Ram_Core4/NePWDR_Cnt_HVOverVoltWarnMSOF}, written-nv-data=NePWDR_Cnt_HVOverVoltWarnMSOF_Rx.NePWDR_Cnt_HVOverVoltWarnMSOF}
          {nv-ram-block-element=autosar-variable-in-impl-datatype={root-variable-data-prototype=ExpendableNonVolatile_RamBlock_Core4, target-data-prototype=ExpendableNonVolatile_Ram_Core4/NeTHDR_Cnt_OEXV_In_MFOP}, read-nv-data=NeTHDR_Cnt_OEXV_In_MFOP.NeTHDR_Cnt_OEXV_In_MFOP}
          {nv-ram-block-element=autosar-variable-in-impl-datatype={root-variable-data-prototype=ExpendableNonVolatile_RamBlock_Core4, target-data-prototype=ExpendableNonVolatile_Ram_Core4/NeTHDR_Cnt_OEXV_In_MFOP}, written-nv-data=NeTHDR_Cnt_OEXV_In_MFOP_Rx.NeTHDR_Cnt_OEXV_In_MFOP}
          {nv-ram-block-element=autosar-variable-in-impl-datatype={root-variable-data-prototype=ExpendableNonVolatile_RamBlock_Core4, target-data-prototype=ExpendableNonVolatile_Ram_Core4/NePWDR_Cnt_HVUnderVoltFailureMSOF}, read-nv-data=NePWDR_Cnt_HVUnderVoltFailureMSOF.NePWDR_Cnt_HVUnderVoltFailureMSOF}
          {nv-ram-block-element=autosar-variable-in-impl-datatype={root-variable-data-prototype=ExpendableNonVolatile_RamBlock_Core4, target-data-prototype=ExpendableNonVolatile_Ram_Core4/NePWDR_Cnt_HVUnderVoltFailureMSOF}, written-nv-data=NePWDR_Cnt_HVUnderVoltFailureMSOF_Rx.NePWDR_Cnt_HVUnderVoltFailureMSOF}
          {nv-ram-block-element=autosar-variable-in-impl-datatype={root-variable-data-prototype=ExpendableNonVolatile_RamBlock_Core4, target-data-prototype=ExpendableNonVolatile_Ram_Core4/NeTHDR_Cnt_InTmpSns_MFOP}, read-nv-data=NeTHDR_Cnt_InTmpSns_MFOP.NeTHDR_Cnt_InTmpSns_MFOP}
          {nv-ram-block-element=autosar-variable-in-impl-datatype={root-variable-data-prototype=ExpendableNonVolatile_RamBlock_Core4, target-data-prototype=ExpendableNonVolatile_Ram_Core4/NeTHDR_Cnt_InTmpSns_MFOP}, written-nv-data=NeTHDR_Cnt_InTmpSns_MFOP_Rx.NeTHDR_Cnt_InTmpSns_MFOP}
          {nv-ram-block-element=autosar-variable-in-impl-datatype={root-variable-data-prototype=ExpendableNonVolatile_RamBlock_Core4, target-data-prototype=ExpendableNonVolatile_Ram_Core4/NeTHDR_Cnt_HTAP_MFOP}, read-nv-data=NeTHDR_Cnt_HTAP_MFOP.NeTHDR_Cnt_HTAP_MFOP}
          {nv-ram-block-element=autosar-variable-in-impl-datatype={root-variable-data-prototype=ExpendableNonVolatile_RamBlock_Core4, target-data-prototype=ExpendableNonVolatile_Ram_Core4/NeTHDR_Cnt_HTAP_MFOP}, written-nv-data=NeTHDR_Cnt_HTAP_MFOP_Rx.NeTHDR_Cnt_HTAP_MFOP}
          {nv-ram-block-element=autosar-variable-in-impl-datatype={root-variable-data-prototype=ExpendableNonVolatile_RamBlock_Core4, target-data-prototype=ExpendableNonVolatile_Ram_Core4/NeTHDR_Cnt_HCCTOS_MFOP}, read-nv-data=NeTHDR_Cnt_HCCTOS_MFOP.NeTHDR_Cnt_HCCTOS_MFOP}
          {nv-ram-block-element=autosar-variable-in-impl-datatype={root-variable-data-prototype=ExpendableNonVolatile_RamBlock_Core4, target-data-prototype=ExpendableNonVolatile_Ram_Core4/NeTHDR_Cnt_HCCTOS_MFOP}, written-nv-data=NeTHDR_Cnt_HCCTOS_MFOP_Rx.NeTHDR_Cnt_HCCTOS_MFOP}
          {nv-ram-block-element=autosar-variable-in-impl-datatype={root-variable-data-prototype=ExpendableNonVolatile_RamBlock_Core4, target-data-prototype=ExpendableNonVolatile_Ram_Core4/NeSCPR_e_NxtSchCH_StrtDay}, read-nv-data=NeSCPR_e_NxtSchCH_StrtDay.NeSCPR_e_NxtSchCH_StrtDay}
          {nv-ram-block-element=autosar-variable-in-impl-datatype={root-variable-data-prototype=ExpendableNonVolatile_RamBlock_Core4, target-data-prototype=ExpendableNonVolatile_Ram_Core4/NeSCPR_e_NxtSchCH_StrtDay}, written-nv-data=NeSCPR_e_NxtSchCH_StrtDay_Rx.NeSCPR_e_NxtSchCH_StrtDay}
          {nv-ram-block-element=autosar-variable-in-impl-datatype={root-variable-data-prototype=ExpendableNonVolatile_RamBlock_Core4, target-data-prototype=ExpendableNonVolatile_Ram_Core4/NeSCPR_e_NxtSchCH_EndMin}, read-nv-data=NeSCPR_e_NxtSchCH_EndMin.NeSCPR_e_NxtSchCH_EndMin}
          {nv-ram-block-element=autosar-variable-in-impl-datatype={root-variable-data-prototype=ExpendableNonVolatile_RamBlock_Core4, target-data-prototype=ExpendableNonVolatile_Ram_Core4/NeSCPR_e_NxtSchCH_EndMin}, written-nv-data=NeSCPR_e_NxtSchCH_EndMin_Rx.NeSCPR_e_NxtSchCH_EndMin}
          {nv-ram-block-element=autosar-variable-in-impl-datatype={root-variable-data-prototype=ExpendableNonVolatile_RamBlock_Core4, target-data-prototype=ExpendableNonVolatile_Ram_Core4/NeSCPR_e_NxtSchCH_StrtMin}, read-nv-data=NeSCPR_e_NxtSchCH_StrtMin.NeSCPR_e_NxtSchCH_StrtMin}
          {nv-ram-block-element=autosar-variable-in-impl-datatype={root-variable-data-prototype=ExpendableNonVolatile_RamBlock_Core4, target-data-prototype=ExpendableNonVolatile_Ram_Core4/NeSCPR_e_NxtSchCH_StrtMin}, written-nv-data=NeSCPR_e_NxtSchCH_StrtMin_Rx.NeSCPR_e_NxtSchCH_StrtMin}
          {nv-ram-block-element=autosar-variable-in-impl-datatype={root-variable-data-prototype=ExpendableNonVolatile_RamBlock_Core4, target-data-prototype=ExpendableNonVolatile_Ram_Core4/NeSCPR_e_NxtSchCH_EndHr}, read-nv-data=NeSCPR_e_NxtSchCH_EndHr.NeSCPR_e_NxtSchCH_EndHr}
          {nv-ram-block-element=autosar-variable-in-impl-datatype={root-variable-data-prototype=ExpendableNonVolatile_RamBlock_Core4, target-data-prototype=ExpendableNonVolatile_Ram_Core4/NeSCPR_e_NxtSchCH_EndHr}, written-nv-data=NeSCPR_e_NxtSchCH_EndHr_Rx.NeSCPR_e_NxtSchCH_EndHr}
          {nv-ram-block-element=autosar-variable-in-impl-datatype={root-variable-data-prototype=ExpendableNonVolatile_RamBlock_Core4, target-data-prototype=ExpendableNonVolatile_Ram_Core4/NeSCPR_e_NxtSchCH_EndDay}, read-nv-data=NeSCPR_e_NxtSchCH_EndDay.NeSCPR_e_NxtSchCH_EndDay}
          {nv-ram-block-element=autosar-variable-in-impl-datatype={root-variable-data-prototype=ExpendableNonVolatile_RamBlock_Core4, target-data-prototype=ExpendableNonVolatile_Ram_Core4/NeSCPR_e_NxtSchCH_EndDay}, written-nv-data=NeSCPR_e_NxtSchCH_EndDay_Rx.NeSCPR_e_NxtSchCH_EndDay}
          {nv-ram-block-element=autosar-variable-in-impl-datatype={root-variable-data-prototype=ExpendableNonVolatile_RamBlock_Core4, target-data-prototype=ExpendableNonVolatile_Ram_Core4/NeSCPR_e_LastNowIndex}, read-nv-data=NeSCPR_e_LastNowIndex.NeSCPR_e_LastNowIndex}
          {nv-ram-block-element=autosar-variable-in-impl-datatype={root-variable-data-prototype=ExpendableNonVolatile_RamBlock_Core4, target-data-prototype=ExpendableNonVolatile_Ram_Core4/NeSCPR_e_LastNowIndex}, written-nv-data=NeSCPR_e_LastNowIndex_Rx.NeSCPR_e_LastNowIndex}
          {nv-ram-block-element=autosar-variable-in-impl-datatype={root-variable-data-prototype=ExpendableNonVolatile_RamBlock_Core4, target-data-prototype=ExpendableNonVolatile_Ram_Core4/NeSCPR_e_EndIndexCanc}, read-nv-data=NeSCPR_e_EndIndexCanc.NeSCPR_e_EndIndexCanc}
          {nv-ram-block-element=autosar-variable-in-impl-datatype={root-variable-data-prototype=ExpendableNonVolatile_RamBlock_Core4, target-data-prototype=ExpendableNonVolatile_Ram_Core4/NeSCPR_e_EndIndexCanc}, written-nv-data=NeSCPR_e_EndIndexCanc_Rx.NeSCPR_e_EndIndexCanc}
          {nv-ram-block-element=autosar-variable-in-impl-datatype={root-variable-data-prototype=ExpendableNonVolatile_RamBlock_Core4, target-data-prototype=ExpendableNonVolatile_Ram_Core4/NeSCPR_e_CancelStartIndx}, read-nv-data=NeSCPR_e_CancelStartIndx.NeSCPR_e_CancelStartIndx}
          {nv-ram-block-element=autosar-variable-in-impl-datatype={root-variable-data-prototype=ExpendableNonVolatile_RamBlock_Core4, target-data-prototype=ExpendableNonVolatile_Ram_Core4/NeSCPR_e_CancelStartIndx}, written-nv-data=NeSCPR_e_CancelStartIndx_Rx.NeSCPR_e_CancelStartIndx}
          {nv-ram-block-element=autosar-variable-in-impl-datatype={root-variable-data-prototype=ExpendableNonVolatile_RamBlock_Core4, target-data-prototype=ExpendableNonVolatile_Ram_Core4/NeSCPR_e_CancStartIdxHold}, read-nv-data=NeSCPR_e_CancStartIdxHold.NeSCPR_e_CancStartIdxHold}
          {nv-ram-block-element=autosar-variable-in-impl-datatype={root-variable-data-prototype=ExpendableNonVolatile_RamBlock_Core4, target-data-prototype=ExpendableNonVolatile_Ram_Core4/NeSCPR_e_CancStartIdxHold}, written-nv-data=NeSCPR_e_CancStartIdxHold_Rx.NeSCPR_e_CancStartIdxHold}
          {nv-ram-block-element=autosar-variable-in-impl-datatype={root-variable-data-prototype=ExpendableNonVolatile_RamBlock_Core4, target-data-prototype=ExpendableNonVolatile_Ram_Core4/NeSCPR_e_NxtSchCH_StrtHr}, read-nv-data=NeSCPR_e_NxtSchCH_StrtHr.NeSCPR_e_NxtSchCH_StrtHr}
          {nv-ram-block-element=autosar-variable-in-impl-datatype={root-variable-data-prototype=ExpendableNonVolatile_RamBlock_Core4, target-data-prototype=ExpendableNonVolatile_Ram_Core4/NeSCPR_e_NxtSchCH_StrtHr}, written-nv-data=NeSCPR_e_NxtSchCH_StrtHr_Rx.NeSCPR_e_NxtSchCH_StrtHr}
          {nv-ram-block-element=autosar-variable-in-impl-datatype={root-variable-data-prototype=ExpendableNonVolatile_RamBlock_Core4, target-data-prototype=ExpendableNonVolatile_Ram_Core4/NeSCPR_e_Sch2CoCH_StopMin}, read-nv-data=NeSCPR_e_Sch2CoCH_StopMin.NeSCPR_e_Sch2CoCH_StopMin}
          {nv-ram-block-element=autosar-variable-in-impl-datatype={root-variable-data-prototype=ExpendableNonVolatile_RamBlock_Core4, target-data-prototype=ExpendableNonVolatile_Ram_Core4/NeSCPR_e_Sch2CoCH_StopMin}, written-nv-data=NeSCPR_e_Sch2CoCH_StopMin_Rx.NeSCPR_e_Sch2CoCH_StopMin}
          {nv-ram-block-element=autosar-variable-in-impl-datatype={root-variable-data-prototype=ExpendableNonVolatile_RamBlock_Core4, target-data-prototype=ExpendableNonVolatile_Ram_Core4/NeTHDR_Cnt_OEXV_Out_MFOP}, read-nv-data=NeTHDR_Cnt_OEXV_Out_MFOP.NeTHDR_Cnt_OEXV_Out_MFOP}
          {nv-ram-block-element=autosar-variable-in-impl-datatype={root-variable-data-prototype=ExpendableNonVolatile_RamBlock_Core4, target-data-prototype=ExpendableNonVolatile_Ram_Core4/NeTHDR_Cnt_OEXV_Out_MFOP}, written-nv-data=NeTHDR_Cnt_OEXV_Out_MFOP_Rx.NeTHDR_Cnt_OEXV_Out_MFOP}
          {nv-ram-block-element=autosar-variable-in-impl-datatype={root-variable-data-prototype=ExpendableNonVolatile_RamBlock_Core4, target-data-prototype=ExpendableNonVolatile_Ram_Core4/NeTHDR_Cnt_OOCTOS_MFOP}, read-nv-data=NeTHDR_Cnt_OOCTOS_MFOP.NeTHDR_Cnt_OOCTOS_MFOP}
          {nv-ram-block-element=autosar-variable-in-impl-datatype={root-variable-data-prototype=ExpendableNonVolatile_RamBlock_Core4, target-data-prototype=ExpendableNonVolatile_Ram_Core4/NeTHDR_Cnt_OOCTOS_MFOP}, written-nv-data=NeTHDR_Cnt_OOCTOS_MFOP_Rx.NeTHDR_Cnt_OOCTOS_MFOP}
          {nv-ram-block-element=autosar-variable-in-impl-datatype={root-variable-data-prototype=ExpendableNonVolatile_RamBlock_Core4, target-data-prototype=ExpendableNonVolatile_Ram_Core4/NeTHDR_Cnt_PPCTIS_MFOP}, read-nv-data=NeTHDR_Cnt_PPCTIS_MFOP.NeTHDR_Cnt_PPCTIS_MFOP}
          {nv-ram-block-element=autosar-variable-in-impl-datatype={root-variable-data-prototype=ExpendableNonVolatile_RamBlock_Core4, target-data-prototype=ExpendableNonVolatile_Ram_Core4/NeTHDR_Cnt_PPCTIS_MFOP}, written-nv-data=NeTHDR_Cnt_PPCTIS_MFOP_Rx.NeTHDR_Cnt_PPCTIS_MFOP}
          {nv-ram-block-element=autosar-variable-in-impl-datatype={root-variable-data-prototype=ExpendableNonVolatile_RamBlock_Core4, target-data-prototype=ExpendableNonVolatile_Ram_Core4/NeTHDR_Cnt_PPCTIS_OT_MSOP}, read-nv-data=NeTHDR_Cnt_PPCTIS_OT_MSOP.NeTHDR_Cnt_PPCTIS_OT_MSOP}
          {nv-ram-block-element=autosar-variable-in-impl-datatype={root-variable-data-prototype=ExpendableNonVolatile_RamBlock_Core4, target-data-prototype=ExpendableNonVolatile_Ram_Core4/NeTHDR_Cnt_PPCTIS_OT_MSOP}, written-nv-data=NeTHDR_Cnt_PPCTIS_OT_MSOP_Rx.NeTHDR_Cnt_PPCTIS_OT_MSOP}
          {nv-ram-block-element=autosar-variable-in-impl-datatype={root-variable-data-prototype=ExpendableNonVolatile_RamBlock_Core4, target-data-prototype=ExpendableNonVolatile_Ram_Core4/NeTHDR_Cnt_LTPP2_MFOP}, read-nv-data=NeTHDR_Cnt_LTPP2_MFOP.NeTHDR_Cnt_LTPP2_MFOP}
          {nv-ram-block-element=autosar-variable-in-impl-datatype={root-variable-data-prototype=ExpendableNonVolatile_RamBlock_Core4, target-data-prototype=ExpendableNonVolatile_Ram_Core4/NeTHDR_Cnt_LTPP2_MFOP}, written-nv-data=NeTHDR_Cnt_LTPP2_MFOP_Rx.NeTHDR_Cnt_LTPP2_MFOP}
          {nv-ram-block-element=autosar-variable-in-impl-datatype={root-variable-data-prototype=ExpendableNonVolatile_RamBlock_Core4, target-data-prototype=ExpendableNonVolatile_Ram_Core4/NeTHDR_Cnt_LRCTOS_MFOP}, read-nv-data=NeTHDR_Cnt_LRCTOS_MFOP.NeTHDR_Cnt_LRCTOS_MFOP}
          {nv-ram-block-element=autosar-variable-in-impl-datatype={root-variable-data-prototype=ExpendableNonVolatile_RamBlock_Core4, target-data-prototype=ExpendableNonVolatile_Ram_Core4/NeTHDR_Cnt_LRCTOS_MFOP}, written-nv-data=NeTHDR_Cnt_LRCTOS_MFOP_Rx.NeTHDR_Cnt_LRCTOS_MFOP}
          {nv-ram-block-element=autosar-variable-in-impl-datatype={root-variable-data-prototype=ExpendableNonVolatile_RamBlock_Core4, target-data-prototype=ExpendableNonVolatile_Ram_Core4/NeTIDR_Cnt_EngTrqHiFlt_MFOP}, read-nv-data=NeTIDR_Cnt_EngTrqHiFlt_MFOP.NeTIDR_Cnt_EngTrqHiFlt_MFOP}
          {nv-ram-block-element=autosar-variable-in-impl-datatype={root-variable-data-prototype=ExpendableNonVolatile_RamBlock_Core4, target-data-prototype=ExpendableNonVolatile_Ram_Core4/NeTIDR_Cnt_EngTrqHiFlt_MFOP}, written-nv-data=NeTIDR_Cnt_EngTrqHiFlt_MFOP_Rx.NeTIDR_Cnt_EngTrqHiFlt_MFOP}
          {nv-ram-block-element=autosar-variable-in-impl-datatype={root-variable-data-prototype=ExpendableNonVolatile_RamBlock_Core4, target-data-prototype=ExpendableNonVolatile_Ram_Core4/NeTIDR_Cnt_EngTrqHiFlt_MSOF}, read-nv-data=NeTIDR_Cnt_EngTrqHiFlt_MSOF.NeTIDR_Cnt_EngTrqHiFlt_MSOF}
          {nv-ram-block-element=autosar-variable-in-impl-datatype={root-variable-data-prototype=ExpendableNonVolatile_RamBlock_Core4, target-data-prototype=ExpendableNonVolatile_Ram_Core4/NeTIDR_Cnt_EngTrqHiFlt_MSOF}, written-nv-data=NeTIDR_Cnt_EngTrqHiFlt_MSOF_Rx.NeTIDR_Cnt_EngTrqHiFlt_MSOF}
          {nv-ram-block-element=autosar-variable-in-impl-datatype={root-variable-data-prototype=ExpendableNonVolatile_RamBlock_Core4, target-data-prototype=ExpendableNonVolatile_Ram_Core4/NeSCPR_e_Sch2CoCH_StopHr}, read-nv-data=NeSCPR_e_Sch2CoCH_StopHr.NeSCPR_e_Sch2CoCH_StopHr}
          {nv-ram-block-element=autosar-variable-in-impl-datatype={root-variable-data-prototype=ExpendableNonVolatile_RamBlock_Core4, target-data-prototype=ExpendableNonVolatile_Ram_Core4/NeSCPR_e_Sch2CoCH_StopHr}, written-nv-data=NeSCPR_e_Sch2CoCH_StopHr_Rx.NeSCPR_e_Sch2CoCH_StopHr}
          {nv-ram-block-element=autosar-variable-in-impl-datatype={root-variable-data-prototype=ExpendableNonVolatile_RamBlock_Core4, target-data-prototype=ExpendableNonVolatile_Ram_Core4/NeTISD_Cnt_SpdRatlFlt_MFOP}, read-nv-data=NeTISD_Cnt_SpdRatlFlt_MFOP.NeTISD_Cnt_SpdRatlFlt_MFOP}
          {nv-ram-block-element=autosar-variable-in-impl-datatype={root-variable-data-prototype=ExpendableNonVolatile_RamBlock_Core4, target-data-prototype=ExpendableNonVolatile_Ram_Core4/NeTISD_Cnt_SpdRatlFlt_MFOP}, written-nv-data=NeTISD_Cnt_SpdRatlFlt_MFOP_Rx.NeTISD_Cnt_SpdRatlFlt_MFOP}
          {nv-ram-block-element=autosar-variable-in-impl-datatype={root-variable-data-prototype=ExpendableNonVolatile_RamBlock_Core4, target-data-prototype=ExpendableNonVolatile_Ram_Core4/NeSCPR_e_Sch1CoCH_StopMin}, read-nv-data=NeSCPR_e_Sch1CoCH_StopMin.NeSCPR_e_Sch1CoCH_StopMin}
          {nv-ram-block-element=autosar-variable-in-impl-datatype={root-variable-data-prototype=ExpendableNonVolatile_RamBlock_Core4, target-data-prototype=ExpendableNonVolatile_Ram_Core4/NeSCPR_e_Sch1CoCH_StopMin}, written-nv-data=NeSCPR_e_Sch1CoCH_StopMin_Rx.NeSCPR_e_Sch1CoCH_StopMin}
          {nv-ram-block-element=autosar-variable-in-impl-datatype={root-variable-data-prototype=ExpendableNonVolatile_RamBlock_Core4, target-data-prototype=ExpendableNonVolatile_Ram_Core4/NeSCPR_e_Sch1CoCH_StopHr}, read-nv-data=NeSCPR_e_Sch1CoCH_StopHr.NeSCPR_e_Sch1CoCH_StopHr}
          {nv-ram-block-element=autosar-variable-in-impl-datatype={root-variable-data-prototype=ExpendableNonVolatile_RamBlock_Core4, target-data-prototype=ExpendableNonVolatile_Ram_Core4/NeSCPR_e_Sch1CoCH_StopHr}, written-nv-data=NeSCPR_e_Sch1CoCH_StopHr_Rx.NeSCPR_e_Sch1CoCH_StopHr}
          {nv-ram-block-element=autosar-variable-in-impl-datatype={root-variable-data-prototype=ExpendableNonVolatile_RamBlock_Core4, target-data-prototype=ExpendableNonVolatile_Ram_Core4/NeTIDR_Cnt_EngTrqLoFlt_MFOP}, read-nv-data=NeTIDR_Cnt_EngTrqLoFlt_MFOP.NeTIDR_Cnt_EngTrqLoFlt_MFOP}
          {nv-ram-block-element=autosar-variable-in-impl-datatype={root-variable-data-prototype=ExpendableNonVolatile_RamBlock_Core4, target-data-prototype=ExpendableNonVolatile_Ram_Core4/NeTIDR_Cnt_EngTrqLoFlt_MFOP}, written-nv-data=NeTIDR_Cnt_EngTrqLoFlt_MFOP_Rx.NeTIDR_Cnt_EngTrqLoFlt_MFOP}
          {nv-ram-block-element=autosar-variable-in-impl-datatype={root-variable-data-prototype=ExpendableNonVolatile_RamBlock_Core4, target-data-prototype=ExpendableNonVolatile_Ram_Core4/NeTIDR_Cnt_EngTrqLoFlt_MSOF}, read-nv-data=NeTIDR_Cnt_EngTrqLoFlt_MSOF.NeTIDR_Cnt_EngTrqLoFlt_MSOF}
          {nv-ram-block-element=autosar-variable-in-impl-datatype={root-variable-data-prototype=ExpendableNonVolatile_RamBlock_Core4, target-data-prototype=ExpendableNonVolatile_Ram_Core4/NeTIDR_Cnt_EngTrqLoFlt_MSOF}, written-nv-data=NeTIDR_Cnt_EngTrqLoFlt_MSOF_Rx.NeTIDR_Cnt_EngTrqLoFlt_MSOF}
          {nv-ram-block-element=autosar-variable-in-impl-datatype={root-variable-data-prototype=ExpendableNonVolatile_RamBlock_Core4, target-data-prototype=ExpendableNonVolatile_Ram_Core4/NeTIMR_e_TrrnMdSt}, read-nv-data=NeTIMR_e_TrrnMdSt.NeTIMR_e_TrrnMdSt}
          {nv-ram-block-element=autosar-variable-in-impl-datatype={root-variable-data-prototype=ExpendableNonVolatile_RamBlock_Core4, target-data-prototype=ExpendableNonVolatile_Ram_Core4/NeTIMR_e_TrrnMdSt}, written-nv-data=NeTIMR_e_TrrnMdSt_Rx.NeTIMR_e_TrrnMdSt}
          {nv-ram-block-element=autosar-variable-in-impl-datatype={root-variable-data-prototype=ExpendableNonVolatile_RamBlock_Core4, target-data-prototype=ExpendableNonVolatile_Ram_Core4/NeSCPR_e_NxtSchCP_StrtMin}, read-nv-data=NeSCPR_e_NxtSchCP_StrtMin.NeSCPR_e_NxtSchCP_StrtMin}
          {nv-ram-block-element=autosar-variable-in-impl-datatype={root-variable-data-prototype=ExpendableNonVolatile_RamBlock_Core4, target-data-prototype=ExpendableNonVolatile_Ram_Core4/NeSCPR_e_NxtSchCP_StrtMin}, written-nv-data=NeSCPR_e_NxtSchCP_StrtMin_Rx.NeSCPR_e_NxtSchCP_StrtMin}
          {nv-ram-block-element=autosar-variable-in-impl-datatype={root-variable-data-prototype=ExpendableNonVolatile_RamBlock_Core4, target-data-prototype=ExpendableNonVolatile_Ram_Core4/NeSCPR_e_NxtSchCP_StrtHr}, read-nv-data=NeSCPR_e_NxtSchCP_StrtHr.NeSCPR_e_NxtSchCP_StrtHr}
          {nv-ram-block-element=autosar-variable-in-impl-datatype={root-variable-data-prototype=ExpendableNonVolatile_RamBlock_Core4, target-data-prototype=ExpendableNonVolatile_Ram_Core4/NeSCPR_e_NxtSchCP_StrtHr}, written-nv-data=NeSCPR_e_NxtSchCP_StrtHr_Rx.NeSCPR_e_NxtSchCP_StrtHr}
          {nv-ram-block-element=autosar-variable-in-impl-datatype={root-variable-data-prototype=ExpendableNonVolatile_RamBlock_Core4, target-data-prototype=ExpendableNonVolatile_Ram_Core4/NeSCPR_e_NxtSchCP_Day}, read-nv-data=NeSCPR_e_NxtSchCP_Day.NeSCPR_e_NxtSchCP_Day}
          {nv-ram-block-element=autosar-variable-in-impl-datatype={root-variable-data-prototype=ExpendableNonVolatile_RamBlock_Core4, target-data-prototype=ExpendableNonVolatile_Ram_Core4/NeSCPR_e_NxtSchCP_Day}, written-nv-data=NeSCPR_e_NxtSchCP_Day_Rx.NeSCPR_e_NxtSchCP_Day}
          {nv-ram-block-element=autosar-variable-in-impl-datatype={root-variable-data-prototype=ExpendableNonVolatile_RamBlock_Core4, target-data-prototype=ExpendableNonVolatile_Ram_Core4/NeTHDR_Cnt_HCCTIS_MFOP}, read-nv-data=NeTHDR_Cnt_HCCTIS_MFOP.NeTHDR_Cnt_HCCTIS_MFOP}
          {nv-ram-block-element=autosar-variable-in-impl-datatype={root-variable-data-prototype=ExpendableNonVolatile_RamBlock_Core4, target-data-prototype=ExpendableNonVolatile_Ram_Core4/NeTHDR_Cnt_HCCTIS_MFOP}, written-nv-data=NeTHDR_Cnt_HCCTIS_MFOP_Rx.NeTHDR_Cnt_HCCTIS_MFOP}
          {nv-ram-block-element=autosar-variable-in-impl-datatype={root-variable-data-prototype=ExpendableNonVolatile_RamBlock_Core4, target-data-prototype=ExpendableNonVolatile_Ram_Core4/NeTHDR_Cnt_LTPP_MFOP}, read-nv-data=NeTHDR_Cnt_LTPP_MFOP.NeTHDR_Cnt_LTPP_MFOP}
          {nv-ram-block-element=autosar-variable-in-impl-datatype={root-variable-data-prototype=ExpendableNonVolatile_RamBlock_Core4, target-data-prototype=ExpendableNonVolatile_Ram_Core4/NeTHDR_Cnt_LTPP_MFOP}, written-nv-data=NeTHDR_Cnt_LTPP_MFOP_Rx.NeTHDR_Cnt_LTPP_MFOP}
          {nv-ram-block-element=autosar-variable-in-impl-datatype={root-variable-data-prototype=ExpendableNonVolatile_RamBlock_Core4, target-data-prototype=ExpendableNonVolatile_Ram_Core4/NeTHDR_Cnt_AGS2_Perf_MFOP}, read-nv-data=NeTHDR_Cnt_AGS2_Perf_MFOP.NeTHDR_Cnt_AGS2_Perf_MFOP}
          {nv-ram-block-element=autosar-variable-in-impl-datatype={root-variable-data-prototype=ExpendableNonVolatile_RamBlock_Core4, target-data-prototype=ExpendableNonVolatile_Ram_Core4/NeTHDR_Cnt_AGS2_Perf_MFOP}, written-nv-data=NeTHDR_Cnt_AGS2_Perf_MFOP_Rx.NeTHDR_Cnt_AGS2_Perf_MFOP}
          {nv-ram-block-element=autosar-variable-in-impl-datatype={root-variable-data-prototype=ExpendableNonVolatile_RamBlock_Core4, target-data-prototype=ExpendableNonVolatile_Ram_Core4/NePWDR_Cnt_StuckHiFOP}, read-nv-data=NePWDR_Cnt_StuckHiFOP.NePWDR_Cnt_StuckHiFOP}
          {nv-ram-block-element=autosar-variable-in-impl-datatype={root-variable-data-prototype=ExpendableNonVolatile_RamBlock_Core4, target-data-prototype=ExpendableNonVolatile_Ram_Core4/NePWDR_Cnt_StuckHiFOP}, written-nv-data=NePWDR_Cnt_StuckHiFOP_Rx.NePWDR_Cnt_StuckHiFOP}
          {nv-ram-block-element=autosar-variable-in-impl-datatype={root-variable-data-prototype=ExpendableNonVolatile_RamBlock_Core4, target-data-prototype=ExpendableNonVolatile_Ram_Core4/NePWDR_Cnt_SOCLowWarnMFOP}, read-nv-data=NePWDR_Cnt_SOCLowWarnMFOP.NePWDR_Cnt_SOCLowWarnMFOP}
          {nv-ram-block-element=autosar-variable-in-impl-datatype={root-variable-data-prototype=ExpendableNonVolatile_RamBlock_Core4, target-data-prototype=ExpendableNonVolatile_Ram_Core4/NePWDR_Cnt_SOCLowWarnMFOP}, written-nv-data=NePWDR_Cnt_SOCLowWarnMFOP_Rx.NePWDR_Cnt_SOCLowWarnMFOP}
          {nv-ram-block-element=autosar-variable-in-impl-datatype={root-variable-data-prototype=ExpendableNonVolatile_RamBlock_Core4, target-data-prototype=ExpendableNonVolatile_Ram_Core4/NePWDR_Cnt_SOCLowFailureMFOP}, read-nv-data=NePWDR_Cnt_SOCLowFailureMFOP.NePWDR_Cnt_SOCLowFailureMFOP}
          {nv-ram-block-element=autosar-variable-in-impl-datatype={root-variable-data-prototype=ExpendableNonVolatile_RamBlock_Core4, target-data-prototype=ExpendableNonVolatile_Ram_Core4/NePWDR_Cnt_SOCLowFailureMFOP}, written-nv-data=NePWDR_Cnt_SOCLowFailureMFOP_Rx.NePWDR_Cnt_SOCLowFailureMFOP}
          {nv-ram-block-element=autosar-variable-in-impl-datatype={root-variable-data-prototype=ExpendableNonVolatile_RamBlock_Core4, target-data-prototype=ExpendableNonVolatile_Ram_Core4/NePWDR_Cnt_SOCHighWarnMFOP}, read-nv-data=NePWDR_Cnt_SOCHighWarnMFOP.NePWDR_Cnt_SOCHighWarnMFOP}
          {nv-ram-block-element=autosar-variable-in-impl-datatype={root-variable-data-prototype=ExpendableNonVolatile_RamBlock_Core4, target-data-prototype=ExpendableNonVolatile_Ram_Core4/NePWDR_Cnt_SOCHighWarnMFOP}, written-nv-data=NePWDR_Cnt_SOCHighWarnMFOP_Rx.NePWDR_Cnt_SOCHighWarnMFOP}
          {nv-ram-block-element=autosar-variable-in-impl-datatype={root-variable-data-prototype=ExpendableNonVolatile_RamBlock_Core4, target-data-prototype=ExpendableNonVolatile_Ram_Core4/NePWDR_Cnt_SOCHighFailureMFOP}, read-nv-data=NePWDR_Cnt_SOCHighFailureMFOP.NePWDR_Cnt_SOCHighFailureMFOP}
          {nv-ram-block-element=autosar-variable-in-impl-datatype={root-variable-data-prototype=ExpendableNonVolatile_RamBlock_Core4, target-data-prototype=ExpendableNonVolatile_Ram_Core4/NePWDR_Cnt_SOCHighFailureMFOP}, written-nv-data=NePWDR_Cnt_SOCHighFailureMFOP_Rx.NePWDR_Cnt_SOCHighFailureMFOP}
          {nv-ram-block-element=autosar-variable-in-impl-datatype={root-variable-data-prototype=ExpendableNonVolatile_RamBlock_Core4, target-data-prototype=ExpendableNonVolatile_Ram_Core4/NePWDR_Cnt_MsmtchLowFOP}, read-nv-data=NePWDR_Cnt_MsmtchLowFOP.NePWDR_Cnt_MsmtchLowFOP}
          {nv-ram-block-element=autosar-variable-in-impl-datatype={root-variable-data-prototype=ExpendableNonVolatile_RamBlock_Core4, target-data-prototype=ExpendableNonVolatile_Ram_Core4/NePWDR_Cnt_MsmtchLowFOP}, written-nv-data=NePWDR_Cnt_MsmtchLowFOP_Rx.NePWDR_Cnt_MsmtchLowFOP}
          {nv-ram-block-element=autosar-variable-in-impl-datatype={root-variable-data-prototype=ExpendableNonVolatile_RamBlock_Core4, target-data-prototype=ExpendableNonVolatile_Ram_Core4/NePWDR_Cnt_HVUnderVoltWarnMSOF}, read-nv-data=NePWDR_Cnt_HVUnderVoltWarnMSOF.NePWDR_Cnt_HVUnderVoltWarnMSOF}
          {nv-ram-block-element=autosar-variable-in-impl-datatype={root-variable-data-prototype=ExpendableNonVolatile_RamBlock_Core4, target-data-prototype=ExpendableNonVolatile_Ram_Core4/NePWDR_Cnt_HVUnderVoltWarnMSOF}, written-nv-data=NePWDR_Cnt_HVUnderVoltWarnMSOF_Rx.NePWDR_Cnt_HVUnderVoltWarnMSOF}
          {nv-ram-block-element=autosar-variable-in-impl-datatype={root-variable-data-prototype=ExpendableNonVolatile_RamBlock_Core4, target-data-prototype=ExpendableNonVolatile_Ram_Core4/NeTHDR_Cnt_AGS_Perf_MFOP}, read-nv-data=NeTHDR_Cnt_AGS_Perf_MFOP.NeTHDR_Cnt_AGS_Perf_MFOP}
          {nv-ram-block-element=autosar-variable-in-impl-datatype={root-variable-data-prototype=ExpendableNonVolatile_RamBlock_Core4, target-data-prototype=ExpendableNonVolatile_Ram_Core4/NeTHDR_Cnt_AGS_Perf_MFOP}, written-nv-data=NeTHDR_Cnt_AGS_Perf_MFOP_Rx.NeTHDR_Cnt_AGS_Perf_MFOP}
          {nv-ram-block-element=autosar-variable-in-impl-datatype={root-variable-data-prototype=ExpendableNonVolatile_RamBlock_Core4, target-data-prototype=ExpendableNonVolatile_Ram_Core4/NeTHDR_Cnt_EEXV_Out_MFOP}, read-nv-data=NeTHDR_Cnt_EEXV_Out_MFOP.NeTHDR_Cnt_EEXV_Out_MFOP}
          {nv-ram-block-element=autosar-variable-in-impl-datatype={root-variable-data-prototype=ExpendableNonVolatile_RamBlock_Core4, target-data-prototype=ExpendableNonVolatile_Ram_Core4/NeTHDR_Cnt_EEXV_Out_MFOP}, written-nv-data=NeTHDR_Cnt_EEXV_Out_MFOP_Rx.NeTHDR_Cnt_EEXV_Out_MFOP}
          {nv-ram-block-element=autosar-variable-in-impl-datatype={root-variable-data-prototype=ExpendableNonVolatile_RamBlock_Core4, target-data-prototype=ExpendableNonVolatile_Ram_Core4/NeTHDR_Cnt_ECH_outTmpSns_MFOP}, read-nv-data=NeTHDR_Cnt_ECH_outTmpSns_MFOP.NeTHDR_Cnt_ECH_outTmpSns_MFOP}
          {nv-ram-block-element=autosar-variable-in-impl-datatype={root-variable-data-prototype=ExpendableNonVolatile_RamBlock_Core4, target-data-prototype=ExpendableNonVolatile_Ram_Core4/NeTHDR_Cnt_ECH_outTmpSns_MFOP}, written-nv-data=NeTHDR_Cnt_ECH_outTmpSns_MFOP_Rx.NeTHDR_Cnt_ECH_outTmpSns_MFOP}
          {nv-ram-block-element=autosar-variable-in-impl-datatype={root-variable-data-prototype=ExpendableNonVolatile_RamBlock_Core4, target-data-prototype=ExpendableNonVolatile_Ram_Core4/NeTHDR_Cnt_ECHTIS_MFOP}, read-nv-data=NeTHDR_Cnt_ECHTIS_MFOP.NeTHDR_Cnt_ECHTIS_MFOP}
          {nv-ram-block-element=autosar-variable-in-impl-datatype={root-variable-data-prototype=ExpendableNonVolatile_RamBlock_Core4, target-data-prototype=ExpendableNonVolatile_Ram_Core4/NeTHDR_Cnt_ECHTIS_MFOP}, written-nv-data=NeTHDR_Cnt_ECHTIS_MFOP_Rx.NeTHDR_Cnt_ECHTIS_MFOP}
          {nv-ram-block-element=autosar-variable-in-impl-datatype={root-variable-data-prototype=ExpendableNonVolatile_RamBlock_Core4, target-data-prototype=ExpendableNonVolatile_Ram_Core4/NePWDR_Cnt_HVUnderVoltWarnMFOP}, read-nv-data=NePWDR_Cnt_HVUnderVoltWarnMFOP.NePWDR_Cnt_HVUnderVoltWarnMFOP}
          {nv-ram-block-element=autosar-variable-in-impl-datatype={root-variable-data-prototype=ExpendableNonVolatile_RamBlock_Core4, target-data-prototype=ExpendableNonVolatile_Ram_Core4/NePWDR_Cnt_HVUnderVoltWarnMFOP}, written-nv-data=NePWDR_Cnt_HVUnderVoltWarnMFOP_Rx.NePWDR_Cnt_HVUnderVoltWarnMFOP}
          {nv-ram-block-element=autosar-variable-in-impl-datatype={root-variable-data-prototype=ExpendableNonVolatile_RamBlock_Core4, target-data-prototype=ExpendableNonVolatile_Ram_Core4/NePMDD_Cnt_RunHiMaxFOP}, read-nv-data=NePMDD_Cnt_RunHiMaxFOP.NePMDD_Cnt_RunHiMaxFOP}
          {nv-ram-block-element=autosar-variable-in-impl-datatype={root-variable-data-prototype=ExpendableNonVolatile_RamBlock_Core4, target-data-prototype=ExpendableNonVolatile_Ram_Core4/NePMDD_Cnt_RunHiMaxFOP}, written-nv-data=NePMDD_Cnt_RunHiMaxFOP_Rx.NePMDD_Cnt_RunHiMaxFOP}
          {nv-ram-block-element=autosar-variable-in-impl-datatype={root-variable-data-prototype=ExpendableNonVolatile_RamBlock_Core4, target-data-prototype=ExpendableNonVolatile_Ram_Core4/NeCPDR_Cnt_LTAP_FunPer_MFOP}, read-nv-data=NeCPDR_Cnt_LTAP_FunPer_MFOP.NeCPDR_Cnt_LTAP_FunPer_MFOP}
          {nv-ram-block-element=autosar-variable-in-impl-datatype={root-variable-data-prototype=ExpendableNonVolatile_RamBlock_Core4, target-data-prototype=ExpendableNonVolatile_Ram_Core4/NeCPDR_Cnt_LTAP_FunPer_MFOP}, written-nv-data=NeCPDR_Cnt_LTAP_FunPer_MFOP_Rx.NeCPDR_Cnt_LTAP_FunPer_MFOP}
          {nv-ram-block-element=autosar-variable-in-impl-datatype={root-variable-data-prototype=ExpendableNonVolatile_RamBlock_Core4, target-data-prototype=ExpendableNonVolatile_Ram_Core4/NeCSVD_Cnt_RearAxleRatlFlt_MFOP}, read-nv-data=NeCSVD_Cnt_RearAxleRatlFlt_MFOP.NeCSVD_Cnt_RearAxleRatlFlt_MFOP}
          {nv-ram-block-element=autosar-variable-in-impl-datatype={root-variable-data-prototype=ExpendableNonVolatile_RamBlock_Core4, target-data-prototype=ExpendableNonVolatile_Ram_Core4/NeCSVD_Cnt_RearAxleRatlFlt_MFOP}, written-nv-data=NeCSVD_Cnt_RearAxleRatlFlt_MFOP_Rx.NeCSVD_Cnt_RearAxleRatlFlt_MFOP}
          {nv-ram-block-element=autosar-variable-in-impl-datatype={root-variable-data-prototype=ExpendableNonVolatile_RamBlock_Core4, target-data-prototype=ExpendableNonVolatile_Ram_Core4/NeCSVD_Cnt_FrontAxleRatlFlt_MFOP}, read-nv-data=NeCSVD_Cnt_FrontAxleRatlFlt_MFOP.NeCSVD_Cnt_FrontAxleRatlFlt_MFOP}
          {nv-ram-block-element=autosar-variable-in-impl-datatype={root-variable-data-prototype=ExpendableNonVolatile_RamBlock_Core4, target-data-prototype=ExpendableNonVolatile_Ram_Core4/NeCSVD_Cnt_FrontAxleRatlFlt_MFOP}, written-nv-data=NeCSVD_Cnt_FrontAxleRatlFlt_MFOP_Rx.NeCSVD_Cnt_FrontAxleRatlFlt_MFOP}
          {nv-ram-block-element=autosar-variable-in-impl-datatype={root-variable-data-prototype=ExpendableNonVolatile_RamBlock_Core4, target-data-prototype=ExpendableNonVolatile_Ram_Core4/NeCPDR_Cnt_LTPP_FunPer_MFOP}, read-nv-data=NeCPDR_Cnt_LTPP_FunPer_MFOP.NeCPDR_Cnt_LTPP_FunPer_MFOP}
          {nv-ram-block-element=autosar-variable-in-impl-datatype={root-variable-data-prototype=ExpendableNonVolatile_RamBlock_Core4, target-data-prototype=ExpendableNonVolatile_Ram_Core4/NeCPDR_Cnt_LTPP_FunPer_MFOP}, written-nv-data=NeCPDR_Cnt_LTPP_FunPer_MFOP_Rx.NeCPDR_Cnt_LTPP_FunPer_MFOP}
          {nv-ram-block-element=autosar-variable-in-impl-datatype={root-variable-data-prototype=ExpendableNonVolatile_RamBlock_Core4, target-data-prototype=ExpendableNonVolatile_Ram_Core4/NeCPDR_Cnt_LTPP_FunDryRun_MFOP}, read-nv-data=NeCPDR_Cnt_LTPP_FunDryRun_MFOP.NeCPDR_Cnt_LTPP_FunDryRun_MFOP}
          {nv-ram-block-element=autosar-variable-in-impl-datatype={root-variable-data-prototype=ExpendableNonVolatile_RamBlock_Core4, target-data-prototype=ExpendableNonVolatile_Ram_Core4/NeCPDR_Cnt_LTPP_FunDryRun_MFOP}, written-nv-data=NeCPDR_Cnt_LTPP_FunDryRun_MFOP_Rx.NeCPDR_Cnt_LTPP_FunDryRun_MFOP}
          {nv-ram-block-element=autosar-variable-in-impl-datatype={root-variable-data-prototype=ExpendableNonVolatile_RamBlock_Core4, target-data-prototype=ExpendableNonVolatile_Ram_Core4/NeCPDR_Cnt_LTPP2_FunPer_MFOP}, read-nv-data=NeCPDR_Cnt_LTPP2_FunPer_MFOP.NeCPDR_Cnt_LTPP2_FunPer_MFOP}
          {nv-ram-block-element=autosar-variable-in-impl-datatype={root-variable-data-prototype=ExpendableNonVolatile_RamBlock_Core4, target-data-prototype=ExpendableNonVolatile_Ram_Core4/NeCPDR_Cnt_LTPP2_FunPer_MFOP}, written-nv-data=NeCPDR_Cnt_LTPP2_FunPer_MFOP_Rx.NeCPDR_Cnt_LTPP2_FunPer_MFOP}
          {nv-ram-block-element=autosar-variable-in-impl-datatype={root-variable-data-prototype=ExpendableNonVolatile_RamBlock_Core4, target-data-prototype=ExpendableNonVolatile_Ram_Core4/NeCPDR_Cnt_LTPP2_FunDryRun_MFOP}, read-nv-data=NeCPDR_Cnt_LTPP2_FunDryRun_MFOP.NeCPDR_Cnt_LTPP2_FunDryRun_MFOP}
          {nv-ram-block-element=autosar-variable-in-impl-datatype={root-variable-data-prototype=ExpendableNonVolatile_RamBlock_Core4, target-data-prototype=ExpendableNonVolatile_Ram_Core4/NeCPDR_Cnt_LTPP2_FunDryRun_MFOP}, written-nv-data=NeCPDR_Cnt_LTPP2_FunDryRun_MFOP_Rx.NeCPDR_Cnt_LTPP2_FunDryRun_MFOP}
          {nv-ram-block-element=autosar-variable-in-impl-datatype={root-variable-data-prototype=ExpendableNonVolatile_RamBlock_Core4, target-data-prototype=ExpendableNonVolatile_Ram_Core4/NeCPDR_Cnt_LTAP_FunDryRun_MFOP}, read-nv-data=NeCPDR_Cnt_LTAP_FunDryRun_MFOP.NeCPDR_Cnt_LTAP_FunDryRun_MFOP}
          {nv-ram-block-element=autosar-variable-in-impl-datatype={root-variable-data-prototype=ExpendableNonVolatile_RamBlock_Core4, target-data-prototype=ExpendableNonVolatile_Ram_Core4/NeCPDR_Cnt_LTAP_FunDryRun_MFOP}, written-nv-data=NeCPDR_Cnt_LTAP_FunDryRun_MFOP_Rx.NeCPDR_Cnt_LTAP_FunDryRun_MFOP}
          {nv-ram-block-element=autosar-variable-in-impl-datatype={root-variable-data-prototype=ExpendableNonVolatile_RamBlock_Core4, target-data-prototype=ExpendableNonVolatile_Ram_Core4/NeDMIR_e_DriveStyleSts}, read-nv-data=NeDMIR_e_DriveStyleSts.NeDMIR_e_DriveStyleSts}
          {nv-ram-block-element=autosar-variable-in-impl-datatype={root-variable-data-prototype=ExpendableNonVolatile_RamBlock_Core4, target-data-prototype=ExpendableNonVolatile_Ram_Core4/NeDMIR_e_DriveStyleSts}, written-nv-data=NeDMIR_e_DriveStyleSts_Rx.NeDMIR_e_DriveStyleSts}
          {nv-ram-block-element=autosar-variable-in-impl-datatype={root-variable-data-prototype=ExpendableNonVolatile_RamBlock_Core4, target-data-prototype=ExpendableNonVolatile_Ram_Core4/NeCPDR_Cnt_HTAP_FunPer_MFOP}, read-nv-data=NeCPDR_Cnt_HTAP_FunPer_MFOP.NeCPDR_Cnt_HTAP_FunPer_MFOP}
          {nv-ram-block-element=autosar-variable-in-impl-datatype={root-variable-data-prototype=ExpendableNonVolatile_RamBlock_Core4, target-data-prototype=ExpendableNonVolatile_Ram_Core4/NeCPDR_Cnt_HTAP_FunPer_MFOP}, written-nv-data=NeCPDR_Cnt_HTAP_FunPer_MFOP_Rx.NeCPDR_Cnt_HTAP_FunPer_MFOP}
          {nv-ram-block-element=autosar-variable-in-impl-datatype={root-variable-data-prototype=ExpendableNonVolatile_RamBlock_Core4, target-data-prototype=ExpendableNonVolatile_Ram_Core4/NeCPDR_Cnt_EOPB_FunPer_MFOP}, read-nv-data=NeCPDR_Cnt_EOPB_FunPer_MFOP.NeCPDR_Cnt_EOPB_FunPer_MFOP}
          {nv-ram-block-element=autosar-variable-in-impl-datatype={root-variable-data-prototype=ExpendableNonVolatile_RamBlock_Core4, target-data-prototype=ExpendableNonVolatile_Ram_Core4/NeCPDR_Cnt_EOPB_FunPer_MFOP}, written-nv-data=NeCPDR_Cnt_EOPB_FunPer_MFOP_Rx.NeCPDR_Cnt_EOPB_FunPer_MFOP}
          {nv-ram-block-element=autosar-variable-in-impl-datatype={root-variable-data-prototype=ExpendableNonVolatile_RamBlock_Core4, target-data-prototype=ExpendableNonVolatile_Ram_Core4/NeCPDR_Cnt_EOPB_FunDryRun_MFOP}, read-nv-data=NeCPDR_Cnt_EOPB_FunDryRun_MFOP.NeCPDR_Cnt_EOPB_FunDryRun_MFOP}
          {nv-ram-block-element=autosar-variable-in-impl-datatype={root-variable-data-prototype=ExpendableNonVolatile_RamBlock_Core4, target-data-prototype=ExpendableNonVolatile_Ram_Core4/NeCPDR_Cnt_EOPB_FunDryRun_MFOP}, written-nv-data=NeCPDR_Cnt_EOPB_FunDryRun_MFOP_Rx.NeCPDR_Cnt_EOPB_FunDryRun_MFOP}
          {nv-ram-block-element=autosar-variable-in-impl-datatype={root-variable-data-prototype=ExpendableNonVolatile_RamBlock_Core4, target-data-prototype=ExpendableNonVolatile_Ram_Core4/NeCPDR_Cnt_EOPA_FunPer_MFOP}, read-nv-data=NeCPDR_Cnt_EOPA_FunPer_MFOP.NeCPDR_Cnt_EOPA_FunPer_MFOP}
          {nv-ram-block-element=autosar-variable-in-impl-datatype={root-variable-data-prototype=ExpendableNonVolatile_RamBlock_Core4, target-data-prototype=ExpendableNonVolatile_Ram_Core4/NeCPDR_Cnt_EOPA_FunPer_MFOP}, written-nv-data=NeCPDR_Cnt_EOPA_FunPer_MFOP_Rx.NeCPDR_Cnt_EOPA_FunPer_MFOP}
          {nv-ram-block-element=autosar-variable-in-impl-datatype={root-variable-data-prototype=ExpendableNonVolatile_RamBlock_Core4, target-data-prototype=ExpendableNonVolatile_Ram_Core4/NeCPDR_Cnt_EOPA_FunDryRun_MFOP}, read-nv-data=NeCPDR_Cnt_EOPA_FunDryRun_MFOP.NeCPDR_Cnt_EOPA_FunDryRun_MFOP}
          {nv-ram-block-element=autosar-variable-in-impl-datatype={root-variable-data-prototype=ExpendableNonVolatile_RamBlock_Core4, target-data-prototype=ExpendableNonVolatile_Ram_Core4/NeCPDR_Cnt_EOPA_FunDryRun_MFOP}, written-nv-data=NeCPDR_Cnt_EOPA_FunDryRun_MFOP_Rx.NeCPDR_Cnt_EOPA_FunDryRun_MFOP}
          {nv-ram-block-element=autosar-variable-in-impl-datatype={root-variable-data-prototype=ExpendableNonVolatile_RamBlock_Core4, target-data-prototype=ExpendableNonVolatile_Ram_Core4/NeCDMR_Cnt_PwrOutletPanelMod2Perf_MFOP}, read-nv-data=NeCDMR_Cnt_PwrOutletPanelMod2Perf_MFOP.NeCDMR_Cnt_PwrOutletPanelMod2Perf_MFOP}
          {nv-ram-block-element=autosar-variable-in-impl-datatype={root-variable-data-prototype=ExpendableNonVolatile_RamBlock_Core4, target-data-prototype=ExpendableNonVolatile_Ram_Core4/NeCDMR_Cnt_PwrOutletPanelMod2Perf_MFOP}, written-nv-data=NeCDMR_Cnt_PwrOutletPanelMod2Perf_MFOP_Rx.NeCDMR_Cnt_PwrOutletPanelMod2Perf_MFOP}
          {nv-ram-block-element=autosar-variable-in-impl-datatype={root-variable-data-prototype=ExpendableNonVolatile_RamBlock_Core4, target-data-prototype=ExpendableNonVolatile_Ram_Core4/NeCDMR_Cnt_PwrOutletPanelMod2LmpCntrl_MFOP}, read-nv-data=NeCDMR_Cnt_PwrOutletPanelMod2LmpCntrl_MFOP.NeCDMR_Cnt_PwrOutletPanelMod2LmpCntrl_MFOP}
          {nv-ram-block-element=autosar-variable-in-impl-datatype={root-variable-data-prototype=ExpendableNonVolatile_RamBlock_Core4, target-data-prototype=ExpendableNonVolatile_Ram_Core4/NeCDMR_Cnt_PwrOutletPanelMod2LmpCntrl_MFOP}, written-nv-data=NeCDMR_Cnt_PwrOutletPanelMod2LmpCntrl_MFOP_Rx.NeCDMR_Cnt_PwrOutletPanelMod2LmpCntrl_MFOP}
          {nv-ram-block-element=autosar-variable-in-impl-datatype={root-variable-data-prototype=ExpendableNonVolatile_RamBlock_Core4, target-data-prototype=ExpendableNonVolatile_Ram_Core4/NeCDMR_Cnt_PwrOutletPanelMod2InACPwrCktPerf_MFOP}, read-nv-data=NeCDMR_Cnt_PwrOutletPanelMod2InACPwrCktPerf_MFOP.NeCDMR_Cnt_PwrOutletPanelMod2InACPwrCktPerf_MFOP}
          {nv-ram-block-element=autosar-variable-in-impl-datatype={root-variable-data-prototype=ExpendableNonVolatile_RamBlock_Core4, target-data-prototype=ExpendableNonVolatile_Ram_Core4/NeCDMR_Cnt_PwrOutletPanelMod2InACPwrCktPerf_MFOP}, written-nv-data=NeCDMR_Cnt_PwrOutletPanelMod2InACPwrCktPerf_MFOP_Rx.NeCDMR_Cnt_PwrOutletPanelMod2InACPwrCktPerf_MFOP}
          {nv-ram-block-element=autosar-variable-in-impl-datatype={root-variable-data-prototype=ExpendableNonVolatile_RamBlock_Core4, target-data-prototype=ExpendableNonVolatile_Ram_Core4/NeCDMR_Cnt_PwrOutletPanelMod1Perf_MFOP}, read-nv-data=NeCDMR_Cnt_PwrOutletPanelMod1Perf_MFOP.NeCDMR_Cnt_PwrOutletPanelMod1Perf_MFOP}
          {nv-ram-block-element=autosar-variable-in-impl-datatype={root-variable-data-prototype=ExpendableNonVolatile_RamBlock_Core4, target-data-prototype=ExpendableNonVolatile_Ram_Core4/NeCDMR_Cnt_PwrOutletPanelMod1Perf_MFOP}, written-nv-data=NeCDMR_Cnt_PwrOutletPanelMod1Perf_MFOP_Rx.NeCDMR_Cnt_PwrOutletPanelMod1Perf_MFOP}
          {nv-ram-block-element=autosar-variable-in-impl-datatype={root-variable-data-prototype=ExpendableNonVolatile_RamBlock_Core4, target-data-prototype=ExpendableNonVolatile_Ram_Core4/NeDMIR_e_DrvMdArb}, read-nv-data=NeDMIR_e_DrvMdArb.NeDMIR_e_DrvMdArb}
          {nv-ram-block-element=autosar-variable-in-impl-datatype={root-variable-data-prototype=ExpendableNonVolatile_RamBlock_Core4, target-data-prototype=ExpendableNonVolatile_Ram_Core4/NeDMIR_e_DrvMdArb}, written-nv-data=NeDMIR_e_DrvMdArb_Rx.NeDMIR_e_DrvMdArb}
          {nv-ram-block-element=autosar-variable-in-impl-datatype={root-variable-data-prototype=ExpendableNonVolatile_RamBlock_Core4, target-data-prototype=ExpendableNonVolatile_Ram_Core4/NeHCDR_Cnt_HVC_Heater_MFOP}, read-nv-data=NeHCDR_Cnt_HVC_Heater_MFOP.NeHCDR_Cnt_HVC_Heater_MFOP}
          {nv-ram-block-element=autosar-variable-in-impl-datatype={root-variable-data-prototype=ExpendableNonVolatile_RamBlock_Core4, target-data-prototype=ExpendableNonVolatile_Ram_Core4/NeHCDR_Cnt_HVC_Heater_MFOP}, written-nv-data=NeHCDR_Cnt_HVC_Heater_MFOP_Rx.NeHCDR_Cnt_HVC_Heater_MFOP}
          {nv-ram-block-element=autosar-variable-in-impl-datatype={root-variable-data-prototype=ExpendableNonVolatile_RamBlock_Core4, target-data-prototype=ExpendableNonVolatile_Ram_Core4/NeHSWD_Cnt_SecBnt_Correlation_MFOP}, read-nv-data=NeHSWD_Cnt_SecBnt_Correlation_MFOP.NeHSWD_Cnt_SecBnt_Correlation_MFOP}
          {nv-ram-block-element=autosar-variable-in-impl-datatype={root-variable-data-prototype=ExpendableNonVolatile_RamBlock_Core4, target-data-prototype=ExpendableNonVolatile_Ram_Core4/NeHSWD_Cnt_SecBnt_Correlation_MFOP}, written-nv-data=NeHSWD_Cnt_SecBnt_Correlation_MFOP_Rx.NeHSWD_Cnt_SecBnt_Correlation_MFOP}
          {nv-ram-block-element=autosar-variable-in-impl-datatype={root-variable-data-prototype=ExpendableNonVolatile_RamBlock_Core4, target-data-prototype=ExpendableNonVolatile_Ram_Core4/NeHSWD_Cnt_SecBnt_CircuitPerf_MFOP}, read-nv-data=NeHSWD_Cnt_SecBnt_CircuitPerf_MFOP.NeHSWD_Cnt_SecBnt_CircuitPerf_MFOP}
          {nv-ram-block-element=autosar-variable-in-impl-datatype={root-variable-data-prototype=ExpendableNonVolatile_RamBlock_Core4, target-data-prototype=ExpendableNonVolatile_Ram_Core4/NeHSWD_Cnt_SecBnt_CircuitPerf_MFOP}, written-nv-data=NeHSWD_Cnt_SecBnt_CircuitPerf_MFOP_Rx.NeHSWD_Cnt_SecBnt_CircuitPerf_MFOP}
          {nv-ram-block-element=autosar-variable-in-impl-datatype={root-variable-data-prototype=ExpendableNonVolatile_RamBlock_Core4, target-data-prototype=ExpendableNonVolatile_Ram_Core4/NeHSWD_Cnt_SecBnt_CircuitLow_MFOP}, read-nv-data=NeHSWD_Cnt_SecBnt_CircuitLow_MFOP.NeHSWD_Cnt_SecBnt_CircuitLow_MFOP}
          {nv-ram-block-element=autosar-variable-in-impl-datatype={root-variable-data-prototype=ExpendableNonVolatile_RamBlock_Core4, target-data-prototype=ExpendableNonVolatile_Ram_Core4/NeHSWD_Cnt_SecBnt_CircuitLow_MFOP}, written-nv-data=NeHSWD_Cnt_SecBnt_CircuitLow_MFOP_Rx.NeHSWD_Cnt_SecBnt_CircuitLow_MFOP}
          {nv-ram-block-element=autosar-variable-in-impl-datatype={root-variable-data-prototype=ExpendableNonVolatile_RamBlock_Core4, target-data-prototype=ExpendableNonVolatile_Ram_Core4/NeHSWD_Cnt_SecBnt_CircuitHigh_MFOP}, read-nv-data=NeHSWD_Cnt_SecBnt_CircuitHigh_MFOP.NeHSWD_Cnt_SecBnt_CircuitHigh_MFOP}
          {nv-ram-block-element=autosar-variable-in-impl-datatype={root-variable-data-prototype=ExpendableNonVolatile_RamBlock_Core4, target-data-prototype=ExpendableNonVolatile_Ram_Core4/NeHSWD_Cnt_SecBnt_CircuitHigh_MFOP}, written-nv-data=NeHSWD_Cnt_SecBnt_CircuitHigh_MFOP_Rx.NeHSWD_Cnt_SecBnt_CircuitHigh_MFOP}
          {nv-ram-block-element=autosar-variable-in-impl-datatype={root-variable-data-prototype=ExpendableNonVolatile_RamBlock_Core4, target-data-prototype=ExpendableNonVolatile_Ram_Core4/NeHSWD_Cnt_CBC_FaultLow_MFOP}, read-nv-data=NeHSWD_Cnt_CBC_FaultLow_MFOP.NeHSWD_Cnt_CBC_FaultLow_MFOP}
          {nv-ram-block-element=autosar-variable-in-impl-datatype={root-variable-data-prototype=ExpendableNonVolatile_RamBlock_Core4, target-data-prototype=ExpendableNonVolatile_Ram_Core4/NeHSWD_Cnt_CBC_FaultLow_MFOP}, written-nv-data=NeHSWD_Cnt_CBC_FaultLow_MFOP_Rx.NeHSWD_Cnt_CBC_FaultLow_MFOP}
          {nv-ram-block-element=autosar-variable-in-impl-datatype={root-variable-data-prototype=ExpendableNonVolatile_RamBlock_Core4, target-data-prototype=ExpendableNonVolatile_Ram_Core4/NeHSWD_Cnt_CBC_FaultHigh_MFOP}, read-nv-data=NeHSWD_Cnt_CBC_FaultHigh_MFOP.NeHSWD_Cnt_CBC_FaultHigh_MFOP}
          {nv-ram-block-element=autosar-variable-in-impl-datatype={root-variable-data-prototype=ExpendableNonVolatile_RamBlock_Core4, target-data-prototype=ExpendableNonVolatile_Ram_Core4/NeHSWD_Cnt_CBC_FaultHigh_MFOP}, written-nv-data=NeHSWD_Cnt_CBC_FaultHigh_MFOP_Rx.NeHSWD_Cnt_CBC_FaultHigh_MFOP}
          {nv-ram-block-element=autosar-variable-in-impl-datatype={root-variable-data-prototype=ExpendableNonVolatile_RamBlock_Core4, target-data-prototype=ExpendableNonVolatile_Ram_Core4/NeHCDR_Cnt_HVC_Heater4_MFOP}, read-nv-data=NeHCDR_Cnt_HVC_Heater4_MFOP.NeHCDR_Cnt_HVC_Heater4_MFOP}
          {nv-ram-block-element=autosar-variable-in-impl-datatype={root-variable-data-prototype=ExpendableNonVolatile_RamBlock_Core4, target-data-prototype=ExpendableNonVolatile_Ram_Core4/NeHCDR_Cnt_HVC_Heater4_MFOP}, written-nv-data=NeHCDR_Cnt_HVC_Heater4_MFOP_Rx.NeHCDR_Cnt_HVC_Heater4_MFOP}
          {nv-ram-block-element=autosar-variable-in-impl-datatype={root-variable-data-prototype=ExpendableNonVolatile_RamBlock_Core4, target-data-prototype=ExpendableNonVolatile_Ram_Core4/NeHCDR_Cnt_HVC_Heater3_MFOP}, read-nv-data=NeHCDR_Cnt_HVC_Heater3_MFOP.NeHCDR_Cnt_HVC_Heater3_MFOP}
          {nv-ram-block-element=autosar-variable-in-impl-datatype={root-variable-data-prototype=ExpendableNonVolatile_RamBlock_Core4, target-data-prototype=ExpendableNonVolatile_Ram_Core4/NeHCDR_Cnt_HVC_Heater3_MFOP}, written-nv-data=NeHCDR_Cnt_HVC_Heater3_MFOP_Rx.NeHCDR_Cnt_HVC_Heater3_MFOP}
          {nv-ram-block-element=autosar-variable-in-impl-datatype={root-variable-data-prototype=ExpendableNonVolatile_RamBlock_Core4, target-data-prototype=ExpendableNonVolatile_Ram_Core4/NeHCDR_Cnt_HVC_Heater2_MFOP}, read-nv-data=NeHCDR_Cnt_HVC_Heater2_MFOP.NeHCDR_Cnt_HVC_Heater2_MFOP}
          {nv-ram-block-element=autosar-variable-in-impl-datatype={root-variable-data-prototype=ExpendableNonVolatile_RamBlock_Core4, target-data-prototype=ExpendableNonVolatile_Ram_Core4/NeHCDR_Cnt_HVC_Heater2_MFOP}, written-nv-data=NeHCDR_Cnt_HVC_Heater2_MFOP_Rx.NeHCDR_Cnt_HVC_Heater2_MFOP}
          {nv-ram-block-element=autosar-variable-in-impl-datatype={root-variable-data-prototype=ExpendableNonVolatile_RamBlock_Core4, target-data-prototype=ExpendableNonVolatile_Ram_Core4/NeHCDR_Cnt_EACPref_MFOP}, read-nv-data=NeHCDR_Cnt_EACPref_MFOP.NeHCDR_Cnt_EACPref_MFOP}
          {nv-ram-block-element=autosar-variable-in-impl-datatype={root-variable-data-prototype=ExpendableNonVolatile_RamBlock_Core4, target-data-prototype=ExpendableNonVolatile_Ram_Core4/NeHCDR_Cnt_EACPref_MFOP}, written-nv-data=NeHCDR_Cnt_EACPref_MFOP_Rx.NeHCDR_Cnt_EACPref_MFOP}
          {nv-ram-block-element=autosar-variable-in-impl-datatype={root-variable-data-prototype=ExpendableNonVolatile_RamBlock_Core4, target-data-prototype=ExpendableNonVolatile_Ram_Core4/NeGENR_Cnt_InPlantAPMOff}, read-nv-data=NeGENR_Cnt_InPlantAPMOff.NeGENR_Cnt_InPlantAPMOff}
          {nv-ram-block-element=autosar-variable-in-impl-datatype={root-variable-data-prototype=ExpendableNonVolatile_RamBlock_Core4, target-data-prototype=ExpendableNonVolatile_Ram_Core4/NeGENR_Cnt_InPlantAPMOff}, written-nv-data=NeGENR_Cnt_InPlantAPMOff_Rx.NeGENR_Cnt_InPlantAPMOff}
          {nv-ram-block-element=autosar-variable-in-impl-datatype={root-variable-data-prototype=ExpendableNonVolatile_RamBlock_Core4, target-data-prototype=ExpendableNonVolatile_Ram_Core4/NeCDMR_Cnt_PwrOutletPanelMod1LmpCntrl_MFOP}, read-nv-data=NeCDMR_Cnt_PwrOutletPanelMod1LmpCntrl_MFOP.NeCDMR_Cnt_PwrOutletPanelMod1LmpCntrl_MFOP}
          {nv-ram-block-element=autosar-variable-in-impl-datatype={root-variable-data-prototype=ExpendableNonVolatile_RamBlock_Core4, target-data-prototype=ExpendableNonVolatile_Ram_Core4/NeCDMR_Cnt_PwrOutletPanelMod1LmpCntrl_MFOP}, written-nv-data=NeCDMR_Cnt_PwrOutletPanelMod1LmpCntrl_MFOP_Rx.NeCDMR_Cnt_PwrOutletPanelMod1LmpCntrl_MFOP}
          {nv-ram-block-element=autosar-variable-in-impl-datatype={root-variable-data-prototype=ExpendableNonVolatile_RamBlock_Core4, target-data-prototype=ExpendableNonVolatile_Ram_Core4/NeCDMR_Cnt_PwrOutletPanelMod1InACPwrCktPerf_MFOP}, read-nv-data=NeCDMR_Cnt_PwrOutletPanelMod1InACPwrCktPerf_MFOP.NeCDMR_Cnt_PwrOutletPanelMod1InACPwrCktPerf_MFOP}
          {nv-ram-block-element=autosar-variable-in-impl-datatype={root-variable-data-prototype=ExpendableNonVolatile_RamBlock_Core4, target-data-prototype=ExpendableNonVolatile_Ram_Core4/NeCDMR_Cnt_PwrOutletPanelMod1InACPwrCktPerf_MFOP}, written-nv-data=NeCDMR_Cnt_PwrOutletPanelMod1InACPwrCktPerf_MFOP_Rx.NeCDMR_Cnt_PwrOutletPanelMod1InACPwrCktPerf_MFOP}
          {nv-ram-block-element=autosar-variable-in-impl-datatype={root-variable-data-prototype=ExpendableNonVolatile_RamBlock_Core4, target-data-prototype=ExpendableNonVolatile_Ram_Core4/NeCDMR_Cnt_InletSensor_MFOP}, read-nv-data=NeCDMR_Cnt_InletSensor_MFOP.NeCDMR_Cnt_InletSensor_MFOP}
          {nv-ram-block-element=autosar-variable-in-impl-datatype={root-variable-data-prototype=ExpendableNonVolatile_RamBlock_Core4, target-data-prototype=ExpendableNonVolatile_Ram_Core4/NeCDMR_Cnt_InletSensor_MFOP}, written-nv-data=NeCDMR_Cnt_InletSensor_MFOP_Rx.NeCDMR_Cnt_InletSensor_MFOP}
          {nv-ram-block-element=autosar-variable-in-impl-datatype={root-variable-data-prototype=ExpendableNonVolatile_RamBlock_Core4, target-data-prototype=ExpendableNonVolatile_Ram_Core4/NeAATR_Cnt_SCP_DCPstvTemp_LoFlt_MFOP}, read-nv-data=NeAATR_Cnt_SCP_DCPstvTemp_LoFlt_MFOP.NeAATR_Cnt_SCP_DCPstvTemp_LoFlt_MFOP}
          {nv-ram-block-element=autosar-variable-in-impl-datatype={root-variable-data-prototype=ExpendableNonVolatile_RamBlock_Core4, target-data-prototype=ExpendableNonVolatile_Ram_Core4/NeAATR_Cnt_SCP_DCPstvTemp_LoFlt_MFOP}, written-nv-data=NeAATR_Cnt_SCP_DCPstvTemp_LoFlt_MFOP_Rx.NeAATR_Cnt_SCP_DCPstvTemp_LoFlt_MFOP}
          {nv-ram-block-element=autosar-variable-in-impl-datatype={root-variable-data-prototype=ExpendableNonVolatile_RamBlock_Core4, target-data-prototype=ExpendableNonVolatile_Ram_Core4/NeBPCR_Cnt_PWMCntctrStMFOP}, read-nv-data=NeBPCR_Cnt_PWMCntctrStMFOP.NeBPCR_Cnt_PWMCntctrStMFOP}
          {nv-ram-block-element=autosar-variable-in-impl-datatype={root-variable-data-prototype=ExpendableNonVolatile_RamBlock_Core4, target-data-prototype=ExpendableNonVolatile_Ram_Core4/NeBPCR_Cnt_PWMCntctrStMFOP}, written-nv-data=NeBPCR_Cnt_PWMCntctrStMFOP_Rx.NeBPCR_Cnt_PWMCntctrStMFOP}
          {nv-ram-block-element=autosar-variable-in-impl-datatype={root-variable-data-prototype=ExpendableNonVolatile_RamBlock_Core4, target-data-prototype=ExpendableNonVolatile_Ram_Core4/NeADIR_Cnt_WEDMechFailure_MFOP}, read-nv-data=NeADIR_Cnt_WEDMechFailure_MFOP.NeADIR_Cnt_WEDMechFailure_MFOP}
          {nv-ram-block-element=autosar-variable-in-impl-datatype={root-variable-data-prototype=ExpendableNonVolatile_RamBlock_Core4, target-data-prototype=ExpendableNonVolatile_Ram_Core4/NeADIR_Cnt_WEDMechFailure_MFOP}, written-nv-data=NeADIR_Cnt_WEDMechFailure_MFOP_Rx.NeADIR_Cnt_WEDMechFailure_MFOP}
          {nv-ram-block-element=autosar-variable-in-impl-datatype={root-variable-data-prototype=ExpendableNonVolatile_RamBlock_Core4, target-data-prototype=ExpendableNonVolatile_Ram_Core4/NeAATR_Cnt_SCP_InletTemp_PerfFlt_MFOP}, read-nv-data=NeAATR_Cnt_SCP_InletTemp_PerfFlt_MFOP.NeAATR_Cnt_SCP_InletTemp_PerfFlt_MFOP}
          {nv-ram-block-element=autosar-variable-in-impl-datatype={root-variable-data-prototype=ExpendableNonVolatile_RamBlock_Core4, target-data-prototype=ExpendableNonVolatile_Ram_Core4/NeAATR_Cnt_SCP_InletTemp_PerfFlt_MFOP}, written-nv-data=NeAATR_Cnt_SCP_InletTemp_PerfFlt_MFOP_Rx.NeAATR_Cnt_SCP_InletTemp_PerfFlt_MFOP}
          {nv-ram-block-element=autosar-variable-in-impl-datatype={root-variable-data-prototype=ExpendableNonVolatile_RamBlock_Core4, target-data-prototype=ExpendableNonVolatile_Ram_Core4/NeAATR_Cnt_SCP_InletTemp_LoFlt_MFOP}, read-nv-data=NeAATR_Cnt_SCP_InletTemp_LoFlt_MFOP.NeAATR_Cnt_SCP_InletTemp_LoFlt_MFOP}
          {nv-ram-block-element=autosar-variable-in-impl-datatype={root-variable-data-prototype=ExpendableNonVolatile_RamBlock_Core4, target-data-prototype=ExpendableNonVolatile_Ram_Core4/NeAATR_Cnt_SCP_InletTemp_LoFlt_MFOP}, written-nv-data=NeAATR_Cnt_SCP_InletTemp_LoFlt_MFOP_Rx.NeAATR_Cnt_SCP_InletTemp_LoFlt_MFOP}
          {nv-ram-block-element=autosar-variable-in-impl-datatype={root-variable-data-prototype=ExpendableNonVolatile_RamBlock_Core4, target-data-prototype=ExpendableNonVolatile_Ram_Core4/NeAATR_Cnt_SCP_InletTemp_HiFlt_MFOP}, read-nv-data=NeAATR_Cnt_SCP_InletTemp_HiFlt_MFOP.NeAATR_Cnt_SCP_InletTemp_HiFlt_MFOP}
          {nv-ram-block-element=autosar-variable-in-impl-datatype={root-variable-data-prototype=ExpendableNonVolatile_RamBlock_Core4, target-data-prototype=ExpendableNonVolatile_Ram_Core4/NeAATR_Cnt_SCP_InletTemp_HiFlt_MFOP}, written-nv-data=NeAATR_Cnt_SCP_InletTemp_HiFlt_MFOP_Rx.NeAATR_Cnt_SCP_InletTemp_HiFlt_MFOP}
          {nv-ram-block-element=autosar-variable-in-impl-datatype={root-variable-data-prototype=ExpendableNonVolatile_RamBlock_Core4, target-data-prototype=ExpendableNonVolatile_Ram_Core4/NeAATR_Cnt_SCP_InletTemp_Flt_MFOP}, read-nv-data=NeAATR_Cnt_SCP_InletTemp_Flt_MFOP.NeAATR_Cnt_SCP_InletTemp_Flt_MFOP}
          {nv-ram-block-element=autosar-variable-in-impl-datatype={root-variable-data-prototype=ExpendableNonVolatile_RamBlock_Core4, target-data-prototype=ExpendableNonVolatile_Ram_Core4/NeAATR_Cnt_SCP_InletTemp_Flt_MFOP}, written-nv-data=NeAATR_Cnt_SCP_InletTemp_Flt_MFOP_Rx.NeAATR_Cnt_SCP_InletTemp_Flt_MFOP}
          {nv-ram-block-element=autosar-variable-in-impl-datatype={root-variable-data-prototype=ExpendableNonVolatile_RamBlock_Core4, target-data-prototype=ExpendableNonVolatile_Ram_Core4/NeAATR_Cnt_SCP_DCPstvTemp_PerfFlt_MFOP}, read-nv-data=NeAATR_Cnt_SCP_DCPstvTemp_PerfFlt_MFOP.NeAATR_Cnt_SCP_DCPstvTemp_PerfFlt_MFOP}
          {nv-ram-block-element=autosar-variable-in-impl-datatype={root-variable-data-prototype=ExpendableNonVolatile_RamBlock_Core4, target-data-prototype=ExpendableNonVolatile_Ram_Core4/NeAATR_Cnt_SCP_DCPstvTemp_PerfFlt_MFOP}, written-nv-data=NeAATR_Cnt_SCP_DCPstvTemp_PerfFlt_MFOP_Rx.NeAATR_Cnt_SCP_DCPstvTemp_PerfFlt_MFOP}
          {nv-ram-block-element=autosar-variable-in-impl-datatype={root-variable-data-prototype=ExpendableNonVolatile_RamBlock_Core4, target-data-prototype=ExpendableNonVolatile_Ram_Core4/NeAATR_Cnt_SCP_DCPstvTemp_Flt_MFOP}, read-nv-data=NeAATR_Cnt_SCP_DCPstvTemp_Flt_MFOP.NeAATR_Cnt_SCP_DCPstvTemp_Flt_MFOP}
          {nv-ram-block-element=autosar-variable-in-impl-datatype={root-variable-data-prototype=ExpendableNonVolatile_RamBlock_Core4, target-data-prototype=ExpendableNonVolatile_Ram_Core4/NeAATR_Cnt_SCP_DCPstvTemp_Flt_MFOP}, written-nv-data=NeAATR_Cnt_SCP_DCPstvTemp_Flt_MFOP_Rx.NeAATR_Cnt_SCP_DCPstvTemp_Flt_MFOP}
          {nv-ram-block-element=autosar-variable-in-impl-datatype={root-variable-data-prototype=ExpendableNonVolatile_RamBlock_Core4, target-data-prototype=ExpendableNonVolatile_Ram_Core4/NeCDMR_Cnt_DTCShortName6_MFOP}, read-nv-data=NeCDMR_Cnt_DTCShortName6_MFOP.NeCDMR_Cnt_DTCShortName6_MFOP}
          {nv-ram-block-element=autosar-variable-in-impl-datatype={root-variable-data-prototype=ExpendableNonVolatile_RamBlock_Core4, target-data-prototype=ExpendableNonVolatile_Ram_Core4/NeCDMR_Cnt_DTCShortName6_MFOP}, written-nv-data=NeCDMR_Cnt_DTCShortName6_MFOP_Rx.NeCDMR_Cnt_DTCShortName6_MFOP}
          {nv-ram-block-element=autosar-variable-in-impl-datatype={root-variable-data-prototype=ExpendableNonVolatile_RamBlock_Core4, target-data-prototype=ExpendableNonVolatile_Ram_Core4/NeAATR_Cnt_SCP_DCNegtvTemp_PerfFlt_MFOP}, read-nv-data=NeAATR_Cnt_SCP_DCNegtvTemp_PerfFlt_MFOP.NeAATR_Cnt_SCP_DCNegtvTemp_PerfFlt_MFOP}
          {nv-ram-block-element=autosar-variable-in-impl-datatype={root-variable-data-prototype=ExpendableNonVolatile_RamBlock_Core4, target-data-prototype=ExpendableNonVolatile_Ram_Core4/NeAATR_Cnt_SCP_DCNegtvTemp_PerfFlt_MFOP}, written-nv-data=NeAATR_Cnt_SCP_DCNegtvTemp_PerfFlt_MFOP_Rx.NeAATR_Cnt_SCP_DCNegtvTemp_PerfFlt_MFOP}
          {nv-ram-block-element=autosar-variable-in-impl-datatype={root-variable-data-prototype=ExpendableNonVolatile_RamBlock_Core4, target-data-prototype=ExpendableNonVolatile_Ram_Core4/NeAATR_Cnt_SCP_DCNegtvTemp_LoFlt_MFOP}, read-nv-data=NeAATR_Cnt_SCP_DCNegtvTemp_LoFlt_MFOP.NeAATR_Cnt_SCP_DCNegtvTemp_LoFlt_MFOP}
          {nv-ram-block-element=autosar-variable-in-impl-datatype={root-variable-data-prototype=ExpendableNonVolatile_RamBlock_Core4, target-data-prototype=ExpendableNonVolatile_Ram_Core4/NeAATR_Cnt_SCP_DCNegtvTemp_LoFlt_MFOP}, written-nv-data=NeAATR_Cnt_SCP_DCNegtvTemp_LoFlt_MFOP_Rx.NeAATR_Cnt_SCP_DCNegtvTemp_LoFlt_MFOP}
          {nv-ram-block-element=autosar-variable-in-impl-datatype={root-variable-data-prototype=ExpendableNonVolatile_RamBlock_Core4, target-data-prototype=ExpendableNonVolatile_Ram_Core4/NeAATR_Cnt_SCP_DCNegtvTemp_HiFlt_MFOP}, read-nv-data=NeAATR_Cnt_SCP_DCNegtvTemp_HiFlt_MFOP.NeAATR_Cnt_SCP_DCNegtvTemp_HiFlt_MFOP}
          {nv-ram-block-element=autosar-variable-in-impl-datatype={root-variable-data-prototype=ExpendableNonVolatile_RamBlock_Core4, target-data-prototype=ExpendableNonVolatile_Ram_Core4/NeAATR_Cnt_SCP_DCNegtvTemp_HiFlt_MFOP}, written-nv-data=NeAATR_Cnt_SCP_DCNegtvTemp_HiFlt_MFOP_Rx.NeAATR_Cnt_SCP_DCNegtvTemp_HiFlt_MFOP}
          {nv-ram-block-element=autosar-variable-in-impl-datatype={root-variable-data-prototype=ExpendableNonVolatile_RamBlock_Core4, target-data-prototype=ExpendableNonVolatile_Ram_Core4/NeAATR_Cnt_SCP_DCNegtvTemp_Flt_MFOP}, read-nv-data=NeAATR_Cnt_SCP_DCNegtvTemp_Flt_MFOP.NeAATR_Cnt_SCP_DCNegtvTemp_Flt_MFOP}
          {nv-ram-block-element=autosar-variable-in-impl-datatype={root-variable-data-prototype=ExpendableNonVolatile_RamBlock_Core4, target-data-prototype=ExpendableNonVolatile_Ram_Core4/NeAATR_Cnt_SCP_DCNegtvTemp_Flt_MFOP}, written-nv-data=NeAATR_Cnt_SCP_DCNegtvTemp_Flt_MFOP_Rx.NeAATR_Cnt_SCP_DCNegtvTemp_Flt_MFOP}
          {nv-ram-block-element=autosar-variable-in-impl-datatype={root-variable-data-prototype=ExpendableNonVolatile_RamBlock_Core4, target-data-prototype=ExpendableNonVolatile_Ram_Core4/NeAATR_Cnt_ECM_IntakeTemp_PerfFlt_MFOP}, read-nv-data=NeAATR_Cnt_ECM_IntakeTemp_PerfFlt_MFOP.NeAATR_Cnt_ECM_IntakeTemp_PerfFlt_MFOP}
          {nv-ram-block-element=autosar-variable-in-impl-datatype={root-variable-data-prototype=ExpendableNonVolatile_RamBlock_Core4, target-data-prototype=ExpendableNonVolatile_Ram_Core4/NeAATR_Cnt_ECM_IntakeTemp_PerfFlt_MFOP}, written-nv-data=NeAATR_Cnt_ECM_IntakeTemp_PerfFlt_MFOP_Rx.NeAATR_Cnt_ECM_IntakeTemp_PerfFlt_MFOP}
          {nv-ram-block-element=autosar-variable-in-impl-datatype={root-variable-data-prototype=ExpendableNonVolatile_RamBlock_Core4, target-data-prototype=ExpendableNonVolatile_Ram_Core4/NeAATR_Cnt_DCPstvTemp_HiFlt_MFOP}, read-nv-data=NeAATR_Cnt_DCPstvTemp_HiFlt_MFOP.NeAATR_Cnt_DCPstvTemp_HiFlt_MFOP}
          {nv-ram-block-element=autosar-variable-in-impl-datatype={root-variable-data-prototype=ExpendableNonVolatile_RamBlock_Core4, target-data-prototype=ExpendableNonVolatile_Ram_Core4/NeAATR_Cnt_DCPstvTemp_HiFlt_MFOP}, written-nv-data=NeAATR_Cnt_DCPstvTemp_HiFlt_MFOP_Rx.NeAATR_Cnt_DCPstvTemp_HiFlt_MFOP}
          {nv-ram-block-element=autosar-variable-in-impl-datatype={root-variable-data-prototype=ExpendableNonVolatile_RamBlock_Core4, target-data-prototype=ExpendableNonVolatile_Ram_Core4/NeAATR_Cnt_AmbAirVolt_LoFlt_MFOP}, read-nv-data=NeAATR_Cnt_AmbAirVolt_LoFlt_MFOP.NeAATR_Cnt_AmbAirVolt_LoFlt_MFOP}
          {nv-ram-block-element=autosar-variable-in-impl-datatype={root-variable-data-prototype=ExpendableNonVolatile_RamBlock_Core4, target-data-prototype=ExpendableNonVolatile_Ram_Core4/NeAATR_Cnt_AmbAirVolt_LoFlt_MFOP}, written-nv-data=NeAATR_Cnt_AmbAirVolt_LoFlt_MFOP_Rx.NeAATR_Cnt_AmbAirVolt_LoFlt_MFOP}
          {nv-ram-block-element=autosar-variable-in-impl-datatype={root-variable-data-prototype=ExpendableNonVolatile_RamBlock_Core4, target-data-prototype=ExpendableNonVolatile_Ram_Core4/NeAATR_Cnt_AmbAirVolt_HiFlt_MFOP}, read-nv-data=NeAATR_Cnt_AmbAirVolt_HiFlt_MFOP.NeAATR_Cnt_AmbAirVolt_HiFlt_MFOP}
          {nv-ram-block-element=autosar-variable-in-impl-datatype={root-variable-data-prototype=ExpendableNonVolatile_RamBlock_Core4, target-data-prototype=ExpendableNonVolatile_Ram_Core4/NeAATR_Cnt_AmbAirVolt_HiFlt_MFOP}, written-nv-data=NeAATR_Cnt_AmbAirVolt_HiFlt_MFOP_Rx.NeAATR_Cnt_AmbAirVolt_HiFlt_MFOP}
          {nv-ram-block-element=autosar-variable-in-impl-datatype={root-variable-data-prototype=ExpendableNonVolatile_RamBlock_Core4, target-data-prototype=ExpendableNonVolatile_Ram_Core4/NeAATR_Cnt_AmbAirTemp_PerfFlt_MFOP}, read-nv-data=NeAATR_Cnt_AmbAirTemp_PerfFlt_MFOP.NeAATR_Cnt_AmbAirTemp_PerfFlt_MFOP}
          {nv-ram-block-element=autosar-variable-in-impl-datatype={root-variable-data-prototype=ExpendableNonVolatile_RamBlock_Core4, target-data-prototype=ExpendableNonVolatile_Ram_Core4/NeAATR_Cnt_AmbAirTemp_PerfFlt_MFOP}, written-nv-data=NeAATR_Cnt_AmbAirTemp_PerfFlt_MFOP_Rx.NeAATR_Cnt_AmbAirTemp_PerfFlt_MFOP}
          {nv-ram-block-element=autosar-variable-in-impl-datatype={root-variable-data-prototype=ExpendableNonVolatile_RamBlock_Core4, target-data-prototype=ExpendableNonVolatile_Ram_Core4/NeCDMR_Cnt_ChrgPortUnlock_MFOP}, read-nv-data=NeCDMR_Cnt_ChrgPortUnlock_MFOP.NeCDMR_Cnt_ChrgPortUnlock_MFOP}
          {nv-ram-block-element=autosar-variable-in-impl-datatype={root-variable-data-prototype=ExpendableNonVolatile_RamBlock_Core4, target-data-prototype=ExpendableNonVolatile_Ram_Core4/NeCDMR_Cnt_ChrgPortUnlock_MFOP}, written-nv-data=NeCDMR_Cnt_ChrgPortUnlock_MFOP_Rx.NeCDMR_Cnt_ChrgPortUnlock_MFOP}
          {nv-ram-block-element=autosar-variable-in-impl-datatype={root-variable-data-prototype=ExpendableNonVolatile_RamBlock_Core4, target-data-prototype=ExpendableNonVolatile_Ram_Core4/NeCDMR_Cnt_ChrgPortRlyActCkt_MFOP}, read-nv-data=NeCDMR_Cnt_ChrgPortRlyActCkt_MFOP.NeCDMR_Cnt_ChrgPortRlyActCkt_MFOP}
          {nv-ram-block-element=autosar-variable-in-impl-datatype={root-variable-data-prototype=ExpendableNonVolatile_RamBlock_Core4, target-data-prototype=ExpendableNonVolatile_Ram_Core4/NeCDMR_Cnt_ChrgPortRlyActCkt_MFOP}, written-nv-data=NeCDMR_Cnt_ChrgPortRlyActCkt_MFOP_Rx.NeCDMR_Cnt_ChrgPortRlyActCkt_MFOP}
          {nv-ram-block-element=autosar-variable-in-impl-datatype={root-variable-data-prototype=ExpendableNonVolatile_RamBlock_Core4, target-data-prototype=ExpendableNonVolatile_Ram_Core4/NeCDMR_Cnt_ChrgPortLock_MFOP}, read-nv-data=NeCDMR_Cnt_ChrgPortLock_MFOP.NeCDMR_Cnt_ChrgPortLock_MFOP}
          {nv-ram-block-element=autosar-variable-in-impl-datatype={root-variable-data-prototype=ExpendableNonVolatile_RamBlock_Core4, target-data-prototype=ExpendableNonVolatile_Ram_Core4/NeCDMR_Cnt_ChrgPortLock_MFOP}, written-nv-data=NeCDMR_Cnt_ChrgPortLock_MFOP_Rx.NeCDMR_Cnt_ChrgPortLock_MFOP}
          {nv-ram-block-element=autosar-variable-in-impl-datatype={root-variable-data-prototype=ExpendableNonVolatile_RamBlock_Core4, target-data-prototype=ExpendableNonVolatile_Ram_Core4/NeCDMR_Cnt_ChgPrtLckFailLMFOP}, read-nv-data=NeCDMR_Cnt_ChgPrtLckFailLMFOP.NeCDMR_Cnt_ChgPrtLckFailLMFOP}
          {nv-ram-block-element=autosar-variable-in-impl-datatype={root-variable-data-prototype=ExpendableNonVolatile_RamBlock_Core4, target-data-prototype=ExpendableNonVolatile_Ram_Core4/NeCDMR_Cnt_ChgPrtLckFailLMFOP}, written-nv-data=NeCDMR_Cnt_ChgPrtLckFailLMFOP_Rx.NeCDMR_Cnt_ChgPrtLckFailLMFOP}
          {nv-ram-block-element=autosar-variable-in-impl-datatype={root-variable-data-prototype=ExpendableNonVolatile_RamBlock_Core4, target-data-prototype=ExpendableNonVolatile_Ram_Core4/NeCDMR_Cnt_ChgPrtLckFailHMFOP}, read-nv-data=NeCDMR_Cnt_ChgPrtLckFailHMFOP.NeCDMR_Cnt_ChgPrtLckFailHMFOP}
          {nv-ram-block-element=autosar-variable-in-impl-datatype={root-variable-data-prototype=ExpendableNonVolatile_RamBlock_Core4, target-data-prototype=ExpendableNonVolatile_Ram_Core4/NeCDMR_Cnt_ChgPrtLckFailHMFOP}, written-nv-data=NeCDMR_Cnt_ChgPrtLckFailHMFOP_Rx.NeCDMR_Cnt_ChgPrtLckFailHMFOP}
          {nv-ram-block-element=autosar-variable-in-impl-datatype={root-variable-data-prototype=ExpendableNonVolatile_RamBlock_Core4, target-data-prototype=ExpendableNonVolatile_Ram_Core4/NeCDMR_Cnt_CPIMInternal_MFOP}, read-nv-data=NeCDMR_Cnt_CPIMInternal_MFOP.NeCDMR_Cnt_CPIMInternal_MFOP}
          {nv-ram-block-element=autosar-variable-in-impl-datatype={root-variable-data-prototype=ExpendableNonVolatile_RamBlock_Core4, target-data-prototype=ExpendableNonVolatile_Ram_Core4/NeCDMR_Cnt_CPIMInternal_MFOP}, written-nv-data=NeCDMR_Cnt_CPIMInternal_MFOP_Rx.NeCDMR_Cnt_CPIMInternal_MFOP}
          {nv-ram-block-element=autosar-variable-in-impl-datatype={root-variable-data-prototype=ExpendableNonVolatile_RamBlock_Core4, target-data-prototype=ExpendableNonVolatile_Ram_Core4/NeCDMR_Cnt_BCIMInternal_MFOP}, read-nv-data=NeCDMR_Cnt_BCIMInternal_MFOP.NeCDMR_Cnt_BCIMInternal_MFOP}
          {nv-ram-block-element=autosar-variable-in-impl-datatype={root-variable-data-prototype=ExpendableNonVolatile_RamBlock_Core4, target-data-prototype=ExpendableNonVolatile_Ram_Core4/NeCDMR_Cnt_BCIMInternal_MFOP}, written-nv-data=NeCDMR_Cnt_BCIMInternal_MFOP_Rx.NeCDMR_Cnt_BCIMInternal_MFOP}
          {nv-ram-block-element=autosar-variable-in-impl-datatype={root-variable-data-prototype=ExpendableNonVolatile_RamBlock_Core4, target-data-prototype=ExpendableNonVolatile_Ram_Core4/NeCCTR_Cnt_SpdCntrlSw1_MFOP}, read-nv-data=NeCCTR_Cnt_SpdCntrlSw1_MFOP.NeCCTR_Cnt_SpdCntrlSw1_MFOP}
          {nv-ram-block-element=autosar-variable-in-impl-datatype={root-variable-data-prototype=ExpendableNonVolatile_RamBlock_Core4, target-data-prototype=ExpendableNonVolatile_Ram_Core4/NeCCTR_Cnt_SpdCntrlSw1_MFOP}, written-nv-data=NeCCTR_Cnt_SpdCntrlSw1_MFOP_Rx.NeCCTR_Cnt_SpdCntrlSw1_MFOP}
          {nv-ram-block-element=autosar-variable-in-impl-datatype={root-variable-data-prototype=ExpendableNonVolatile_RamBlock_Core4, target-data-prototype=ExpendableNonVolatile_Ram_Core4/NeBTQD_Cnt_ESPSignalDiag_MFOP}, read-nv-data=NeBTQD_Cnt_ESPSignalDiag_MFOP.NeBTQD_Cnt_ESPSignalDiag_MFOP}
          {nv-ram-block-element=autosar-variable-in-impl-datatype={root-variable-data-prototype=ExpendableNonVolatile_RamBlock_Core4, target-data-prototype=ExpendableNonVolatile_Ram_Core4/NeBTQD_Cnt_ESPSignalDiag_MFOP}, written-nv-data=NeBTQD_Cnt_ESPSignalDiag_MFOP_Rx.NeBTQD_Cnt_ESPSignalDiag_MFOP}
          {nv-ram-block-element=autosar-variable-in-impl-datatype={root-variable-data-prototype=ExpendableNonVolatile_RamBlock_Core4, target-data-prototype=ExpendableNonVolatile_Ram_Core4/NeBRDR_Cnt_LTAP_MFOP}, read-nv-data=NeBRDR_Cnt_LTAP_MFOP.NeBRDR_Cnt_LTAP_MFOP}
          {nv-ram-block-element=autosar-variable-in-impl-datatype={root-variable-data-prototype=ExpendableNonVolatile_RamBlock_Core4, target-data-prototype=ExpendableNonVolatile_Ram_Core4/NeBRDR_Cnt_LTAP_MFOP}, written-nv-data=NeBRDR_Cnt_LTAP_MFOP_Rx.NeBRDR_Cnt_LTAP_MFOP}
          {nv-ram-block-element=autosar-variable-in-impl-datatype={root-variable-data-prototype=ExpendableNonVolatile_RamBlock_Core4, target-data-prototype=ExpendableNonVolatile_Ram_Core4/NeBRDR_Cnt_HeatExPerf_MFOP}, read-nv-data=NeBRDR_Cnt_HeatExPerf_MFOP.NeBRDR_Cnt_HeatExPerf_MFOP}
          {nv-ram-block-element=autosar-variable-in-impl-datatype={root-variable-data-prototype=ExpendableNonVolatile_RamBlock_Core4, target-data-prototype=ExpendableNonVolatile_Ram_Core4/NeBRDR_Cnt_HeatExPerf_MFOP}, written-nv-data=NeBRDR_Cnt_HeatExPerf_MFOP_Rx.NeBRDR_Cnt_HeatExPerf_MFOP}
          {nv-ram-block-element=autosar-variable-in-impl-datatype={root-variable-data-prototype=ExpendableNonVolatile_RamBlock_Core4, target-data-prototype=ExpendableNonVolatile_Ram_Core4/NeBRDR_Cnt_HV_BTOS_MFOP}, read-nv-data=NeBRDR_Cnt_HV_BTOS_MFOP.NeBRDR_Cnt_HV_BTOS_MFOP}
          {nv-ram-block-element=autosar-variable-in-impl-datatype={root-variable-data-prototype=ExpendableNonVolatile_RamBlock_Core4, target-data-prototype=ExpendableNonVolatile_Ram_Core4/NeBRDR_Cnt_HV_BTOS_MFOP}, written-nv-data=NeBRDR_Cnt_HV_BTOS_MFOP_Rx.NeBRDR_Cnt_HV_BTOS_MFOP}
          {nv-ram-block-element=autosar-variable-in-impl-datatype={root-variable-data-prototype=ExpendableNonVolatile_RamBlock_Core4, target-data-prototype=ExpendableNonVolatile_Ram_Core4/NeBRDR_Cnt_HV_BTOS2_MFOP}, read-nv-data=NeBRDR_Cnt_HV_BTOS2_MFOP.NeBRDR_Cnt_HV_BTOS2_MFOP}
          {nv-ram-block-element=autosar-variable-in-impl-datatype={root-variable-data-prototype=ExpendableNonVolatile_RamBlock_Core4, target-data-prototype=ExpendableNonVolatile_Ram_Core4/NeBRDR_Cnt_HV_BTOS2_MFOP}, written-nv-data=NeBRDR_Cnt_HV_BTOS2_MFOP_Rx.NeBRDR_Cnt_HV_BTOS2_MFOP}
          {nv-ram-block-element=autosar-variable-in-impl-datatype={root-variable-data-prototype=ExpendableNonVolatile_RamBlock_Core4, target-data-prototype=ExpendableNonVolatile_Ram_Core4/NeBRDR_Cnt_HV_BTIS_MFOP}, read-nv-data=NeBRDR_Cnt_HV_BTIS_MFOP.NeBRDR_Cnt_HV_BTIS_MFOP}
          {nv-ram-block-element=autosar-variable-in-impl-datatype={root-variable-data-prototype=ExpendableNonVolatile_RamBlock_Core4, target-data-prototype=ExpendableNonVolatile_Ram_Core4/NeBRDR_Cnt_HV_BTIS_MFOP}, written-nv-data=NeBRDR_Cnt_HV_BTIS_MFOP_Rx.NeBRDR_Cnt_HV_BTIS_MFOP}
          {nv-ram-block-element=autosar-variable-in-impl-datatype={root-variable-data-prototype=ExpendableNonVolatile_RamBlock_Core4, target-data-prototype=ExpendableNonVolatile_Ram_Core4/NeBRDR_Cnt_HV_BTIS2_MFOP}, read-nv-data=NeBRDR_Cnt_HV_BTIS2_MFOP.NeBRDR_Cnt_HV_BTIS2_MFOP}
          {nv-ram-block-element=autosar-variable-in-impl-datatype={root-variable-data-prototype=ExpendableNonVolatile_RamBlock_Core4, target-data-prototype=ExpendableNonVolatile_Ram_Core4/NeBRDR_Cnt_HV_BTIS2_MFOP}, written-nv-data=NeBRDR_Cnt_HV_BTIS2_MFOP_Rx.NeBRDR_Cnt_HV_BTIS2_MFOP}
          {nv-ram-block-element=autosar-variable-in-impl-datatype={root-variable-data-prototype=ExpendableNonVolatile_RamBlock_Core4, target-data-prototype=ExpendableNonVolatile_Ram_Core4/NeBRDR_Cnt_HV_BHOS_MFOP}, read-nv-data=NeBRDR_Cnt_HV_BHOS_MFOP.NeBRDR_Cnt_HV_BHOS_MFOP}
          {nv-ram-block-element=autosar-variable-in-impl-datatype={root-variable-data-prototype=ExpendableNonVolatile_RamBlock_Core4, target-data-prototype=ExpendableNonVolatile_Ram_Core4/NeBRDR_Cnt_HV_BHOS_MFOP}, written-nv-data=NeBRDR_Cnt_HV_BHOS_MFOP_Rx.NeBRDR_Cnt_HV_BHOS_MFOP}
          {nv-ram-block-element=autosar-variable-in-impl-datatype={root-variable-data-prototype=ExpendableNonVolatile_RamBlock_Core4, target-data-prototype=ExpendableNonVolatile_Ram_Core4/NeBRDR_Cnt_HVBatCltLvlSnsCkt_MFOP}, read-nv-data=NeBRDR_Cnt_HVBatCltLvlSnsCkt_MFOP.NeBRDR_Cnt_HVBatCltLvlSnsCkt_MFOP}
          {nv-ram-block-element=autosar-variable-in-impl-datatype={root-variable-data-prototype=ExpendableNonVolatile_RamBlock_Core4, target-data-prototype=ExpendableNonVolatile_Ram_Core4/NeBRDR_Cnt_HVBatCltLvlSnsCkt_MFOP}, written-nv-data=NeBRDR_Cnt_HVBatCltLvlSnsCkt_MFOP_Rx.NeBRDR_Cnt_HVBatCltLvlSnsCkt_MFOP}
          {nv-ram-block-element=autosar-variable-in-impl-datatype={root-variable-data-prototype=ExpendableNonVolatile_RamBlock_Core4, target-data-prototype=ExpendableNonVolatile_Ram_Core4/NeBRDR_Cnt_HVBatCltLvLo_OC_MFOP}, read-nv-data=NeBRDR_Cnt_HVBatCltLvLo_OC_MFOP.NeBRDR_Cnt_HVBatCltLvLo_OC_MFOP}
          {nv-ram-block-element=autosar-variable-in-impl-datatype={root-variable-data-prototype=ExpendableNonVolatile_RamBlock_Core4, target-data-prototype=ExpendableNonVolatile_Ram_Core4/NeBRDR_Cnt_HVBatCltLvLo_OC_MFOP}, written-nv-data=NeBRDR_Cnt_HVBatCltLvLo_OC_MFOP_Rx.NeBRDR_Cnt_HVBatCltLvLo_OC_MFOP}
          {nv-ram-block-element=autosar-variable-in-impl-datatype={root-variable-data-prototype=ExpendableNonVolatile_RamBlock_Core4, target-data-prototype=ExpendableNonVolatile_Ram_Core4/NeBRDR_Cnt_ChillPerf_MFOP}, read-nv-data=NeBRDR_Cnt_ChillPerf_MFOP.NeBRDR_Cnt_ChillPerf_MFOP}
          {nv-ram-block-element=autosar-variable-in-impl-datatype={root-variable-data-prototype=ExpendableNonVolatile_RamBlock_Core4, target-data-prototype=ExpendableNonVolatile_Ram_Core4/NeBRDR_Cnt_ChillPerf_MFOP}, written-nv-data=NeBRDR_Cnt_ChillPerf_MFOP_Rx.NeBRDR_Cnt_ChillPerf_MFOP}
          {nv-ram-block-element=autosar-variable-in-impl-datatype={root-variable-data-prototype=ExpendableNonVolatile_RamBlock_Core4, target-data-prototype=ExpendableNonVolatile_Ram_Core4/NeHVTR_Cnt_AntiTampCounter}, read-nv-data=NeHVTR_Cnt_AntiTampCounter.NeHVTR_Cnt_AntiTampCounter}
          {nv-ram-block-element=autosar-variable-in-impl-datatype={root-variable-data-prototype=ExpendableNonVolatile_RamBlock_Core4, target-data-prototype=ExpendableNonVolatile_Ram_Core4/NeHVTR_Cnt_AntiTampCounter}, written-nv-data=NeHVTR_Cnt_AntiTampCounter_Rx.NeHVTR_Cnt_AntiTampCounter}
          {nv-ram-block-element=autosar-variable-in-impl-datatype={root-variable-data-prototype=ExpendableNonVolatile_RamBlock_Core4, target-data-prototype=ExpendableNonVolatile_Ram_Core4/NeHSWD_Cnt_CBC_Range_MFOP}, read-nv-data=NeHSWD_Cnt_CBC_Range_MFOP.NeHSWD_Cnt_CBC_Range_MFOP}
          {nv-ram-block-element=autosar-variable-in-impl-datatype={root-variable-data-prototype=ExpendableNonVolatile_RamBlock_Core4, target-data-prototype=ExpendableNonVolatile_Ram_Core4/NeHSWD_Cnt_CBC_Range_MFOP}, written-nv-data=NeHSWD_Cnt_CBC_Range_MFOP_Rx.NeHSWD_Cnt_CBC_Range_MFOP}
          {nv-ram-block-element=autosar-variable-in-impl-datatype={root-variable-data-prototype=ExpendableNonVolatile_RamBlock_Core4, target-data-prototype=ExpendableNonVolatile_Ram_Core4/NeITIR_Cnt_TimeSinceEngineStrt}, read-nv-data=NeITIR_Cnt_TimeSinceEngineStrt.NeITIR_Cnt_TimeSinceEngineStrt}
          {nv-ram-block-element=autosar-variable-in-impl-datatype={root-variable-data-prototype=ExpendableNonVolatile_RamBlock_Core4, target-data-prototype=ExpendableNonVolatile_Ram_Core4/NeITIR_Cnt_TimeSinceEngineStrt}, written-nv-data=NeITIR_Cnt_TimeSinceEngineStrt_Rx.NeITIR_Cnt_TimeSinceEngineStrt}
          {nv-ram-block-element=autosar-variable-in-impl-datatype={root-variable-data-prototype=ExpendableNonVolatile_RamBlock_Core4, target-data-prototype=ExpendableNonVolatile_Ram_Core4/NeIMPR_Cnt_HVShtDwn_MFOP}, read-nv-data=NeIMPR_Cnt_HVShtDwn_MFOP.NeIMPR_Cnt_HVShtDwn_MFOP}
          {nv-ram-block-element=autosar-variable-in-impl-datatype={root-variable-data-prototype=ExpendableNonVolatile_RamBlock_Core4, target-data-prototype=ExpendableNonVolatile_Ram_Core4/NeIMPR_Cnt_HVShtDwn_MFOP}, written-nv-data=NeIMPR_Cnt_HVShtDwn_MFOP_Rx.NeIMPR_Cnt_HVShtDwn_MFOP}
          {nv-ram-block-element=autosar-variable-in-impl-datatype={root-variable-data-prototype=ExpendableNonVolatile_RamBlock_Core4, target-data-prototype=ExpendableNonVolatile_Ram_Core4/NeCCCR_b_FirstIncrFlag_MinHot}, read-nv-data=NeCCCR_b_FirstIncrFlag_MinHot.NeCCCR_b_FirstIncrFlag_MinHot}
          {nv-ram-block-element=autosar-variable-in-impl-datatype={root-variable-data-prototype=ExpendableNonVolatile_RamBlock_Core4, target-data-prototype=ExpendableNonVolatile_Ram_Core4/NeCCCR_b_FirstIncrFlag_MinHot}, written-nv-data=NeCCCR_b_FirstIncrFlag_MinHot_Rx.NeCCCR_b_FirstIncrFlag_MinHot}
          {nv-ram-block-element=autosar-variable-in-impl-datatype={root-variable-data-prototype=ExpendableNonVolatile_RamBlock_Core4, target-data-prototype=ExpendableNonVolatile_Ram_Core4/NeCITR_b_PortLockBCM_Cmd}, read-nv-data=NeCITR_b_PortLockBCM_Cmd.NeCITR_b_PortLockBCM_Cmd}
          {nv-ram-block-element=autosar-variable-in-impl-datatype={root-variable-data-prototype=ExpendableNonVolatile_RamBlock_Core4, target-data-prototype=ExpendableNonVolatile_Ram_Core4/NeCITR_b_PortLockBCM_Cmd}, written-nv-data=NeCITR_b_PortLockBCM_Cmd_Rx.NeCITR_b_PortLockBCM_Cmd}
          {nv-ram-block-element=autosar-variable-in-impl-datatype={root-variable-data-prototype=ExpendableNonVolatile_RamBlock_Core4, target-data-prototype=ExpendableNonVolatile_Ram_Core4/NeCITR_b_Lock_Status}, read-nv-data=NeCITR_b_Lock_Status.NeCITR_b_Lock_Status}
          {nv-ram-block-element=autosar-variable-in-impl-datatype={root-variable-data-prototype=ExpendableNonVolatile_RamBlock_Core4, target-data-prototype=ExpendableNonVolatile_Ram_Core4/NeCITR_b_Lock_Status}, written-nv-data=NeCITR_b_Lock_Status_Rx.NeCITR_b_Lock_Status}
          {nv-ram-block-element=autosar-variable-in-impl-datatype={root-variable-data-prototype=ExpendableNonVolatile_RamBlock_Core4, target-data-prototype=ExpendableNonVolatile_Ram_Core4/NeCCCR_e_PwrLvlSet}, read-nv-data=NeCCCR_e_PwrLvlSet.NeCCCR_e_PwrLvlSet}
          {nv-ram-block-element=autosar-variable-in-impl-datatype={root-variable-data-prototype=ExpendableNonVolatile_RamBlock_Core4, target-data-prototype=ExpendableNonVolatile_Ram_Core4/NeCCCR_e_PwrLvlSet}, written-nv-data=NeCCCR_e_PwrLvlSet_Rx.NeCCCR_e_PwrLvlSet}
          {nv-ram-block-element=autosar-variable-in-impl-datatype={root-variable-data-prototype=ExpendableNonVolatile_RamBlock_Core4, target-data-prototype=ExpendableNonVolatile_Ram_Core4/NeDMIR_e_PddlMdStatus}, read-nv-data=NeDMIR_e_PddlMdStatus.NeDMIR_e_PddlMdStatus}
          {nv-ram-block-element=autosar-variable-in-impl-datatype={root-variable-data-prototype=ExpendableNonVolatile_RamBlock_Core4, target-data-prototype=ExpendableNonVolatile_Ram_Core4/NeDMIR_e_PddlMdStatus}, written-nv-data=NeDMIR_e_PddlMdStatus_Rx.NeDMIR_e_PddlMdStatus}
          {nv-ram-block-element=autosar-variable-in-impl-datatype={root-variable-data-prototype=ExpendableNonVolatile_RamBlock_Core4, target-data-prototype=ExpendableNonVolatile_Ram_Core4/NeDMIR_e_CreepSts}, read-nv-data=NeDMIR_e_CreepSts.NeDMIR_e_CreepSts}
          {nv-ram-block-element=autosar-variable-in-impl-datatype={root-variable-data-prototype=ExpendableNonVolatile_RamBlock_Core4, target-data-prototype=ExpendableNonVolatile_Ram_Core4/NeDMIR_e_CreepSts}, written-nv-data=NeDMIR_e_CreepSts_Rx.NeDMIR_e_CreepSts}
          {nv-ram-block-element=autosar-variable-in-impl-datatype={root-variable-data-prototype=ExpendableNonVolatile_RamBlock_Core4, target-data-prototype=ExpendableNonVolatile_Ram_Core4/NeCSVR_e_MIL_LightRequest}, read-nv-data=NeCSVR_e_MIL_LightRequest.NeCSVR_e_MIL_LightRequest}
          {nv-ram-block-element=autosar-variable-in-impl-datatype={root-variable-data-prototype=ExpendableNonVolatile_RamBlock_Core4, target-data-prototype=ExpendableNonVolatile_Ram_Core4/NeCSVR_e_MIL_LightRequest}, written-nv-data=NeCSVR_e_MIL_LightRequest_Rx.NeCSVR_e_MIL_LightRequest}
          {nv-ram-block-element=autosar-variable-in-impl-datatype={root-variable-data-prototype=ExpendableNonVolatile_RamBlock_Core4, target-data-prototype=ExpendableNonVolatile_Ram_Core4/NeSSDC_b_HVBatPerWU12VChrg}, read-nv-data=NeSSDC_b_HVBatPerWU12VChrg.NeSSDC_b_HVBatPerWU12VChrg}
          {nv-ram-block-element=autosar-variable-in-impl-datatype={root-variable-data-prototype=ExpendableNonVolatile_RamBlock_Core4, target-data-prototype=ExpendableNonVolatile_Ram_Core4/NeSSDC_b_HVBatPerWU12VChrg}, written-nv-data=NeSSDC_b_HVBatPerWU12VChrg_Rx.NeSSDC_b_HVBatPerWU12VChrg}
          {nv-ram-block-element=autosar-variable-in-impl-datatype={root-variable-data-prototype=ExpendableNonVolatile_RamBlock_Core4, target-data-prototype=ExpendableNonVolatile_Ram_Core4/NeSSDC_b_HVBatPerWUCabinPre}, read-nv-data=NeSSDC_b_HVBatPerWUCabinPre.NeSSDC_b_HVBatPerWUCabinPre}
          {nv-ram-block-element=autosar-variable-in-impl-datatype={root-variable-data-prototype=ExpendableNonVolatile_RamBlock_Core4, target-data-prototype=ExpendableNonVolatile_Ram_Core4/NeSSDC_b_HVBatPerWUCabinPre}, written-nv-data=NeSSDC_b_HVBatPerWUCabinPre_Rx.NeSSDC_b_HVBatPerWUCabinPre}
          {nv-ram-block-element=autosar-variable-in-impl-datatype={root-variable-data-prototype=ExpendableNonVolatile_RamBlock_Core4, target-data-prototype=ExpendableNonVolatile_Ram_Core4/NeSSDC_b_HVBatPerWUSchChrg}, read-nv-data=NeSSDC_b_HVBatPerWUSchChrg.NeSSDC_b_HVBatPerWUSchChrg}
          {nv-ram-block-element=autosar-variable-in-impl-datatype={root-variable-data-prototype=ExpendableNonVolatile_RamBlock_Core4, target-data-prototype=ExpendableNonVolatile_Ram_Core4/NeSSDC_b_HVBatPerWUSchChrg}, written-nv-data=NeSSDC_b_HVBatPerWUSchChrg_Rx.NeSSDC_b_HVBatPerWUSchChrg}
          {nv-ram-block-element=autosar-variable-in-impl-datatype={root-variable-data-prototype=ExpendableNonVolatile_RamBlock_Core4, target-data-prototype=ExpendableNonVolatile_Ram_Core4/NeSSDC_b_HVBatPerWUThermal}, read-nv-data=NeSSDC_b_HVBatPerWUThermal.NeSSDC_b_HVBatPerWUThermal}
          {nv-ram-block-element=autosar-variable-in-impl-datatype={root-variable-data-prototype=ExpendableNonVolatile_RamBlock_Core4, target-data-prototype=ExpendableNonVolatile_Ram_Core4/NeSSDC_b_HVBatPerWUThermal}, written-nv-data=NeSSDC_b_HVBatPerWUThermal_Rx.NeSSDC_b_HVBatPerWUThermal}
          {nv-ram-block-element=autosar-variable-in-impl-datatype={root-variable-data-prototype=ExpendableNonVolatile_RamBlock_Core4, target-data-prototype=ExpendableNonVolatile_Ram_Core4/NeCSVR_b_PriorMIL_StatusOn}, read-nv-data=NeCSVR_b_PriorMIL_StatusOn.NeCSVR_b_PriorMIL_StatusOn}
          {nv-ram-block-element=autosar-variable-in-impl-datatype={root-variable-data-prototype=ExpendableNonVolatile_RamBlock_Core4, target-data-prototype=ExpendableNonVolatile_Ram_Core4/NeCSVR_b_PriorMIL_StatusOn}, written-nv-data=NeCSVR_b_PriorMIL_StatusOn_Rx.NeCSVR_b_PriorMIL_StatusOn}
          {nv-ram-block-element=autosar-variable-in-impl-datatype={root-variable-data-prototype=ExpendableNonVolatile_RamBlock_Core4, target-data-prototype=ExpendableNonVolatile_Ram_Core4/NeCPLR_e_RemoteLockLastSts}, read-nv-data=NeCPLR_e_RemoteLockLastSts.NeCPLR_e_RemoteLockLastSts}
          {nv-ram-block-element=autosar-variable-in-impl-datatype={root-variable-data-prototype=ExpendableNonVolatile_RamBlock_Core4, target-data-prototype=ExpendableNonVolatile_Ram_Core4/NeCPLR_e_RemoteLockLastSts}, written-nv-data=NeCPLR_e_RemoteLockLastSts_Rx.NeCPLR_e_RemoteLockLastSts}
          {nv-ram-block-element=autosar-variable-in-impl-datatype={root-variable-data-prototype=ExpendableNonVolatile_RamBlock_Core4, target-data-prototype=ExpendableNonVolatile_Ram_Core4/NeCPLR_e_DoorLastSts}, read-nv-data=NeCPLR_e_DoorLastSts.NeCPLR_e_DoorLastSts}
          {nv-ram-block-element=autosar-variable-in-impl-datatype={root-variable-data-prototype=ExpendableNonVolatile_RamBlock_Core4, target-data-prototype=ExpendableNonVolatile_Ram_Core4/NeCPLR_e_DoorLastSts}, written-nv-data=NeCPLR_e_DoorLastSts_Rx.NeCPLR_e_DoorLastSts}
          {nv-ram-block-element=autosar-variable-in-impl-datatype={root-variable-data-prototype=ExpendableNonVolatile_RamBlock_Core4, target-data-prototype=ExpendableNonVolatile_Ram_Core4/NeCPLR_e_ChargeportLockLastSts}, read-nv-data=NeCPLR_e_ChargeportLockLastSts.NeCPLR_e_ChargeportLockLastSts}
          {nv-ram-block-element=autosar-variable-in-impl-datatype={root-variable-data-prototype=ExpendableNonVolatile_RamBlock_Core4, target-data-prototype=ExpendableNonVolatile_Ram_Core4/NeCPLR_e_ChargeportLockLastSts}, written-nv-data=NeCPLR_e_ChargeportLockLastSts_Rx.NeCPLR_e_ChargeportLockLastSts}
          {nv-ram-block-element=autosar-variable-in-impl-datatype={root-variable-data-prototype=ExpendableNonVolatile_RamBlock_Core4, target-data-prototype=ExpendableNonVolatile_Ram_Core4/NeCPLR_b_ManualRelease}, read-nv-data=NeCPLR_b_ManualRelease.NeCPLR_b_ManualRelease}
          {nv-ram-block-element=autosar-variable-in-impl-datatype={root-variable-data-prototype=ExpendableNonVolatile_RamBlock_Core4, target-data-prototype=ExpendableNonVolatile_Ram_Core4/NeCPLR_b_ManualRelease}, written-nv-data=NeCPLR_b_ManualRelease_Rx.NeCPLR_b_ManualRelease}
          {nv-ram-block-element=autosar-variable-in-impl-datatype={root-variable-data-prototype=ExpendableNonVolatile_RamBlock_Core4, target-data-prototype=ExpendableNonVolatile_Ram_Core4/NeCCCR_b_FirstIncrFlag_MaxHot}, read-nv-data=NeCCCR_b_FirstIncrFlag_MaxHot.NeCCCR_b_FirstIncrFlag_MaxHot}
          {nv-ram-block-element=autosar-variable-in-impl-datatype={root-variable-data-prototype=ExpendableNonVolatile_RamBlock_Core4, target-data-prototype=ExpendableNonVolatile_Ram_Core4/NeCCCR_b_FirstIncrFlag_MaxHot}, written-nv-data=NeCCCR_b_FirstIncrFlag_MaxHot_Rx.NeCCCR_b_FirstIncrFlag_MaxHot}
          {nv-ram-block-element=autosar-variable-in-impl-datatype={root-variable-data-prototype=ExpendableNonVolatile_RamBlock_Core4, target-data-prototype=ExpendableNonVolatile_Ram_Core4/NeCCCR_b_FirstIncrFlag_MinCold}, read-nv-data=NeCCCR_b_FirstIncrFlag_MinCold.NeCCCR_b_FirstIncrFlag_MinCold}
          {nv-ram-block-element=autosar-variable-in-impl-datatype={root-variable-data-prototype=ExpendableNonVolatile_RamBlock_Core4, target-data-prototype=ExpendableNonVolatile_Ram_Core4/NeCCCR_b_FirstIncrFlag_MinCold}, written-nv-data=NeCCCR_b_FirstIncrFlag_MinCold_Rx.NeCCCR_b_FirstIncrFlag_MinCold}
          {nv-ram-block-element=autosar-variable-in-impl-datatype={root-variable-data-prototype=ExpendableNonVolatile_RamBlock_Core4, target-data-prototype=ExpendableNonVolatile_Ram_Core4/NeCCCR_b_FirstIncrFlag_Cold}, read-nv-data=NeCCCR_b_FirstIncrFlag_Cold.NeCCCR_b_FirstIncrFlag_Cold}
          {nv-ram-block-element=autosar-variable-in-impl-datatype={root-variable-data-prototype=ExpendableNonVolatile_RamBlock_Core4, target-data-prototype=ExpendableNonVolatile_Ram_Core4/NeCCCR_b_FirstIncrFlag_Cold}, written-nv-data=NeCCCR_b_FirstIncrFlag_Cold_Rx.NeCCCR_b_FirstIncrFlag_Cold}
          {nv-ram-block-element=autosar-variable-in-impl-datatype={root-variable-data-prototype=ExpendableNonVolatile_RamBlock_Core4, target-data-prototype=ExpendableNonVolatile_Ram_Core4/NeCCCR_b_FirstIncrFlag_MaxCold}, read-nv-data=NeCCCR_b_FirstIncrFlag_MaxCold.NeCCCR_b_FirstIncrFlag_MaxCold}
          {nv-ram-block-element=autosar-variable-in-impl-datatype={root-variable-data-prototype=ExpendableNonVolatile_RamBlock_Core4, target-data-prototype=ExpendableNonVolatile_Ram_Core4/NeCCCR_b_FirstIncrFlag_MaxCold}, written-nv-data=NeCCCR_b_FirstIncrFlag_MaxCold_Rx.NeCCCR_b_FirstIncrFlag_MaxCold}
          {nv-ram-block-element=autosar-variable-in-impl-datatype={root-variable-data-prototype=ExpendableNonVolatile_RamBlock_Core4, target-data-prototype=ExpendableNonVolatile_Ram_Core4/NeAECR_e_eCoastLvlLatched}, read-nv-data=NeAECR_e_eCoastLvlLatched.NeAECR_e_eCoastLvlLatched}
          {nv-ram-block-element=autosar-variable-in-impl-datatype={root-variable-data-prototype=ExpendableNonVolatile_RamBlock_Core4, target-data-prototype=ExpendableNonVolatile_Ram_Core4/NeAECR_e_eCoastLvlLatched}, written-nv-data=NeAECR_e_eCoastLvlLatched_Rx.NeAECR_e_eCoastLvlLatched}
          {nv-ram-block-element=autosar-variable-in-impl-datatype={root-variable-data-prototype=ExpendableNonVolatile_RamBlock_Core4, target-data-prototype=ExpendableNonVolatile_Ram_Core4/NeAECR_e_eCoastDefaultCustom}, read-nv-data=NeAECR_e_eCoastDefaultCustom.NeAECR_e_eCoastDefaultCustom}
          {nv-ram-block-element=autosar-variable-in-impl-datatype={root-variable-data-prototype=ExpendableNonVolatile_RamBlock_Core4, target-data-prototype=ExpendableNonVolatile_Ram_Core4/NeAECR_e_eCoastDefaultCustom}, written-nv-data=NeAECR_e_eCoastDefaultCustom_Rx.NeAECR_e_eCoastDefaultCustom}
          {nv-ram-block-element=autosar-variable-in-impl-datatype={root-variable-data-prototype=ExpendableNonVolatile_RamBlock_Core4, target-data-prototype=ExpendableNonVolatile_Ram_Core4/NeAECR_e_eCoastDefaultAuto}, read-nv-data=NeAECR_e_eCoastDefaultAuto.NeAECR_e_eCoastDefaultAuto}
          {nv-ram-block-element=autosar-variable-in-impl-datatype={root-variable-data-prototype=ExpendableNonVolatile_RamBlock_Core4, target-data-prototype=ExpendableNonVolatile_Ram_Core4/NeAECR_e_eCoastDefaultAuto}, written-nv-data=NeAECR_e_eCoastDefaultAuto_Rx.NeAECR_e_eCoastDefaultAuto}
          {nv-ram-block-element=autosar-variable-in-impl-datatype={root-variable-data-prototype=ExpendableNonVolatile_RamBlock_Core4, target-data-prototype=ExpendableNonVolatile_Ram_Core4/NeAECR_e_RegenSts}, read-nv-data=NeAECR_e_RegenSts.NeAECR_e_RegenSts}
          {nv-ram-block-element=autosar-variable-in-impl-datatype={root-variable-data-prototype=ExpendableNonVolatile_RamBlock_Core4, target-data-prototype=ExpendableNonVolatile_Ram_Core4/NeAECR_e_RegenSts}, written-nv-data=NeAECR_e_RegenSts_Rx.NeAECR_e_RegenSts}
          {nv-ram-block-element=autosar-variable-in-impl-datatype={root-variable-data-prototype=ExpendableNonVolatile_RamBlock_Core4, target-data-prototype=ExpendableNonVolatile_Ram_Core4/NeAECR_e_RaceModeSts}, read-nv-data=NeAECR_e_RaceModeSts.NeAECR_e_RaceModeSts}
          {nv-ram-block-element=autosar-variable-in-impl-datatype={root-variable-data-prototype=ExpendableNonVolatile_RamBlock_Core4, target-data-prototype=ExpendableNonVolatile_Ram_Core4/NeAECR_e_RaceModeSts}, written-nv-data=NeAECR_e_RaceModeSts_Rx.NeAECR_e_RaceModeSts}
          {nv-ram-block-element=autosar-variable-in-impl-datatype={root-variable-data-prototype=ExpendableNonVolatile_RamBlock_Core4, target-data-prototype=ExpendableNonVolatile_Ram_Core4/NeAECR_e_PddlMdStatus}, read-nv-data=NeAECR_e_PddlMdStatus.NeAECR_e_PddlMdStatus}
          {nv-ram-block-element=autosar-variable-in-impl-datatype={root-variable-data-prototype=ExpendableNonVolatile_RamBlock_Core4, target-data-prototype=ExpendableNonVolatile_Ram_Core4/NeAECR_e_PddlMdStatus}, written-nv-data=NeAECR_e_PddlMdStatus_Rx.NeAECR_e_PddlMdStatus}
          {nv-ram-block-element=autosar-variable-in-impl-datatype={root-variable-data-prototype=ExpendableNonVolatile_RamBlock_Core4, target-data-prototype=ExpendableNonVolatile_Ram_Core4/NeCCCR_b_FirstIncrFlag_Hot}, read-nv-data=NeCCCR_b_FirstIncrFlag_Hot.NeCCCR_b_FirstIncrFlag_Hot}
          {nv-ram-block-element=autosar-variable-in-impl-datatype={root-variable-data-prototype=ExpendableNonVolatile_RamBlock_Core4, target-data-prototype=ExpendableNonVolatile_Ram_Core4/NeCCCR_b_FirstIncrFlag_Hot}, written-nv-data=NeCCCR_b_FirstIncrFlag_Hot_Rx.NeCCCR_b_FirstIncrFlag_Hot}
          {nv-ram-block-element=autosar-variable-in-impl-datatype={root-variable-data-prototype=ExpendableNonVolatile_RamBlock_Core4, target-data-prototype=ExpendableNonVolatile_Ram_Core4/NeAATR_b_AmbAirTempPred_PrevFA}, read-nv-data=NeAATR_b_AmbAirTempPred_PrevFA.NeAATR_b_AmbAirTempPred_PrevFA}
          {nv-ram-block-element=autosar-variable-in-impl-datatype={root-variable-data-prototype=ExpendableNonVolatile_RamBlock_Core4, target-data-prototype=ExpendableNonVolatile_Ram_Core4/NeAATR_b_AmbAirTempPred_PrevFA}, written-nv-data=NeAATR_b_AmbAirTempPred_PrevFA_Rx.NeAATR_b_AmbAirTempPred_PrevFA}
          {nv-ram-block-element=autosar-variable-in-impl-datatype={root-variable-data-prototype=ExpendableNonVolatile_RamBlock_Core4, target-data-prototype=ExpendableNonVolatile_Ram_Core4/NeOBCR_b_GoodConnEst}, read-nv-data=NeOBCR_b_GoodConnEst.NeOBCR_b_GoodConnEst}
          {nv-ram-block-element=autosar-variable-in-impl-datatype={root-variable-data-prototype=ExpendableNonVolatile_RamBlock_Core4, target-data-prototype=ExpendableNonVolatile_Ram_Core4/NeOBCR_b_GoodConnEst}, written-nv-data=NeOBCR_b_GoodConnEst_Rx.NeOBCR_b_GoodConnEst}
          {nv-ram-block-element=autosar-variable-in-impl-datatype={root-variable-data-prototype=ExpendableNonVolatile_RamBlock_Core4, target-data-prototype=ExpendableNonVolatile_Ram_Core4/NeOBCR_b_Lvl1Latch}, read-nv-data=NeOBCR_b_Lvl1Latch.NeOBCR_b_Lvl1Latch}
          {nv-ram-block-element=autosar-variable-in-impl-datatype={root-variable-data-prototype=ExpendableNonVolatile_RamBlock_Core4, target-data-prototype=ExpendableNonVolatile_Ram_Core4/NeOBCR_b_Lvl1Latch}, written-nv-data=NeOBCR_b_Lvl1Latch_Rx.NeOBCR_b_Lvl1Latch}
          {nv-ram-block-element=autosar-variable-in-impl-datatype={root-variable-data-prototype=ExpendableNonVolatile_RamBlock_Core4, target-data-prototype=ExpendableNonVolatile_Ram_Core4/NeOBCR_b_Lvl2Latch}, read-nv-data=NeOBCR_b_Lvl2Latch.NeOBCR_b_Lvl2Latch}
          {nv-ram-block-element=autosar-variable-in-impl-datatype={root-variable-data-prototype=ExpendableNonVolatile_RamBlock_Core4, target-data-prototype=ExpendableNonVolatile_Ram_Core4/NeOBCR_b_Lvl2Latch}, written-nv-data=NeOBCR_b_Lvl2Latch_Rx.NeOBCR_b_Lvl2Latch}
          {nv-ram-block-element=autosar-variable-in-impl-datatype={root-variable-data-prototype=ExpendableNonVolatile_RamBlock_Core4, target-data-prototype=ExpendableNonVolatile_Ram_Core4/NeOBCR_b_SmartEvse_Detected}, read-nv-data=NeOBCR_b_SmartEvse_Detected.NeOBCR_b_SmartEvse_Detected}
          {nv-ram-block-element=autosar-variable-in-impl-datatype={root-variable-data-prototype=ExpendableNonVolatile_RamBlock_Core4, target-data-prototype=ExpendableNonVolatile_Ram_Core4/NeOBCR_b_SmartEvse_Detected}, written-nv-data=NeOBCR_b_SmartEvse_Detected_Rx.NeOBCR_b_SmartEvse_Detected}
          {nv-ram-block-element=autosar-variable-in-impl-datatype={root-variable-data-prototype=ExpendableNonVolatile_RamBlock_Core4, target-data-prototype=ExpendableNonVolatile_Ram_Core4/NeOFCR_b_PluginLatchOverride}, read-nv-data=NeOFCR_b_PluginLatchOverride.NeOFCR_b_PluginLatchOverride}
          {nv-ram-block-element=autosar-variable-in-impl-datatype={root-variable-data-prototype=ExpendableNonVolatile_RamBlock_Core4, target-data-prototype=ExpendableNonVolatile_Ram_Core4/NeOFCR_b_PluginLatchOverride}, written-nv-data=NeOFCR_b_PluginLatchOverride_Rx.NeOFCR_b_PluginLatchOverride}
          {nv-ram-block-element=autosar-variable-in-impl-datatype={root-variable-data-prototype=ExpendableNonVolatile_RamBlock_Core4, target-data-prototype=ExpendableNonVolatile_Ram_Core4/NeOFCR_b_RadioRqLstVldStt}, read-nv-data=NeOFCR_b_RadioRqLstVldStt.NeOFCR_b_RadioRqLstVldStt}
          {nv-ram-block-element=autosar-variable-in-impl-datatype={root-variable-data-prototype=ExpendableNonVolatile_RamBlock_Core4, target-data-prototype=ExpendableNonVolatile_Ram_Core4/NeOFCR_b_RadioRqLstVldStt}, written-nv-data=NeOFCR_b_RadioRqLstVldStt_Rx.NeOFCR_b_RadioRqLstVldStt}
          {nv-ram-block-element=autosar-variable-in-impl-datatype={root-variable-data-prototype=ExpendableNonVolatile_RamBlock_Core4, target-data-prototype=ExpendableNonVolatile_Ram_Core4/NeBPCR_b_HV_BatPackSOC_FA_Ovrd}, read-nv-data=NeBPCR_b_HV_BatPackSOC_FA_Ovrd.NeBPCR_b_HV_BatPackSOC_FA_Ovrd}
          {nv-ram-block-element=autosar-variable-in-impl-datatype={root-variable-data-prototype=ExpendableNonVolatile_RamBlock_Core4, target-data-prototype=ExpendableNonVolatile_Ram_Core4/NeBPCR_b_HV_BatPackSOC_FA_Ovrd}, written-nv-data=NeBPCR_b_HV_BatPackSOC_FA_Ovrd_Rx.NeBPCR_b_HV_BatPackSOC_FA_Ovrd}
          {nv-ram-block-element=autosar-variable-in-impl-datatype={root-variable-data-prototype=ExpendableNonVolatile_RamBlock_Core4, target-data-prototype=ExpendableNonVolatile_Ram_Core4/NeBPCR_b_HV_BatRdy}, read-nv-data=NeBPCR_b_HV_BatRdy.NeBPCR_b_HV_BatRdy}
          {nv-ram-block-element=autosar-variable-in-impl-datatype={root-variable-data-prototype=ExpendableNonVolatile_RamBlock_Core4, target-data-prototype=ExpendableNonVolatile_Ram_Core4/NeBPCR_b_HV_BatRdy}, written-nv-data=NeBPCR_b_HV_BatRdy_Rx.NeBPCR_b_HV_BatRdy}
          {nv-ram-block-element=autosar-variable-in-impl-datatype={root-variable-data-prototype=ExpendableNonVolatile_RamBlock_Core4, target-data-prototype=ExpendableNonVolatile_Ram_Core4/NeDMIR_e_RegenSts}, read-nv-data=NeDMIR_e_RegenSts.NeDMIR_e_RegenSts}
          {nv-ram-block-element=autosar-variable-in-impl-datatype={root-variable-data-prototype=ExpendableNonVolatile_RamBlock_Core4, target-data-prototype=ExpendableNonVolatile_Ram_Core4/NeDMIR_e_RegenSts}, written-nv-data=NeDMIR_e_RegenSts_Rx.NeDMIR_e_RegenSts}
          {nv-ram-block-element=autosar-variable-in-impl-datatype={root-variable-data-prototype=ExpendableNonVolatile_RamBlock_Core4, target-data-prototype=ExpendableNonVolatile_Ram_Core4/NeCCCR_b_FirstDecrFlag_MinHot}, read-nv-data=NeCCCR_b_FirstDecrFlag_MinHot.NeCCCR_b_FirstDecrFlag_MinHot}
          {nv-ram-block-element=autosar-variable-in-impl-datatype={root-variable-data-prototype=ExpendableNonVolatile_RamBlock_Core4, target-data-prototype=ExpendableNonVolatile_Ram_Core4/NeCCCR_b_FirstDecrFlag_MinHot}, written-nv-data=NeCCCR_b_FirstDecrFlag_MinHot_Rx.NeCCCR_b_FirstDecrFlag_MinHot}
          {nv-ram-block-element=autosar-variable-in-impl-datatype={root-variable-data-prototype=ExpendableNonVolatile_RamBlock_Core4, target-data-prototype=ExpendableNonVolatile_Ram_Core4/NeCCCR_b_FirstDecrFlag_MinCold}, read-nv-data=NeCCCR_b_FirstDecrFlag_MinCold.NeCCCR_b_FirstDecrFlag_MinCold}
          {nv-ram-block-element=autosar-variable-in-impl-datatype={root-variable-data-prototype=ExpendableNonVolatile_RamBlock_Core4, target-data-prototype=ExpendableNonVolatile_Ram_Core4/NeCCCR_b_FirstDecrFlag_MinCold}, written-nv-data=NeCCCR_b_FirstDecrFlag_MinCold_Rx.NeCCCR_b_FirstDecrFlag_MinCold}
          {nv-ram-block-element=autosar-variable-in-impl-datatype={root-variable-data-prototype=ExpendableNonVolatile_RamBlock_Core4, target-data-prototype=ExpendableNonVolatile_Ram_Core4/NeCCCR_b_FirstDecrFlag_MaxHot}, read-nv-data=NeCCCR_b_FirstDecrFlag_MaxHot.NeCCCR_b_FirstDecrFlag_MaxHot}
          {nv-ram-block-element=autosar-variable-in-impl-datatype={root-variable-data-prototype=ExpendableNonVolatile_RamBlock_Core4, target-data-prototype=ExpendableNonVolatile_Ram_Core4/NeCCCR_b_FirstDecrFlag_MaxHot}, written-nv-data=NeCCCR_b_FirstDecrFlag_MaxHot_Rx.NeCCCR_b_FirstDecrFlag_MaxHot}
          {nv-ram-block-element=autosar-variable-in-impl-datatype={root-variable-data-prototype=ExpendableNonVolatile_RamBlock_Core4, target-data-prototype=ExpendableNonVolatile_Ram_Core4/NeTIMR_b_RacePrepType}, read-nv-data=NeTIMR_b_RacePrepType.NeTIMR_b_RacePrepType}
          {nv-ram-block-element=autosar-variable-in-impl-datatype={root-variable-data-prototype=ExpendableNonVolatile_RamBlock_Core4, target-data-prototype=ExpendableNonVolatile_Ram_Core4/NeTIMR_b_RacePrepType}, written-nv-data=NeTIMR_b_RacePrepType_Rx.NeTIMR_b_RacePrepType}
          {nv-ram-block-element=autosar-variable-in-impl-datatype={root-variable-data-prototype=ExpendableNonVolatile_RamBlock_Core4, target-data-prototype=ExpendableNonVolatile_Ram_Core4/NeTIMR_e_CustomDrvMdSts}, read-nv-data=NeTIMR_e_CustomDrvMdSts.NeTIMR_e_CustomDrvMdSts}
          {nv-ram-block-element=autosar-variable-in-impl-datatype={root-variable-data-prototype=ExpendableNonVolatile_RamBlock_Core4, target-data-prototype=ExpendableNonVolatile_Ram_Core4/NeTIMR_e_CustomDrvMdSts}, written-nv-data=NeTIMR_e_CustomDrvMdSts_Rx.NeTIMR_e_CustomDrvMdSts}
          {nv-ram-block-element=autosar-variable-in-impl-datatype={root-variable-data-prototype=ExpendableNonVolatile_RamBlock_Core4, target-data-prototype=ExpendableNonVolatile_Ram_Core4/NeTIMR_e_RacePrepMode}, read-nv-data=NeTIMR_e_RacePrepMode.NeTIMR_e_RacePrepMode}
          {nv-ram-block-element=autosar-variable-in-impl-datatype={root-variable-data-prototype=ExpendableNonVolatile_RamBlock_Core4, target-data-prototype=ExpendableNonVolatile_Ram_Core4/NeTIMR_e_RacePrepMode}, written-nv-data=NeTIMR_e_RacePrepMode_Rx.NeTIMR_e_RacePrepMode}
          {nv-ram-block-element=autosar-variable-in-impl-datatype={root-variable-data-prototype=ExpendableNonVolatile_RamBlock_Core4, target-data-prototype=ExpendableNonVolatile_Ram_Core4/NeCCCR_b_FirstDecrFlag_MaxCold}, read-nv-data=NeCCCR_b_FirstDecrFlag_MaxCold.NeCCCR_b_FirstDecrFlag_MaxCold}
          {nv-ram-block-element=autosar-variable-in-impl-datatype={root-variable-data-prototype=ExpendableNonVolatile_RamBlock_Core4, target-data-prototype=ExpendableNonVolatile_Ram_Core4/NeCCCR_b_FirstDecrFlag_MaxCold}, written-nv-data=NeCCCR_b_FirstDecrFlag_MaxCold_Rx.NeCCCR_b_FirstDecrFlag_MaxCold}
          {nv-ram-block-element=autosar-variable-in-impl-datatype={root-variable-data-prototype=ExpendableNonVolatile_RamBlock_Core4, target-data-prototype=ExpendableNonVolatile_Ram_Core4/NeCCCR_b_FirstDecrFlag_Hot}, read-nv-data=NeCCCR_b_FirstDecrFlag_Hot.NeCCCR_b_FirstDecrFlag_Hot}
          {nv-ram-block-element=autosar-variable-in-impl-datatype={root-variable-data-prototype=ExpendableNonVolatile_RamBlock_Core4, target-data-prototype=ExpendableNonVolatile_Ram_Core4/NeCCCR_b_FirstDecrFlag_Hot}, written-nv-data=NeCCCR_b_FirstDecrFlag_Hot_Rx.NeCCCR_b_FirstDecrFlag_Hot}
          {nv-ram-block-element=autosar-variable-in-impl-datatype={root-variable-data-prototype=ExpendableNonVolatile_RamBlock_Core4, target-data-prototype=ExpendableNonVolatile_Ram_Core4/NeCCCR_b_FirstDecrFlag_Cold}, read-nv-data=NeCCCR_b_FirstDecrFlag_Cold.NeCCCR_b_FirstDecrFlag_Cold}
          {nv-ram-block-element=autosar-variable-in-impl-datatype={root-variable-data-prototype=ExpendableNonVolatile_RamBlock_Core4, target-data-prototype=ExpendableNonVolatile_Ram_Core4/NeCCCR_b_FirstDecrFlag_Cold}, written-nv-data=NeCCCR_b_FirstDecrFlag_Cold_Rx.NeCCCR_b_FirstDecrFlag_Cold}
          {nv-ram-block-element=autosar-variable-in-impl-datatype={root-variable-data-prototype=ExpendableNonVolatile_RamBlock_Core4, target-data-prototype=ExpendableNonVolatile_Ram_Core4/NeTPCR_b_12VloadShed}, read-nv-data=NeTPCR_b_12VloadShed.NeTPCR_b_12VloadShed}
          {nv-ram-block-element=autosar-variable-in-impl-datatype={root-variable-data-prototype=ExpendableNonVolatile_RamBlock_Core4, target-data-prototype=ExpendableNonVolatile_Ram_Core4/NeTPCR_b_12VloadShed}, written-nv-data=NeTPCR_b_12VloadShed_Rx.NeTPCR_b_12VloadShed}
          {nv-ram-block-element=autosar-variable-in-impl-datatype={root-variable-data-prototype=ExpendableNonVolatile_RamBlock_Core4, target-data-prototype=ExpendableNonVolatile_Ram_Core4/NeTPCR_b_HoldCabPrecFailLtch}, read-nv-data=NeTPCR_b_HoldCabPrecFailLtch.NeTPCR_b_HoldCabPrecFailLtch}
          {nv-ram-block-element=autosar-variable-in-impl-datatype={root-variable-data-prototype=ExpendableNonVolatile_RamBlock_Core4, target-data-prototype=ExpendableNonVolatile_Ram_Core4/NeTPCR_b_HoldCabPrecFailLtch}, written-nv-data=NeTPCR_b_HoldCabPrecFailLtch_Rx.NeTPCR_b_HoldCabPrecFailLtch}
          {nv-ram-block-element=autosar-variable-in-impl-datatype={root-variable-data-prototype=ExpendableNonVolatile_RamBlock_Core4, target-data-prototype=ExpendableNonVolatile_Ram_Core4/NeTPCR_b_RS_CabPrecDeny_Prev}, read-nv-data=NeTPCR_b_RS_CabPrecDeny_Prev.NeTPCR_b_RS_CabPrecDeny_Prev}
          {nv-ram-block-element=autosar-variable-in-impl-datatype={root-variable-data-prototype=ExpendableNonVolatile_RamBlock_Core4, target-data-prototype=ExpendableNonVolatile_Ram_Core4/NeTPCR_b_RS_CabPrecDeny_Prev}, written-nv-data=NeTPCR_b_RS_CabPrecDeny_Prev_Rx.NeTPCR_b_RS_CabPrecDeny_Prev}
          {nv-ram-block-element=autosar-variable-in-impl-datatype={root-variable-data-prototype=ExpendableNonVolatile_RamBlock_Core4, target-data-prototype=ExpendableNonVolatile_Ram_Core4/NeTRGR_y_IP_PRNDLTestFailStatus}, read-nv-data=NeTRGR_y_IP_PRNDLTestFailStatus.NeTRGR_y_IP_PRNDLTestFailStatus}
          {nv-ram-block-element=autosar-variable-in-impl-datatype={root-variable-data-prototype=ExpendableNonVolatile_RamBlock_Core4, target-data-prototype=ExpendableNonVolatile_Ram_Core4/NeTRGR_y_IP_PRNDLTestFailStatus}, written-nv-data=NeTRGR_y_IP_PRNDLTestFailStatus_Rx.NeTRGR_y_IP_PRNDLTestFailStatus}
          {nv-ram-block-element=autosar-variable-in-impl-datatype={root-variable-data-prototype=ExpendableNonVolatile_RamBlock_Core4, target-data-prototype=ExpendableNonVolatile_Ram_Core4/NePPCR_e_PrvCmdVal}, read-nv-data=NePPCR_e_PrvCmdVal.NePPCR_e_PrvCmdVal}
          {nv-ram-block-element=autosar-variable-in-impl-datatype={root-variable-data-prototype=ExpendableNonVolatile_RamBlock_Core4, target-data-prototype=ExpendableNonVolatile_Ram_Core4/NePPCR_e_PrvCmdVal}, written-nv-data=NePPCR_e_PrvCmdVal_Rx.NePPCR_e_PrvCmdVal}
          {nv-ram-block-element=autosar-variable-in-impl-datatype={root-variable-data-prototype=ExpendableNonVolatile_RamBlock_Core4, target-data-prototype=ExpendableNonVolatile_Ram_Core4/NeDMIR_e_RaceModeSts}, read-nv-data=NeDMIR_e_RaceModeSts.NeDMIR_e_RaceModeSts}
          {nv-ram-block-element=autosar-variable-in-impl-datatype={root-variable-data-prototype=ExpendableNonVolatile_RamBlock_Core4, target-data-prototype=ExpendableNonVolatile_Ram_Core4/NeDMIR_e_RaceModeSts}, written-nv-data=NeDMIR_e_RaceModeSts_Rx.NeDMIR_e_RaceModeSts}
          {nv-ram-block-element=autosar-variable-in-impl-datatype={root-variable-data-prototype=ExpendableNonVolatile_RamBlock_Core4, target-data-prototype=ExpendableNonVolatile_Ram_Core4/NeDMIR_e_eCoastDefaultAuto}, read-nv-data=NeDMIR_e_eCoastDefaultAuto.NeDMIR_e_eCoastDefaultAuto}
          {nv-ram-block-element=autosar-variable-in-impl-datatype={root-variable-data-prototype=ExpendableNonVolatile_RamBlock_Core4, target-data-prototype=ExpendableNonVolatile_Ram_Core4/NeDMIR_e_eCoastDefaultAuto}, written-nv-data=NeDMIR_e_eCoastDefaultAuto_Rx.NeDMIR_e_eCoastDefaultAuto}
          {nv-ram-block-element=autosar-variable-in-impl-datatype={root-variable-data-prototype=ExpendableNonVolatile_RamBlock_Core4, target-data-prototype=ExpendableNonVolatile_Ram_Core4/NeSCPR_y_Sch2CoCH_Day}, read-nv-data=NeSCPR_y_Sch2CoCH_Day.NeSCPR_y_Sch2CoCH_Day}
          {nv-ram-block-element=autosar-variable-in-impl-datatype={root-variable-data-prototype=ExpendableNonVolatile_RamBlock_Core4, target-data-prototype=ExpendableNonVolatile_Ram_Core4/NeSCPR_y_Sch2CoCH_Day}, written-nv-data=NeSCPR_y_Sch2CoCH_Day_Rx.NeSCPR_y_Sch2CoCH_Day}
          {nv-ram-block-element=autosar-variable-in-impl-datatype={root-variable-data-prototype=ExpendableNonVolatile_RamBlock_Core4, target-data-prototype=ExpendableNonVolatile_Ram_Core4/NeRTMR_y_RngTestResult_PID}, read-nv-data=NeRTMR_y_RngTestResult_PID.NeRTMR_y_RngTestResult_PID}
          {nv-ram-block-element=autosar-variable-in-impl-datatype={root-variable-data-prototype=ExpendableNonVolatile_RamBlock_Core4, target-data-prototype=ExpendableNonVolatile_Ram_Core4/NeRTMR_y_RngTestResult_PID}, written-nv-data=NeRTMR_y_RngTestResult_PID_Rx.NeRTMR_y_RngTestResult_PID}
          {nv-ram-block-element=autosar-variable-in-impl-datatype={root-variable-data-prototype=ExpendableNonVolatile_RamBlock_Core4, target-data-prototype=ExpendableNonVolatile_Ram_Core4/NeRTMR_e_BattChrgStatus_PID}, read-nv-data=NeRTMR_e_BattChrgStatus_PID.NeRTMR_e_BattChrgStatus_PID}
          {nv-ram-block-element=autosar-variable-in-impl-datatype={root-variable-data-prototype=ExpendableNonVolatile_RamBlock_Core4, target-data-prototype=ExpendableNonVolatile_Ram_Core4/NeRTMR_e_BattChrgStatus_PID}, written-nv-data=NeRTMR_e_BattChrgStatus_PID_Rx.NeRTMR_e_BattChrgStatus_PID}
          {nv-ram-block-element=autosar-variable-in-impl-datatype={root-variable-data-prototype=ExpendableNonVolatile_RamBlock_Core4, target-data-prototype=ExpendableNonVolatile_Ram_Core4/NeRTMR_y_BattChrgCndtnCheck_PID}, read-nv-data=NeRTMR_y_BattChrgCndtnCheck_PID.NeRTMR_y_BattChrgCndtnCheck_PID}
          {nv-ram-block-element=autosar-variable-in-impl-datatype={root-variable-data-prototype=ExpendableNonVolatile_RamBlock_Core4, target-data-prototype=ExpendableNonVolatile_Ram_Core4/NeRTMR_y_BattChrgCndtnCheck_PID}, written-nv-data=NeRTMR_y_BattChrgCndtnCheck_PID_Rx.NeRTMR_y_BattChrgCndtnCheck_PID}
          {nv-ram-block-element=autosar-variable-in-impl-datatype={root-variable-data-prototype=ExpendableNonVolatile_RamBlock_Core4, target-data-prototype=ExpendableNonVolatile_Ram_Core4/NeRTMR_y_RngTestStatus_PID}, read-nv-data=NeRTMR_y_RngTestStatus_PID.NeRTMR_y_RngTestStatus_PID}
          {nv-ram-block-element=autosar-variable-in-impl-datatype={root-variable-data-prototype=ExpendableNonVolatile_RamBlock_Core4, target-data-prototype=ExpendableNonVolatile_Ram_Core4/NeRTMR_y_RngTestStatus_PID}, written-nv-data=NeRTMR_y_RngTestStatus_PID_Rx.NeRTMR_y_RngTestStatus_PID}
          {nv-ram-block-element=autosar-variable-in-impl-datatype={root-variable-data-prototype=ExpendableNonVolatile_RamBlock_Core4, target-data-prototype=ExpendableNonVolatile_Ram_Core4/NeRTMR_y_RngTstCndtnCheck1_PID}, read-nv-data=NeRTMR_y_RngTstCndtnCheck1_PID.NeRTMR_y_RngTstCndtnCheck1_PID}
          {nv-ram-block-element=autosar-variable-in-impl-datatype={root-variable-data-prototype=ExpendableNonVolatile_RamBlock_Core4, target-data-prototype=ExpendableNonVolatile_Ram_Core4/NeRTMR_y_RngTstCndtnCheck1_PID}, written-nv-data=NeRTMR_y_RngTstCndtnCheck1_PID_Rx.NeRTMR_y_RngTstCndtnCheck1_PID}
          {nv-ram-block-element=autosar-variable-in-impl-datatype={root-variable-data-prototype=ExpendableNonVolatile_RamBlock_Core4, target-data-prototype=ExpendableNonVolatile_Ram_Core4/NeRTMR_y_RngTstCndtnCheck2_PID}, read-nv-data=NeRTMR_y_RngTstCndtnCheck2_PID.NeRTMR_y_RngTstCndtnCheck2_PID}
          {nv-ram-block-element=autosar-variable-in-impl-datatype={root-variable-data-prototype=ExpendableNonVolatile_RamBlock_Core4, target-data-prototype=ExpendableNonVolatile_Ram_Core4/NeRTMR_y_RngTstCndtnCheck2_PID}, written-nv-data=NeRTMR_y_RngTstCndtnCheck2_PID_Rx.NeRTMR_y_RngTstCndtnCheck2_PID}
          {nv-ram-block-element=autosar-variable-in-impl-datatype={root-variable-data-prototype=ExpendableNonVolatile_RamBlock_Core4, target-data-prototype=ExpendableNonVolatile_Ram_Core4/NeSCPR_y_Sch1CoCH_Day}, read-nv-data=NeSCPR_y_Sch1CoCH_Day.NeSCPR_y_Sch1CoCH_Day}
          {nv-ram-block-element=autosar-variable-in-impl-datatype={root-variable-data-prototype=ExpendableNonVolatile_RamBlock_Core4, target-data-prototype=ExpendableNonVolatile_Ram_Core4/NeSCPR_y_Sch1CoCH_Day}, written-nv-data=NeSCPR_y_Sch1CoCH_Day_Rx.NeSCPR_y_Sch1CoCH_Day}
          {nv-ram-block-element=autosar-variable-in-impl-datatype={root-variable-data-prototype=ExpendableNonVolatile_RamBlock_Core4, target-data-prototype=ExpendableNonVolatile_Ram_Core4/NeSCPR_e_Sch1CH_SchType}, read-nv-data=NeSCPR_e_Sch1CH_SchType.NeSCPR_e_Sch1CH_SchType}
          {nv-ram-block-element=autosar-variable-in-impl-datatype={root-variable-data-prototype=ExpendableNonVolatile_RamBlock_Core4, target-data-prototype=ExpendableNonVolatile_Ram_Core4/NeSCPR_e_Sch1CH_SchType}, written-nv-data=NeSCPR_e_Sch1CH_SchType_Rx.NeSCPR_e_Sch1CH_SchType}
          {nv-ram-block-element=autosar-variable-in-impl-datatype={root-variable-data-prototype=ExpendableNonVolatile_RamBlock_Core4, target-data-prototype=ExpendableNonVolatile_Ram_Core4/NeSCPR_e_Sch2CH_SchType}, read-nv-data=NeSCPR_e_Sch2CH_SchType.NeSCPR_e_Sch2CH_SchType}
          {nv-ram-block-element=autosar-variable-in-impl-datatype={root-variable-data-prototype=ExpendableNonVolatile_RamBlock_Core4, target-data-prototype=ExpendableNonVolatile_Ram_Core4/NeSCPR_e_Sch2CH_SchType}, written-nv-data=NeSCPR_e_Sch2CH_SchType_Rx.NeSCPR_e_Sch2CH_SchType}
          {nv-ram-block-element=autosar-variable-in-impl-datatype={root-variable-data-prototype=ExpendableNonVolatile_RamBlock_Core4, target-data-prototype=ExpendableNonVolatile_Ram_Core4/NeENGR_b_IAT_SnsrFA}, read-nv-data=NeENGR_b_IAT_SnsrFA.NeENGR_b_IAT_SnsrFA}
          {nv-ram-block-element=autosar-variable-in-impl-datatype={root-variable-data-prototype=ExpendableNonVolatile_RamBlock_Core4, target-data-prototype=ExpendableNonVolatile_Ram_Core4/NeENGR_b_IAT_SnsrFA}, written-nv-data=NeENGR_b_IAT_SnsrFA_Rx.NeENGR_b_IAT_SnsrFA}
          {nv-ram-block-element=autosar-variable-in-impl-datatype={root-variable-data-prototype=ExpendableNonVolatile_RamBlock_Core4, target-data-prototype=ExpendableNonVolatile_Ram_Core4/NeENGR_b_ECT_SnsrFA}, read-nv-data=NeENGR_b_ECT_SnsrFA.NeENGR_b_ECT_SnsrFA}
          {nv-ram-block-element=autosar-variable-in-impl-datatype={root-variable-data-prototype=ExpendableNonVolatile_RamBlock_Core4, target-data-prototype=ExpendableNonVolatile_Ram_Core4/NeENGR_b_ECT_SnsrFA}, written-nv-data=NeENGR_b_ECT_SnsrFA_Rx.NeENGR_b_ECT_SnsrFA}
          {nv-ram-block-element=autosar-variable-in-impl-datatype={root-variable-data-prototype=ExpendableNonVolatile_RamBlock_Core4, target-data-prototype=ExpendableNonVolatile_Ram_Core4/NeDMIR_e_eCoastLvlLatched}, read-nv-data=NeDMIR_e_eCoastLvlLatched.NeDMIR_e_eCoastLvlLatched}
          {nv-ram-block-element=autosar-variable-in-impl-datatype={root-variable-data-prototype=ExpendableNonVolatile_RamBlock_Core4, target-data-prototype=ExpendableNonVolatile_Ram_Core4/NeDMIR_e_eCoastLvlLatched}, written-nv-data=NeDMIR_e_eCoastLvlLatched_Rx.NeDMIR_e_eCoastLvlLatched}
          {nv-ram-block-element=autosar-variable-in-impl-datatype={root-variable-data-prototype=ExpendableNonVolatile_RamBlock_Core4, target-data-prototype=ExpendableNonVolatile_Ram_Core4/NeDMIR_e_eCoastDefaultCustom}, read-nv-data=NeDMIR_e_eCoastDefaultCustom.NeDMIR_e_eCoastDefaultCustom}
          {nv-ram-block-element=autosar-variable-in-impl-datatype={root-variable-data-prototype=ExpendableNonVolatile_RamBlock_Core4, target-data-prototype=ExpendableNonVolatile_Ram_Core4/NeDMIR_e_eCoastDefaultCustom}, written-nv-data=NeDMIR_e_eCoastDefaultCustom_Rx.NeDMIR_e_eCoastDefaultCustom}
          {nv-ram-block-element=autosar-variable-in-impl-datatype={root-variable-data-prototype=ExpendableNonVolatile_RamBlock_Core4, target-data-prototype=ExpendableNonVolatile_Ram_Core4/NeSCPR_b_xMinUFCancel}, read-nv-data=NeSCPR_b_xMinUFCancel.NeSCPR_b_xMinUFCancel}
          {nv-ram-block-element=autosar-variable-in-impl-datatype={root-variable-data-prototype=ExpendableNonVolatile_RamBlock_Core4, target-data-prototype=ExpendableNonVolatile_Ram_Core4/NeSCPR_b_xMinUFCancel}, written-nv-data=NeSCPR_b_xMinUFCancel_Rx.NeSCPR_b_xMinUFCancel}
          {nv-ram-block-element=autosar-variable-in-impl-datatype={root-variable-data-prototype=ExpendableNonVolatile_RamBlock_Core4, target-data-prototype=ExpendableNonVolatile_Ram_Core4/NeSCPR_b_xMinUF}, read-nv-data=NeSCPR_b_xMinUF.NeSCPR_b_xMinUF}
          {nv-ram-block-element=autosar-variable-in-impl-datatype={root-variable-data-prototype=ExpendableNonVolatile_RamBlock_Core4, target-data-prototype=ExpendableNonVolatile_Ram_Core4/NeSCPR_b_xMinUF}, written-nv-data=NeSCPR_b_xMinUF_Rx.NeSCPR_b_xMinUF}
          {nv-ram-block-element=autosar-variable-in-impl-datatype={root-variable-data-prototype=ExpendableNonVolatile_RamBlock_Core4, target-data-prototype=ExpendableNonVolatile_Ram_Core4/NeSCPR_b_StopChrg}, read-nv-data=NeSCPR_b_StopChrg.NeSCPR_b_StopChrg}
          {nv-ram-block-element=autosar-variable-in-impl-datatype={root-variable-data-prototype=ExpendableNonVolatile_RamBlock_Core4, target-data-prototype=ExpendableNonVolatile_Ram_Core4/NeSCPR_b_StopChrg}, written-nv-data=NeSCPR_b_StopChrg_Rx.NeSCPR_b_StopChrg}
          {nv-ram-block-element=autosar-variable-in-impl-datatype={root-variable-data-prototype=ExpendableNonVolatile_RamBlock_Core4, target-data-prototype=ExpendableNonVolatile_Ram_Core4/NeSCPR_b_Sch2CoCH_Enbl}, read-nv-data=NeSCPR_b_Sch2CoCH_Enbl.NeSCPR_b_Sch2CoCH_Enbl}
          {nv-ram-block-element=autosar-variable-in-impl-datatype={root-variable-data-prototype=ExpendableNonVolatile_RamBlock_Core4, target-data-prototype=ExpendableNonVolatile_Ram_Core4/NeSCPR_b_Sch2CoCH_Enbl}, written-nv-data=NeSCPR_b_Sch2CoCH_Enbl_Rx.NeSCPR_b_Sch2CoCH_Enbl}
          {nv-ram-block-element=autosar-variable-in-impl-datatype={root-variable-data-prototype=ExpendableNonVolatile_RamBlock_Core4, target-data-prototype=ExpendableNonVolatile_Ram_Core4/NeHVTR_b_AntiTampFailed}, read-nv-data=NeHVTR_b_AntiTampFailed.NeHVTR_b_AntiTampFailed}
          {nv-ram-block-element=autosar-variable-in-impl-datatype={root-variable-data-prototype=ExpendableNonVolatile_RamBlock_Core4, target-data-prototype=ExpendableNonVolatile_Ram_Core4/NeHVTR_b_AntiTampFailed}, written-nv-data=NeHVTR_b_AntiTampFailed_Rx.NeHVTR_b_AntiTampFailed}
          {nv-ram-block-element=autosar-variable-in-impl-datatype={root-variable-data-prototype=ExpendableNonVolatile_RamBlock_Core4, target-data-prototype=ExpendableNonVolatile_Ram_Core4/NeSCPR_b_AllowCancel}, read-nv-data=NeSCPR_b_AllowCancel.NeSCPR_b_AllowCancel}
          {nv-ram-block-element=autosar-variable-in-impl-datatype={root-variable-data-prototype=ExpendableNonVolatile_RamBlock_Core4, target-data-prototype=ExpendableNonVolatile_Ram_Core4/NeSCPR_b_AllowCancel}, written-nv-data=NeSCPR_b_AllowCancel_Rx.NeSCPR_b_AllowCancel}
          {nv-ram-block-element=autosar-variable-in-impl-datatype={root-variable-data-prototype=ExpendableNonVolatile_RamBlock_Core4, target-data-prototype=ExpendableNonVolatile_Ram_Core4/NeSCPR_b_CancSchedIsUF}, read-nv-data=NeSCPR_b_CancSchedIsUF.NeSCPR_b_CancSchedIsUF}
          {nv-ram-block-element=autosar-variable-in-impl-datatype={root-variable-data-prototype=ExpendableNonVolatile_RamBlock_Core4, target-data-prototype=ExpendableNonVolatile_Ram_Core4/NeSCPR_b_CancSchedIsUF}, written-nv-data=NeSCPR_b_CancSchedIsUF_Rx.NeSCPR_b_CancSchedIsUF}
          {nv-ram-block-element=autosar-variable-in-impl-datatype={root-variable-data-prototype=ExpendableNonVolatile_RamBlock_Core4, target-data-prototype=ExpendableNonVolatile_Ram_Core4/NeSCPR_b_CancWindow}, read-nv-data=NeSCPR_b_CancWindow.NeSCPR_b_CancWindow}
          {nv-ram-block-element=autosar-variable-in-impl-datatype={root-variable-data-prototype=ExpendableNonVolatile_RamBlock_Core4, target-data-prototype=ExpendableNonVolatile_Ram_Core4/NeSCPR_b_CancWindow}, written-nv-data=NeSCPR_b_CancWindow_Rx.NeSCPR_b_CancWindow}
          {nv-ram-block-element=autosar-variable-in-impl-datatype={root-variable-data-prototype=ExpendableNonVolatile_RamBlock_Core4, target-data-prototype=ExpendableNonVolatile_Ram_Core4/NeSCPR_b_ChrgComplete}, read-nv-data=NeSCPR_b_ChrgComplete.NeSCPR_b_ChrgComplete}
          {nv-ram-block-element=autosar-variable-in-impl-datatype={root-variable-data-prototype=ExpendableNonVolatile_RamBlock_Core4, target-data-prototype=ExpendableNonVolatile_Ram_Core4/NeSCPR_b_ChrgComplete}, written-nv-data=NeSCPR_b_ChrgComplete_Rx.NeSCPR_b_ChrgComplete}
          {nv-ram-block-element=autosar-variable-in-impl-datatype={root-variable-data-prototype=ExpendableNonVolatile_RamBlock_Core4, target-data-prototype=ExpendableNonVolatile_Ram_Core4/NeSCPR_b_CoCH_Sch1_DNR}, read-nv-data=NeSCPR_b_CoCH_Sch1_DNR.NeSCPR_b_CoCH_Sch1_DNR}
          {nv-ram-block-element=autosar-variable-in-impl-datatype={root-variable-data-prototype=ExpendableNonVolatile_RamBlock_Core4, target-data-prototype=ExpendableNonVolatile_Ram_Core4/NeSCPR_b_CoCH_Sch1_DNR}, written-nv-data=NeSCPR_b_CoCH_Sch1_DNR_Rx.NeSCPR_b_CoCH_Sch1_DNR}
          {nv-ram-block-element=autosar-variable-in-impl-datatype={root-variable-data-prototype=ExpendableNonVolatile_RamBlock_Core4, target-data-prototype=ExpendableNonVolatile_Ram_Core4/NeSCPR_b_CoCH_Sch2_DNR}, read-nv-data=NeSCPR_b_CoCH_Sch2_DNR.NeSCPR_b_CoCH_Sch2_DNR}
          {nv-ram-block-element=autosar-variable-in-impl-datatype={root-variable-data-prototype=ExpendableNonVolatile_RamBlock_Core4, target-data-prototype=ExpendableNonVolatile_Ram_Core4/NeSCPR_b_CoCH_Sch2_DNR}, written-nv-data=NeSCPR_b_CoCH_Sch2_DNR_Rx.NeSCPR_b_CoCH_Sch2_DNR}
          {nv-ram-block-element=autosar-variable-in-impl-datatype={root-variable-data-prototype=ExpendableNonVolatile_RamBlock_Core4, target-data-prototype=ExpendableNonVolatile_Ram_Core4/NeSCPR_b_CoCh_VehLocation}, read-nv-data=NeSCPR_b_CoCh_VehLocation.NeSCPR_b_CoCh_VehLocation}
          {nv-ram-block-element=autosar-variable-in-impl-datatype={root-variable-data-prototype=ExpendableNonVolatile_RamBlock_Core4, target-data-prototype=ExpendableNonVolatile_Ram_Core4/NeSCPR_b_CoCh_VehLocation}, written-nv-data=NeSCPR_b_CoCh_VehLocation_Rx.NeSCPR_b_CoCh_VehLocation}
          {nv-ram-block-element=autosar-variable-in-impl-datatype={root-variable-data-prototype=ExpendableNonVolatile_RamBlock_Core4, target-data-prototype=ExpendableNonVolatile_Ram_Core4/NeSCPR_b_PluginLatchOverride}, read-nv-data=NeSCPR_b_PluginLatchOverride.NeSCPR_b_PluginLatchOverride}
          {nv-ram-block-element=autosar-variable-in-impl-datatype={root-variable-data-prototype=ExpendableNonVolatile_RamBlock_Core4, target-data-prototype=ExpendableNonVolatile_Ram_Core4/NeSCPR_b_PluginLatchOverride}, written-nv-data=NeSCPR_b_PluginLatchOverride_Rx.NeSCPR_b_PluginLatchOverride}
          {nv-ram-block-element=autosar-variable-in-impl-datatype={root-variable-data-prototype=ExpendableNonVolatile_RamBlock_Core4, target-data-prototype=ExpendableNonVolatile_Ram_Core4/NeSCPR_b_RadioRqLstVldStt}, read-nv-data=NeSCPR_b_RadioRqLstVldStt.NeSCPR_b_RadioRqLstVldStt}
          {nv-ram-block-element=autosar-variable-in-impl-datatype={root-variable-data-prototype=ExpendableNonVolatile_RamBlock_Core4, target-data-prototype=ExpendableNonVolatile_Ram_Core4/NeSCPR_b_RadioRqLstVldStt}, written-nv-data=NeSCPR_b_RadioRqLstVldStt_Rx.NeSCPR_b_RadioRqLstVldStt}
          {nv-ram-block-element=autosar-variable-in-impl-datatype={root-variable-data-prototype=ExpendableNonVolatile_RamBlock_Core4, target-data-prototype=ExpendableNonVolatile_Ram_Core4/NeSCPR_b_Sch1CoCH_Enbl}, read-nv-data=NeSCPR_b_Sch1CoCH_Enbl.NeSCPR_b_Sch1CoCH_Enbl}
          {nv-ram-block-element=autosar-variable-in-impl-datatype={root-variable-data-prototype=ExpendableNonVolatile_RamBlock_Core4, target-data-prototype=ExpendableNonVolatile_Ram_Core4/NeSCPR_b_Sch1CoCH_Enbl}, written-nv-data=NeSCPR_b_Sch1CoCH_Enbl_Rx.NeSCPR_b_Sch1CoCH_Enbl}
