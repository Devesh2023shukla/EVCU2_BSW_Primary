[part 5 of 5: packages /IBNvBlkSWC_4 to /IFEepNVBlk_4]
AUTOSAR XML (schema 00050)
package /IBNvBlkSWC_4  (continued)
  nv block sw component type IBNvBlkSWC_4  (continued)
    10 x nv block descriptor, all with support-dirty-flag=true:  (continued)
      FE_Descr_Core4
        nv-block-data-mappings:
          {nv-ram-block-element=autosar-variable-in-impl-datatype={root-variable-data-prototype=FE_RamBlock_Core4, target-data-prototype=FE_Ram_Core4/FeSCPR_g_ChrgNowMaxTimetoPlugin}, read-nv-data=FeSCPR_g_ChrgNowMaxTimetoPlugin.FeSCPR_g_ChrgNowMaxTimetoPlugin}
          {nv-ram-block-element=autosar-variable-in-impl-datatype={root-variable-data-prototype=FE_RamBlock_Core4, target-data-prototype=FE_Ram_Core4/FeSCPR_g_ChrgNowMaxTimetoPlugin}, written-nv-data=FeSCPR_g_ChrgNowMaxTimetoPlugin_Rx.FeSCPR_g_ChrgNowMaxTimetoPlugin}
          {nv-ram-block-element=autosar-variable-in-impl-datatype={root-variable-data-prototype=FE_RamBlock_Core4, target-data-prototype=FE_Ram_Core4/FeSCPR_T_Sch2CP_DepTemp}, read-nv-data=FeSCPR_T_Sch2CP_DepTemp.FeSCPR_T_Sch2CP_DepTemp}
          {nv-ram-block-element=autosar-variable-in-impl-datatype={root-variable-data-prototype=FE_RamBlock_Core4, target-data-prototype=FE_Ram_Core4/FeSCPR_T_Sch2CP_DepTemp}, written-nv-data=FeSCPR_T_Sch2CP_DepTemp_Rx.FeSCPR_T_Sch2CP_DepTemp}
          {nv-ram-block-element=autosar-variable-in-impl-datatype={root-variable-data-prototype=FE_RamBlock_Core4, target-data-prototype=FE_Ram_Core4/FeSCPR_T_Sch1CP_DepTemp}, read-nv-data=FeSCPR_T_Sch1CP_DepTemp.FeSCPR_T_Sch1CP_DepTemp}
          {nv-ram-block-element=autosar-variable-in-impl-datatype={root-variable-data-prototype=FE_RamBlock_Core4, target-data-prototype=FE_Ram_Core4/FeSCPR_T_Sch1CP_DepTemp}, written-nv-data=FeSCPR_T_Sch1CP_DepTemp_Rx.FeSCPR_T_Sch1CP_DepTemp}
          {nv-ram-block-element=autosar-variable-in-impl-datatype={root-variable-data-prototype=FE_RamBlock_Core4, target-data-prototype=FE_Ram_Core4/FeSCPR_e_Sch2CP_DepMin}, read-nv-data=FeSCPR_e_Sch2CP_DepMin.FeSCPR_e_Sch2CP_DepMin}
          {nv-ram-block-element=autosar-variable-in-impl-datatype={root-variable-data-prototype=FE_RamBlock_Core4, target-data-prototype=FE_Ram_Core4/FeSCPR_e_Sch2CP_DepMin}, written-nv-data=FeSCPR_e_Sch2CP_DepMin_Rx.FeSCPR_e_Sch2CP_DepMin}
          {nv-ram-block-element=autosar-variable-in-impl-datatype={root-variable-data-prototype=FE_RamBlock_Core4, target-data-prototype=FE_Ram_Core4/FeSCPR_e_Sch2CP_DepHr}, read-nv-data=FeSCPR_e_Sch2CP_DepHr.FeSCPR_e_Sch2CP_DepHr}
          {nv-ram-block-element=autosar-variable-in-impl-datatype={root-variable-data-prototype=FE_RamBlock_Core4, target-data-prototype=FE_Ram_Core4/FeSCPR_e_Sch2CP_DepHr}, written-nv-data=FeSCPR_e_Sch2CP_DepHr_Rx.FeSCPR_e_Sch2CP_DepHr}
          {nv-ram-block-element=autosar-variable-in-impl-datatype={root-variable-data-prototype=FE_RamBlock_Core4, target-data-prototype=FE_Ram_Core4/FeSCPR_e_Sch2CH_StrtMin}, read-nv-data=FeSCPR_e_Sch2CH_StrtMin.FeSCPR_e_Sch2CH_StrtMin}
          {nv-ram-block-element=autosar-variable-in-impl-datatype={root-variable-data-prototype=FE_RamBlock_Core4, target-data-prototype=FE_Ram_Core4/FeSCPR_e_Sch2CH_StrtMin}, written-nv-data=FeSCPR_e_Sch2CH_StrtMin_Rx.FeSCPR_e_Sch2CH_StrtMin}
          {nv-ram-block-element=autosar-variable-in-impl-datatype={root-variable-data-prototype=FE_RamBlock_Core4, target-data-prototype=FE_Ram_Core4/FeSCPR_e_Sch2CH_StrtHr}, read-nv-data=FeSCPR_e_Sch2CH_StrtHr.FeSCPR_e_Sch2CH_StrtHr}
          {nv-ram-block-element=autosar-variable-in-impl-datatype={root-variable-data-prototype=FE_RamBlock_Core4, target-data-prototype=FE_Ram_Core4/FeSCPR_e_Sch2CH_StrtHr}, written-nv-data=FeSCPR_e_Sch2CH_StrtHr_Rx.FeSCPR_e_Sch2CH_StrtHr}
          {nv-ram-block-element=autosar-variable-in-impl-datatype={root-variable-data-prototype=FE_RamBlock_Core4, target-data-prototype=FE_Ram_Core4/FeSCPR_e_Sch2CH_EndMin}, read-nv-data=FeSCPR_e_Sch2CH_EndMin.FeSCPR_e_Sch2CH_EndMin}
          {nv-ram-block-element=autosar-variable-in-impl-datatype={root-variable-data-prototype=FE_RamBlock_Core4, target-data-prototype=FE_Ram_Core4/FeSCPR_e_Sch2CH_EndMin}, written-nv-data=FeSCPR_e_Sch2CH_EndMin_Rx.FeSCPR_e_Sch2CH_EndMin}
          {nv-ram-block-element=autosar-variable-in-impl-datatype={root-variable-data-prototype=FE_RamBlock_Core4, target-data-prototype=FE_Ram_Core4/FeSCPR_e_Sch2CH_EndHr}, read-nv-data=FeSCPR_e_Sch2CH_EndHr.FeSCPR_e_Sch2CH_EndHr}
          {nv-ram-block-element=autosar-variable-in-impl-datatype={root-variable-data-prototype=FE_RamBlock_Core4, target-data-prototype=FE_Ram_Core4/FeSCPR_e_Sch2CH_EndHr}, written-nv-data=FeSCPR_e_Sch2CH_EndHr_Rx.FeSCPR_e_Sch2CH_EndHr}
          {nv-ram-block-element=autosar-variable-in-impl-datatype={root-variable-data-prototype=FE_RamBlock_Core4, target-data-prototype=FE_Ram_Core4/FeSCPR_e_Sch1CP_DepMin}, read-nv-data=FeSCPR_e_Sch1CP_DepMin.FeSCPR_e_Sch1CP_DepMin}
          {nv-ram-block-element=autosar-variable-in-impl-datatype={root-variable-data-prototype=FE_RamBlock_Core4, target-data-prototype=FE_Ram_Core4/FeSCPR_e_Sch1CP_DepMin}, written-nv-data=FeSCPR_e_Sch1CP_DepMin_Rx.FeSCPR_e_Sch1CP_DepMin}
          {nv-ram-block-element=autosar-variable-in-impl-datatype={root-variable-data-prototype=FE_RamBlock_Core4, target-data-prototype=FE_Ram_Core4/FeSCPR_e_Sch1CP_DepHr}, read-nv-data=FeSCPR_e_Sch1CP_DepHr.FeSCPR_e_Sch1CP_DepHr}
          {nv-ram-block-element=autosar-variable-in-impl-datatype={root-variable-data-prototype=FE_RamBlock_Core4, target-data-prototype=FE_Ram_Core4/FeSCPR_e_Sch1CP_DepHr}, written-nv-data=FeSCPR_e_Sch1CP_DepHr_Rx.FeSCPR_e_Sch1CP_DepHr}
          {nv-ram-block-element=autosar-variable-in-impl-datatype={root-variable-data-prototype=FE_RamBlock_Core4, target-data-prototype=FE_Ram_Core4/FeSCPR_e_Sch1CH_StrtMin}, read-nv-data=FeSCPR_e_Sch1CH_StrtMin.FeSCPR_e_Sch1CH_StrtMin}
          {nv-ram-block-element=autosar-variable-in-impl-datatype={root-variable-data-prototype=FE_RamBlock_Core4, target-data-prototype=FE_Ram_Core4/FeSCPR_e_Sch1CH_StrtMin}, written-nv-data=FeSCPR_e_Sch1CH_StrtMin_Rx.FeSCPR_e_Sch1CH_StrtMin}
          {nv-ram-block-element=autosar-variable-in-impl-datatype={root-variable-data-prototype=FE_RamBlock_Core4, target-data-prototype=FE_Ram_Core4/FeSCPR_e_Sch1CH_StrtHr}, read-nv-data=FeSCPR_e_Sch1CH_StrtHr.FeSCPR_e_Sch1CH_StrtHr}
          {nv-ram-block-element=autosar-variable-in-impl-datatype={root-variable-data-prototype=FE_RamBlock_Core4, target-data-prototype=FE_Ram_Core4/FeSCPR_e_Sch1CH_StrtHr}, written-nv-data=FeSCPR_e_Sch1CH_StrtHr_Rx.FeSCPR_e_Sch1CH_StrtHr}
          {nv-ram-block-element=autosar-variable-in-impl-datatype={root-variable-data-prototype=FE_RamBlock_Core4, target-data-prototype=FE_Ram_Core4/FeSCPR_e_Sch1CH_EndMin}, read-nv-data=FeSCPR_e_Sch1CH_EndMin.FeSCPR_e_Sch1CH_EndMin}
          {nv-ram-block-element=autosar-variable-in-impl-datatype={root-variable-data-prototype=FE_RamBlock_Core4, target-data-prototype=FE_Ram_Core4/FeSCPR_e_Sch1CH_EndMin}, written-nv-data=FeSCPR_e_Sch1CH_EndMin_Rx.FeSCPR_e_Sch1CH_EndMin}
          {nv-ram-block-element=autosar-variable-in-impl-datatype={root-variable-data-prototype=FE_RamBlock_Core4, target-data-prototype=FE_Ram_Core4/FeSCPR_e_Sch1CH_EndHr}, read-nv-data=FeSCPR_e_Sch1CH_EndHr.FeSCPR_e_Sch1CH_EndHr}
          {nv-ram-block-element=autosar-variable-in-impl-datatype={root-variable-data-prototype=FE_RamBlock_Core4, target-data-prototype=FE_Ram_Core4/FeSCPR_e_Sch1CH_EndHr}, written-nv-data=FeSCPR_e_Sch1CH_EndHr_Rx.FeSCPR_e_Sch1CH_EndHr}
          {nv-ram-block-element=autosar-variable-in-impl-datatype={root-variable-data-prototype=FE_RamBlock_Core4, target-data-prototype=FE_Ram_Core4/FeSCPR_b_Sch2CP_DNR}, read-nv-data=FeSCPR_b_Sch2CP_DNR.FeSCPR_b_Sch2CP_DNR}
          {nv-ram-block-element=autosar-variable-in-impl-datatype={root-variable-data-prototype=FE_RamBlock_Core4, target-data-prototype=FE_Ram_Core4/FeSCPR_b_Sch2CP_DNR}, written-nv-data=FeSCPR_b_Sch2CP_DNR_Rx.FeSCPR_b_Sch2CP_DNR}
          {nv-ram-block-element=autosar-variable-in-impl-datatype={root-variable-data-prototype=FE_RamBlock_Core4, target-data-prototype=FE_Ram_Core4/FeSCPR_b_CancelActFOTA}, read-nv-data=FeSCPR_b_CancelActFOTA.FeSCPR_b_CancelActFOTA}
          {nv-ram-block-element=autosar-variable-in-impl-datatype={root-variable-data-prototype=FE_RamBlock_Core4, target-data-prototype=FE_Ram_Core4/FeSCPR_b_CancelActFOTA}, written-nv-data=FeSCPR_b_CancelActFOTA_Rx.FeSCPR_b_CancelActFOTA}
          {nv-ram-block-element=autosar-variable-in-impl-datatype={root-variable-data-prototype=FE_RamBlock_Core4, target-data-prototype=FE_Ram_Core4/FeSCPR_b_ChrgNowLatch}, read-nv-data=FeSCPR_b_ChrgNowLatch.FeSCPR_b_ChrgNowLatch}
          {nv-ram-block-element=autosar-variable-in-impl-datatype={root-variable-data-prototype=FE_RamBlock_Core4, target-data-prototype=FE_Ram_Core4/FeSCPR_b_ChrgNowLatch}, written-nv-data=FeSCPR_b_ChrgNowLatch_Rx.FeSCPR_b_ChrgNowLatch}
          {nv-ram-block-element=autosar-variable-in-impl-datatype={root-variable-data-prototype=FE_RamBlock_Core4, target-data-prototype=FE_Ram_Core4/FeSCPR_b_FOTA_Conflict}, read-nv-data=FeSCPR_b_FOTA_Conflict.FeSCPR_b_FOTA_Conflict}
          {nv-ram-block-element=autosar-variable-in-impl-datatype={root-variable-data-prototype=FE_RamBlock_Core4, target-data-prototype=FE_Ram_Core4/FeSCPR_b_FOTA_Conflict}, written-nv-data=FeSCPR_b_FOTA_Conflict_Rx.FeSCPR_b_FOTA_Conflict}
          {nv-ram-block-element=autosar-variable-in-impl-datatype={root-variable-data-prototype=FE_RamBlock_Core4, target-data-prototype=FE_Ram_Core4/FeSCPR_b_Sch1CH_ChrgUntFl}, read-nv-data=FeSCPR_b_Sch1CH_ChrgUntFl.FeSCPR_b_Sch1CH_ChrgUntFl}
          {nv-ram-block-element=autosar-variable-in-impl-datatype={root-variable-data-prototype=FE_RamBlock_Core4, target-data-prototype=FE_Ram_Core4/FeSCPR_b_Sch1CH_ChrgUntFl}, written-nv-data=FeSCPR_b_Sch1CH_ChrgUntFl_Rx.FeSCPR_b_Sch1CH_ChrgUntFl}
          {nv-ram-block-element=autosar-variable-in-impl-datatype={root-variable-data-prototype=FE_RamBlock_Core4, target-data-prototype=FE_Ram_Core4/FeSCPR_b_Sch1CH_DNR}, read-nv-data=FeSCPR_b_Sch1CH_DNR.FeSCPR_b_Sch1CH_DNR}
          {nv-ram-block-element=autosar-variable-in-impl-datatype={root-variable-data-prototype=FE_RamBlock_Core4, target-data-prototype=FE_Ram_Core4/FeSCPR_b_Sch1CH_DNR}, written-nv-data=FeSCPR_b_Sch1CH_DNR_Rx.FeSCPR_b_Sch1CH_DNR}
          {nv-ram-block-element=autosar-variable-in-impl-datatype={root-variable-data-prototype=FE_RamBlock_Core4, target-data-prototype=FE_Ram_Core4/FeSCPR_b_Sch1CH_Enbl}, read-nv-data=FeSCPR_b_Sch1CH_Enbl.FeSCPR_b_Sch1CH_Enbl}
          {nv-ram-block-element=autosar-variable-in-impl-datatype={root-variable-data-prototype=FE_RamBlock_Core4, target-data-prototype=FE_Ram_Core4/FeSCPR_b_Sch1CH_Enbl}, written-nv-data=FeSCPR_b_Sch1CH_Enbl_Rx.FeSCPR_b_Sch1CH_Enbl}
          {nv-ram-block-element=autosar-variable-in-impl-datatype={root-variable-data-prototype=FE_RamBlock_Core4, target-data-prototype=FE_Ram_Core4/FeSCPR_b_Sch1CP_DNR}, read-nv-data=FeSCPR_b_Sch1CP_DNR.FeSCPR_b_Sch1CP_DNR}
          {nv-ram-block-element=autosar-variable-in-impl-datatype={root-variable-data-prototype=FE_RamBlock_Core4, target-data-prototype=FE_Ram_Core4/FeSCPR_b_Sch1CP_DNR}, written-nv-data=FeSCPR_b_Sch1CP_DNR_Rx.FeSCPR_b_Sch1CP_DNR}
          {nv-ram-block-element=autosar-variable-in-impl-datatype={root-variable-data-prototype=FE_RamBlock_Core4, target-data-prototype=FE_Ram_Core4/FeSCPR_b_Sch1CP_Enbl}, read-nv-data=FeSCPR_b_Sch1CP_Enbl.FeSCPR_b_Sch1CP_Enbl}
          {nv-ram-block-element=autosar-variable-in-impl-datatype={root-variable-data-prototype=FE_RamBlock_Core4, target-data-prototype=FE_Ram_Core4/FeSCPR_b_Sch1CP_Enbl}, written-nv-data=FeSCPR_b_Sch1CP_Enbl_Rx.FeSCPR_b_Sch1CP_Enbl}
          {nv-ram-block-element=autosar-variable-in-impl-datatype={root-variable-data-prototype=FE_RamBlock_Core4, target-data-prototype=FE_Ram_Core4/FeSCPR_b_Sch2CH_ChrgUntFl}, read-nv-data=FeSCPR_b_Sch2CH_ChrgUntFl.FeSCPR_b_Sch2CH_ChrgUntFl}
          {nv-ram-block-element=autosar-variable-in-impl-datatype={root-variable-data-prototype=FE_RamBlock_Core4, target-data-prototype=FE_Ram_Core4/FeSCPR_b_Sch2CH_ChrgUntFl}, written-nv-data=FeSCPR_b_Sch2CH_ChrgUntFl_Rx.FeSCPR_b_Sch2CH_ChrgUntFl}
          {nv-ram-block-element=autosar-variable-in-impl-datatype={root-variable-data-prototype=FE_RamBlock_Core4, target-data-prototype=FE_Ram_Core4/FeSCPR_b_Sch2CH_DNR}, read-nv-data=FeSCPR_b_Sch2CH_DNR.FeSCPR_b_Sch2CH_DNR}
          {nv-ram-block-element=autosar-variable-in-impl-datatype={root-variable-data-prototype=FE_RamBlock_Core4, target-data-prototype=FE_Ram_Core4/FeSCPR_b_Sch2CH_DNR}, written-nv-data=FeSCPR_b_Sch2CH_DNR_Rx.FeSCPR_b_Sch2CH_DNR}
          {nv-ram-block-element=autosar-variable-in-impl-datatype={root-variable-data-prototype=FE_RamBlock_Core4, target-data-prototype=FE_Ram_Core4/FeSCPR_b_Sch2CH_Enbl}, read-nv-data=FeSCPR_b_Sch2CH_Enbl.FeSCPR_b_Sch2CH_Enbl}
          {nv-ram-block-element=autosar-variable-in-impl-datatype={root-variable-data-prototype=FE_RamBlock_Core4, target-data-prototype=FE_Ram_Core4/FeSCPR_b_Sch2CH_Enbl}, written-nv-data=FeSCPR_b_Sch2CH_Enbl_Rx.FeSCPR_b_Sch2CH_Enbl}
          {nv-ram-block-element=autosar-variable-in-impl-datatype={root-variable-data-prototype=FE_RamBlock_Core4, target-data-prototype=FE_Ram_Core4/FeSCPR_b_Sch2CP_Enbl}, read-nv-data=FeSCPR_b_Sch2CP_Enbl.FeSCPR_b_Sch2CP_Enbl}
          {nv-ram-block-element=autosar-variable-in-impl-datatype={root-variable-data-prototype=FE_RamBlock_Core4, target-data-prototype=FE_Ram_Core4/FeSCPR_b_Sch2CP_Enbl}, written-nv-data=FeSCPR_b_Sch2CP_Enbl_Rx.FeSCPR_b_Sch2CP_Enbl}
          {nv-ram-block-element=autosar-variable-in-impl-datatype={root-variable-data-prototype=FE_RamBlock_Core4, target-data-prototype=FE_Ram_Core4/FeSCPR_e_FOTA_Install_Type}, read-nv-data=FeSCPR_e_FOTA_Install_Type.FeSCPR_e_FOTA_Install_Type}
          {nv-ram-block-element=autosar-variable-in-impl-datatype={root-variable-data-prototype=FE_RamBlock_Core4, target-data-prototype=FE_Ram_Core4/FeSCPR_e_FOTA_Install_Type}, written-nv-data=FeSCPR_e_FOTA_Install_Type_Rx.FeSCPR_e_FOTA_Install_Type}
          {nv-ram-block-element=autosar-variable-in-impl-datatype={root-variable-data-prototype=FE_RamBlock_Core4, target-data-prototype=FE_Ram_Core4/FeSCPR_e_Sch1CP_Allow}, read-nv-data=FeSCPR_e_Sch1CP_Allow.FeSCPR_e_Sch1CP_Allow}
          {nv-ram-block-element=autosar-variable-in-impl-datatype={root-variable-data-prototype=FE_RamBlock_Core4, target-data-prototype=FE_Ram_Core4/FeSCPR_e_Sch1CP_Allow}, written-nv-data=FeSCPR_e_Sch1CP_Allow_Rx.FeSCPR_e_Sch1CP_Allow}
          {nv-ram-block-element=autosar-variable-in-impl-datatype={root-variable-data-prototype=FE_RamBlock_Core4, target-data-prototype=FE_Ram_Core4/FeSCPR_e_Sch2CP_Allow}, read-nv-data=FeSCPR_e_Sch2CP_Allow.FeSCPR_e_Sch2CP_Allow}
          {nv-ram-block-element=autosar-variable-in-impl-datatype={root-variable-data-prototype=FE_RamBlock_Core4, target-data-prototype=FE_Ram_Core4/FeSCPR_e_Sch2CP_Allow}, written-nv-data=FeSCPR_e_Sch2CP_Allow_Rx.FeSCPR_e_Sch2CP_Allow}
          {nv-ram-block-element=autosar-variable-in-impl-datatype={root-variable-data-prototype=FE_RamBlock_Core4, target-data-prototype=FE_Ram_Core4/FeSCPR_y_Sch1CH_Day}, read-nv-data=FeSCPR_y_Sch1CH_Day.FeSCPR_y_Sch1CH_Day}
          {nv-ram-block-element=autosar-variable-in-impl-datatype={root-variable-data-prototype=FE_RamBlock_Core4, target-data-prototype=FE_Ram_Core4/FeSCPR_y_Sch1CH_Day}, written-nv-data=FeSCPR_y_Sch1CH_Day_Rx.FeSCPR_y_Sch1CH_Day}
          {nv-ram-block-element=autosar-variable-in-impl-datatype={root-variable-data-prototype=FE_RamBlock_Core4, target-data-prototype=FE_Ram_Core4/FeSCPR_y_Sch1CP_Day}, read-nv-data=FeSCPR_y_Sch1CP_Day.FeSCPR_y_Sch1CP_Day}
          {nv-ram-block-element=autosar-variable-in-impl-datatype={root-variable-data-prototype=FE_RamBlock_Core4, target-data-prototype=FE_Ram_Core4/FeSCPR_y_Sch1CP_Day}, written-nv-data=FeSCPR_y_Sch1CP_Day_Rx.FeSCPR_y_Sch1CP_Day}
          {nv-ram-block-element=autosar-variable-in-impl-datatype={root-variable-data-prototype=FE_RamBlock_Core4, target-data-prototype=FE_Ram_Core4/FeSCPR_y_Sch2CH_Day}, read-nv-data=FeSCPR_y_Sch2CH_Day.FeSCPR_y_Sch2CH_Day}
          {nv-ram-block-element=autosar-variable-in-impl-datatype={root-variable-data-prototype=FE_RamBlock_Core4, target-data-prototype=FE_Ram_Core4/FeSCPR_y_Sch2CH_Day}, written-nv-data=FeSCPR_y_Sch2CH_Day_Rx.FeSCPR_y_Sch2CH_Day}
          {nv-ram-block-element=autosar-variable-in-impl-datatype={root-variable-data-prototype=FE_RamBlock_Core4, target-data-prototype=FE_Ram_Core4/FeSCPR_y_Sch2CP_Day}, read-nv-data=FeSCPR_y_Sch2CP_Day.FeSCPR_y_Sch2CP_Day}
          {nv-ram-block-element=autosar-variable-in-impl-datatype={root-variable-data-prototype=FE_RamBlock_Core4, target-data-prototype=FE_Ram_Core4/FeSCPR_y_Sch2CP_Day}, written-nv-data=FeSCPR_y_Sch2CP_Day_Rx.FeSCPR_y_Sch2CP_Day}
        nv block needs NvBlockNeeds: calc-ram-block-crc=false, check-static-block-id=false, readonly=false, resistant-to-changed-sw=true, restore-at-start=true, store-at-shutdown=true, store-cyclic=false, store-emergency=false, store-immediate=false, use-auto-validation-at-shut-down=false, use-crc-comp-mechanism=true, write-only-once=true, write-verification=false
        ram block FE_RamBlock_Core4: type=FE_Ram_Core4, init-value={short-label=FE_Ram_Core4, fields=[FeSCPR_g_ChrgNowMaxTimetoPlugin:0, FeSCPR_T_Sch2CP_DepTemp:0, FeSCPR_T_Sch1CP_DepTemp:0, FeSCPR_e_Sch2CP_DepMin:0, FeSCPR_e_Sch2CP_DepHr:0, FeSCPR_e_Sch2CH_StrtMin:0, FeSCPR_e_Sch2CH_StrtHr:0, FeSCPR_e_Sch2CH_EndMin:0, FeSCPR_e_Sch2CH_EndHr:0, FeSCPR_e_Sch1CP_DepMin:0, FeSCPR_e_Sch1CP_DepHr:0, FeSCPR_e_Sch1CH_StrtMin:0, FeSCPR_e_Sch1CH_StrtHr:0, FeSCPR_e_Sch1CH_EndMin:0, FeSCPR_e_Sch1CH_EndHr:0, FeSCPR_b_Sch2CP_DNR:0, FeSCPR_b_CancelActFOTA:0, FeSCPR_b_ChrgNowLatch:0, FeSCPR_b_FOTA_Conflict:0, FeSCPR_b_Sch1CH_ChrgUntFl:0, FeSCPR_b_Sch1CH_DNR:0, FeSCPR_b_Sch1CH_Enbl:0, FeSCPR_b_Sch1CP_DNR:0, FeSCPR_b_Sch1CP_Enbl:0, FeSCPR_b_Sch2CH_ChrgUntFl:0, FeSCPR_b_Sch2CH_DNR:0, FeSCPR_b_Sch2CH_Enbl:0, FeSCPR_b_Sch2CP_Enbl:0, FeSCPR_e_FOTA_Install_Type:0, FeSCPR_e_Sch1CP_Allow:0, FeSCPR_e_Sch2CP_Allow:0, FeSCPR_y_Sch1CH_Day:0, FeSCPR_y_Sch1CP_Day:0, FeSCPR_y_Sch2CH_Day:0, FeSCPR_y_Sch2CP_Day:0]}
        rom block FE_RomBlock_Core4: type=FE_Rom_Core4, init-value={short-label=FE_Rom_Core4, fields=[FeSCPR_g_ChrgNowMaxTimetoPlugin:0, FeSCPR_T_Sch2CP_DepTemp:0, FeSCPR_T_Sch1CP_DepTemp:0, FeSCPR_e_Sch2CP_DepMin:0, FeSCPR_e_Sch2CP_DepHr:0, FeSCPR_e_Sch2CH_StrtMin:0, FeSCPR_e_Sch2CH_StrtHr:0, FeSCPR_e_Sch2CH_EndMin:0, FeSCPR_e_Sch2CH_EndHr:0, FeSCPR_e_Sch1CP_DepMin:0, FeSCPR_e_Sch1CP_DepHr:0, FeSCPR_e_Sch1CH_StrtMin:0, FeSCPR_e_Sch1CH_StrtHr:0, FeSCPR_e_Sch1CH_EndMin:0, FeSCPR_e_Sch1CH_EndHr:0, FeSCPR_b_Sch2CP_DNR:0, FeSCPR_b_CancelActFOTA:0, FeSCPR_b_ChrgNowLatch:0, FeSCPR_b_FOTA_Conflict:0, FeSCPR_b_Sch1CH_ChrgUntFl:0, FeSCPR_b_Sch1CH_DNR:0, FeSCPR_b_Sch1CH_Enbl:0, FeSCPR_b_Sch1CP_DNR:0, FeSCPR_b_Sch1CP_Enbl:0, FeSCPR_b_Sch2CH_ChrgUntFl:0, FeSCPR_b_Sch2CH_DNR:0, FeSCPR_b_Sch2CH_Enbl:0, FeSCPR_b_Sch2CP_Enbl:0, FeSCPR_e_FOTA_Install_Type:0, FeSCPR_e_Sch1CP_Allow:0, FeSCPR_e_Sch2CP_Allow:0, FeSCPR_y_Sch1CH_Day:0, FeSCPR_y_Sch1CP_Day:0, FeSCPR_y_Sch2CH_Day:0, FeSCPR_y_Sch2CP_Day:0]}
      EE_RunTimeBlock1_Descr_Core4
        nv-block-data-mappings:
          {nv-ram-block-element=autosar-variable-in-impl-datatype={root-variable-data-prototype=EE_RunTimeBlock1_RamBlock_Core4, target-data-prototype=EE_RunTimeBlock1_Ram_Core4/AeASLR_v_STSLSpdLimMPH}, read-nv-data=AeASLR_v_STSLSpdLimMPH.AeASLR_v_STSLSpdLimMPH}
          {nv-ram-block-element=autosar-variable-in-impl-datatype={root-variable-data-prototype=EE_RunTimeBlock1_RamBlock_Core4, target-data-prototype=EE_RunTimeBlock1_Ram_Core4/AeASLR_v_STSLSpdLimMPH}, written-nv-data=AeASLR_v_STSLSpdLimMPH_Rx.AeASLR_v_STSLSpdLimMPH}
          {nv-ram-block-element=autosar-variable-in-impl-datatype={root-variable-data-prototype=EE_RunTimeBlock1_RamBlock_Core4, target-data-prototype=EE_RunTimeBlock1_Ram_Core4/AeDCCR_y_DCChrgTestSts}, read-nv-data=AeDCCR_y_DCChrgTestSts.AeDCCR_y_DCChrgTestSts}
          {nv-ram-block-element=autosar-variable-in-impl-datatype={root-variable-data-prototype=EE_RunTimeBlock1_RamBlock_Core4, target-data-prototype=EE_RunTimeBlock1_Ram_Core4/AeDCCR_y_DCChrgTestSts}, written-nv-data=AeDCCR_y_DCChrgTestSts_Rx.AeDCCR_y_DCChrgTestSts}
          {nv-ram-block-element=autosar-variable-in-impl-datatype={root-variable-data-prototype=EE_RunTimeBlock1_RamBlock_Core4, target-data-prototype=EE_RunTimeBlock1_Ram_Core4/AeADIR_e_WEDExtToolCmd}, read-nv-data=AeADIR_e_WEDExtToolCmd.AeADIR_e_WEDExtToolCmd}
          {nv-ram-block-element=autosar-variable-in-impl-datatype={root-variable-data-prototype=EE_RunTimeBlock1_RamBlock_Core4, target-data-prototype=EE_RunTimeBlock1_Ram_Core4/AeADIR_e_WEDExtToolCmd}, written-nv-data=AeADIR_e_WEDExtToolCmd_Rx.AeADIR_e_WEDExtToolCmd}
          {nv-ram-block-element=autosar-variable-in-impl-datatype={root-variable-data-prototype=EE_RunTimeBlock1_RamBlock_Core4, target-data-prototype=EE_RunTimeBlock1_Ram_Core4/AeTRGR_y_PwrDwnSts}, read-nv-data=AeTRGR_y_PwrDwnSts.AeTRGR_y_PwrDwnSts}
          {nv-ram-block-element=autosar-variable-in-impl-datatype={root-variable-data-prototype=EE_RunTimeBlock1_RamBlock_Core4, target-data-prototype=EE_RunTimeBlock1_Ram_Core4/AeTRGR_y_PwrDwnSts}, written-nv-data=AeTRGR_y_PwrDwnSts_Rx.AeTRGR_y_PwrDwnSts}
          {nv-ram-block-element=autosar-variable-in-impl-datatype={root-variable-data-prototype=EE_RunTimeBlock1_RamBlock_Core4, target-data-prototype=EE_RunTimeBlock1_Ram_Core4/AeRTMR_b_ElectricOnlyTest_Enabled}, read-nv-data=AeRTMR_b_ElectricOnlyTest_Enabled.AeRTMR_b_ElectricOnlyTest_Enabled}
          {nv-ram-block-element=autosar-variable-in-impl-datatype={root-variable-data-prototype=EE_RunTimeBlock1_RamBlock_Core4, target-data-prototype=EE_RunTimeBlock1_Ram_Core4/AeRTMR_b_ElectricOnlyTest_Enabled}, written-nv-data=AeRTMR_b_ElectricOnlyTest_Enabled_Rx.AeRTMR_b_ElectricOnlyTest_Enabled}
          {nv-ram-block-element=autosar-variable-in-impl-datatype={root-variable-data-prototype=EE_RunTimeBlock1_RamBlock_Core4, target-data-prototype=EE_RunTimeBlock1_Ram_Core4/AeRTMR_e_EngStrtType_LstActn}, read-nv-data=AeRTMR_e_EngStrtType_LstActn.AeRTMR_e_EngStrtType_LstActn}
          {nv-ram-block-element=autosar-variable-in-impl-datatype={root-variable-data-prototype=EE_RunTimeBlock1_RamBlock_Core4, target-data-prototype=EE_RunTimeBlock1_Ram_Core4/AeRTMR_e_EngStrtType_LstActn}, written-nv-data=AeRTMR_e_EngStrtType_LstActn_Rx.AeRTMR_e_EngStrtType_LstActn}
          {nv-ram-block-element=autosar-variable-in-impl-datatype={root-variable-data-prototype=EE_RunTimeBlock1_RamBlock_Core4, target-data-prototype=EE_RunTimeBlock1_Ram_Core4/AeRTMR_e_WED_ToothAbutResult}, read-nv-data=AeRTMR_e_WED_ToothAbutResult.AeRTMR_e_WED_ToothAbutResult}
          {nv-ram-block-element=autosar-variable-in-impl-datatype={root-variable-data-prototype=EE_RunTimeBlock1_RamBlock_Core4, target-data-prototype=EE_RunTimeBlock1_Ram_Core4/AeRTMR_e_WED_ToothAbutResult}, written-nv-data=AeRTMR_e_WED_ToothAbutResult_Rx.AeRTMR_e_WED_ToothAbutResult}
          {nv-ram-block-element=autosar-variable-in-impl-datatype={root-variable-data-prototype=EE_RunTimeBlock1_RamBlock_Core4, target-data-prototype=EE_RunTimeBlock1_Ram_Core4/AeRTMR_y_ElecOnlyTestResult_PID}, read-nv-data=AeRTMR_y_ElecOnlyTestResult_PID.AeRTMR_y_ElecOnlyTestResult_PID}
          {nv-ram-block-element=autosar-variable-in-impl-datatype={root-variable-data-prototype=EE_RunTimeBlock1_RamBlock_Core4, target-data-prototype=EE_RunTimeBlock1_Ram_Core4/AeRTMR_y_ElecOnlyTestResult_PID}, written-nv-data=AeRTMR_y_ElecOnlyTestResult_PID_Rx.AeRTMR_y_ElecOnlyTestResult_PID}
          {nv-ram-block-element=autosar-variable-in-impl-datatype={root-variable-data-prototype=EE_RunTimeBlock1_RamBlock_Core4, target-data-prototype=EE_RunTimeBlock1_Ram_Core4/AeRTMR_y_ElecOnlyTestStatus_PID}, read-nv-data=AeRTMR_y_ElecOnlyTestStatus_PID.AeRTMR_y_ElecOnlyTestStatus_PID}
          {nv-ram-block-element=autosar-variable-in-impl-datatype={root-variable-data-prototype=EE_RunTimeBlock1_RamBlock_Core4, target-data-prototype=EE_RunTimeBlock1_Ram_Core4/AeRTMR_y_ElecOnlyTestStatus_PID}, written-nv-data=AeRTMR_y_ElecOnlyTestStatus_PID_Rx.AeRTMR_y_ElecOnlyTestStatus_PID}
          {nv-ram-block-element=autosar-variable-in-impl-datatype={root-variable-data-prototype=EE_RunTimeBlock1_RamBlock_Core4, target-data-prototype=EE_RunTimeBlock1_Ram_Core4/AeIMPR_b_HVRpdShtdwnCmd}, read-nv-data=AeIMPR_b_HVRpdShtdwnCmd.AeIMPR_b_HVRpdShtdwnCmd}
          {nv-ram-block-element=autosar-variable-in-impl-datatype={root-variable-data-prototype=EE_RunTimeBlock1_RamBlock_Core4, target-data-prototype=EE_RunTimeBlock1_Ram_Core4/AeIMPR_b_HVRpdShtdwnCmd}, written-nv-data=AeIMPR_b_HVRpdShtdwnCmd_Rx.AeIMPR_b_HVRpdShtdwnCmd}
        nv block needs NvBlockNeeds: calc-ram-block-crc=false, check-static-block-id=false, readonly=false, resistant-to-changed-sw=false, restore-at-start=true, store-at-shutdown=false, store-cyclic=false, store-emergency=false, store-immediate=true, use-auto-validation-at-shut-down=false, use-crc-comp-mechanism=true, write-only-once=false, write-verification=false
        ram block EE_RunTimeBlock1_RamBlock_Core4: type=EE_RunTimeBlock1_Ram_Core4, init-value={short-label=EE_RunTimeBlock1_Ram_Core4, fields=[AeASLR_v_STSLSpdLimMPH:0, AeDCCR_y_DCChrgTestSts:0, AeADIR_e_WEDExtToolCmd:0, AeTRGR_y_PwrDwnSts:0, AeRTMR_b_ElectricOnlyTest_Enabled:0, AeRTMR_e_EngStrtType_LstActn:0, AeRTMR_e_WED_ToothAbutResult:0, AeRTMR_y_ElecOnlyTestResult_PID:0, AeRTMR_y_ElecOnlyTestStatus_PID:0, AeIMPR_b_HVRpdShtdwnCmd:0, Reserved1:0, Reserved2:0, Reserved3:0]}
        rom block EE_RunTimeBlock1_RomBlock_Core4: type=EE_RunTimeBlock1_Rom_Core4, init-value={short-label=EE_RunTimeBlock1_Rom_Core4, fields=[AeASLR_v_STSLSpdLimMPH:0, AeDCCR_y_DCChrgTestSts:0, AeADIR_e_WEDExtToolCmd:0, AeTRGR_y_PwrDwnSts:0, AeRTMR_b_ElectricOnlyTest_Enabled:0, AeRTMR_e_EngStrtType_LstActn:0, AeRTMR_e_WED_ToothAbutResult:0, AeRTMR_y_ElecOnlyTestResult_PID:0, AeRTMR_y_ElecOnlyTestStatus_PID:0, AeIMPR_b_HVRpdShtdwnCmd:0, Reserved1:0, Reserved2:0, Reserved3:0]}
      EE_RunTimeBlock2_Descr_Core4
        nv-block-data-mappings:
          {nv-ram-block-element=autosar-variable-in-impl-datatype={root-variable-data-prototype=EE_RunTimeBlock2_RamBlock_Core4, target-data-prototype=EE_RunTimeBlock2_Ram_Core4/AePLTR_Pct_CS_SOCSetPt}, read-nv-data=AePLTR_Pct_CS_SOCSetPt.AePLTR_Pct_CS_SOCSetPt}
          {nv-ram-block-element=autosar-variable-in-impl-datatype={root-variable-data-prototype=EE_RunTimeBlock2_RamBlock_Core4, target-data-prototype=EE_RunTimeBlock2_Ram_Core4/AePLTR_Pct_CS_SOCSetPt}, written-nv-data=AePLTR_Pct_CS_SOCSetPt_Rx.AePLTR_Pct_CS_SOCSetPt}
          {nv-ram-block-element=autosar-variable-in-impl-datatype={root-variable-data-prototype=EE_RunTimeBlock2_RamBlock_Core4, target-data-prototype=EE_RunTimeBlock2_Ram_Core4/AePLTR_Pct_IP_SOCSetPt}, read-nv-data=AePLTR_Pct_IP_SOCSetPt.AePLTR_Pct_IP_SOCSetPt}
          {nv-ram-block-element=autosar-variable-in-impl-datatype={root-variable-data-prototype=EE_RunTimeBlock2_RamBlock_Core4, target-data-prototype=EE_RunTimeBlock2_Ram_Core4/AePLTR_Pct_IP_SOCSetPt}, written-nv-data=AePLTR_Pct_IP_SOCSetPt_Rx.AePLTR_Pct_IP_SOCSetPt}
          {nv-ram-block-element=autosar-variable-in-impl-datatype={root-variable-data-prototype=EE_RunTimeBlock2_RamBlock_Core4, target-data-prototype=EE_RunTimeBlock2_Ram_Core4/AePLTR_milel_IPEETestMileageLimit}, read-nv-data=AePLTR_milel_IPEETestMileageLimit.AePLTR_milel_IPEETestMileageLimit}
          {nv-ram-block-element=autosar-variable-in-impl-datatype={root-variable-data-prototype=EE_RunTimeBlock2_RamBlock_Core4, target-data-prototype=EE_RunTimeBlock2_Ram_Core4/AePLTR_milel_IPEETestMileageLimit}, written-nv-data=AePLTR_milel_IPEETestMileageLimit_Rx.AePLTR_milel_IPEETestMileageLimit}
          {nv-ram-block-element=autosar-variable-in-impl-datatype={root-variable-data-prototype=EE_RunTimeBlock2_RamBlock_Core4, target-data-prototype=EE_RunTimeBlock2_Ram_Core4/AePLTR_milel_OdometerLimit}, read-nv-data=AePLTR_milel_OdometerLimit.AePLTR_milel_OdometerLimit}
          {nv-ram-block-element=autosar-variable-in-impl-datatype={root-variable-data-prototype=EE_RunTimeBlock2_RamBlock_Core4, target-data-prototype=EE_RunTimeBlock2_Ram_Core4/AePLTR_milel_OdometerLimit}, written-nv-data=AePLTR_milel_OdometerLimit_Rx.AePLTR_milel_OdometerLimit}
          {nv-ram-block-element=autosar-variable-in-impl-datatype={root-variable-data-prototype=EE_RunTimeBlock2_RamBlock_Core4, target-data-prototype=EE_RunTimeBlock2_Ram_Core4/AePLTR_b_InFieldMode}, read-nv-data=AePLTR_b_InFieldMode.AePLTR_b_InFieldMode}
          {nv-ram-block-element=autosar-variable-in-impl-datatype={root-variable-data-prototype=EE_RunTimeBlock2_RamBlock_Core4, target-data-prototype=EE_RunTimeBlock2_Ram_Core4/AePLTR_b_InFieldMode}, written-nv-data=AePLTR_b_InFieldMode_Rx.AePLTR_b_InFieldMode}
          {nv-ram-block-element=autosar-variable-in-impl-datatype={root-variable-data-prototype=EE_RunTimeBlock2_RamBlock_Core4, target-data-prototype=EE_RunTimeBlock2_Ram_Core4/AePLTR_b_PwrOffOk}, read-nv-data=AePLTR_b_PwrOffOk.AePLTR_b_PwrOffOk}
          {nv-ram-block-element=autosar-variable-in-impl-datatype={root-variable-data-prototype=EE_RunTimeBlock2_RamBlock_Core4, target-data-prototype=EE_RunTimeBlock2_Ram_Core4/AePLTR_b_PwrOffOk}, written-nv-data=AePLTR_b_PwrOffOk_Rx.AePLTR_b_PwrOffOk}
          {nv-ram-block-element=autosar-variable-in-impl-datatype={root-variable-data-prototype=EE_RunTimeBlock2_RamBlock_Core4, target-data-prototype=EE_RunTimeBlock2_Ram_Core4/AePLTR_b_REMDisabled}, read-nv-data=AePLTR_b_REMDisabled.AePLTR_b_REMDisabled}
          {nv-ram-block-element=autosar-variable-in-impl-datatype={root-variable-data-prototype=EE_RunTimeBlock2_RamBlock_Core4, target-data-prototype=EE_RunTimeBlock2_Ram_Core4/AePLTR_b_REMDisabled}, written-nv-data=AePLTR_b_REMDisabled_Rx.AePLTR_b_REMDisabled}
          {nv-ram-block-element=autosar-variable-in-impl-datatype={root-variable-data-prototype=EE_RunTimeBlock2_RamBlock_Core4, target-data-prototype=EE_RunTimeBlock2_Ram_Core4/AePLTR_b_RadFanHandshake_disbld}, read-nv-data=AePLTR_b_RadFanHandshake_disbld.AePLTR_b_RadFanHandshake_disbld}
          {nv-ram-block-element=autosar-variable-in-impl-datatype={root-variable-data-prototype=EE_RunTimeBlock2_RamBlock_Core4, target-data-prototype=EE_RunTimeBlock2_Ram_Core4/AePLTR_b_RadFanHandshake_disbld}, written-nv-data=AePLTR_b_RadFanHandshake_disbld_Rx.AePLTR_b_RadFanHandshake_disbld}
        nv block needs NvBlockNeeds: calc-ram-block-crc=false, check-static-block-id=false, readonly=false, resistant-to-changed-sw=false, restore-at-start=true, store-at-shutdown=false, store-cyclic=false, store-emergency=false, store-immediate=true, use-auto-validation-at-shut-down=false, use-crc-comp-mechanism=true, write-only-once=false, write-verification=false
        ram block EE_RunTimeBlock2_RamBlock_Core4: type=EE_RunTimeBlock2_Ram_Core4, init-value={short-label=EE_RunTimeBlock2_Ram_Core4, fields=[AePLTR_Pct_CS_SOCSetPt:0, AePLTR_Pct_IP_SOCSetPt:0, AePLTR_milel_IPEETestMileageLimit:0, AePLTR_milel_OdometerLimit:0, AePLTR_b_InFieldMode:0, AePLTR_b_PwrOffOk:0, AePLTR_b_REMDisabled:0, AePLTR_b_RadFanHandshake_disbld:0]}
        rom block EE_RunTimeBlock2_RomBlock_Core4: type=EE_RunTimeBlock2_Rom_Core4, init-value={short-label=EE_RunTimeBlock2_Rom_Core4, fields=[AePLTR_Pct_CS_SOCSetPt:0, AePLTR_Pct_IP_SOCSetPt:0, AePLTR_milel_IPEETestMileageLimit:0, AePLTR_milel_OdometerLimit:0, AePLTR_b_InFieldMode:0, AePLTR_b_PwrOffOk:0, AePLTR_b_REMDisabled:0, AePLTR_b_RadFanHandshake_disbld:0]}
      EE_IMMOBILIZERMMKEY_StrIMM_Descr_Core4
        nv-block-data-mappings:
          {nv-ram-block-element=autosar-variable-in-impl-datatype={root-variable-data-prototype=EE_IMMOBILIZERMMKEY_StrIMM_RamBlock_Core4, target-data-prototype=EE_IMMOBILIZERMMKEY_StrIMM_Ram_Core4/AaIMOR_y_MMKeyStr_EE}, read-nv-data=AaIMOR_y_MMKeyStr_EE.AaIMOR_y_MMKeyStr_EE}
          {nv-ram-block-element=autosar-variable-in-impl-datatype={root-variable-data-prototype=EE_IMMOBILIZERMMKEY_StrIMM_RamBlock_Core4, target-data-prototype=EE_IMMOBILIZERMMKEY_StrIMM_Ram_Core4/AaIMOR_y_MMKeyStr_EE}, written-nv-data=AaIMOR_y_MMKeyStr_EE_Rx.AaIMOR_y_MMKeyStr_EE}
        nv block needs NvBlockNeeds: calc-ram-block-crc=false, check-static-block-id=false, readonly=false, resistant-to-changed-sw=false, restore-at-start=true, store-at-shutdown=false, store-cyclic=false, store-emergency=false, store-immediate=true, use-auto-validation-at-shut-down=false, use-crc-comp-mechanism=true, write-only-once=false, write-verification=false
        ram block EE_IMMOBILIZERMMKEY_StrIMM_RamBlock_Core4: type=EE_IMMOBILIZERMMKEY_StrIMM_Ram_Core4, init-value={short-label=EE_IMMOBILIZERMMKEY_StrIMM_Ram_Core4, fields=[AaIMOR_y_MMKeyStr_EE:[ArrayElement0:0, ArrayElement1:0, ArrayElement2:0, ArrayElement3:0, ArrayElement4:0, ArrayElement5:0, ArrayElement6:0], Reserved1:0]}
        rom block EE_IMMOBILIZERMMKEY_StrIMM_RomBlock_Core4: type=EE_IMMOBILIZERMMKEY_StrIMM_Rom_Core4, init-value={short-label=EE_IMMOBILIZERMMKEY_StrIMM_Rom_Core4, fields=[AaIMOR_y_MMKeyStr_EE:[ArrayElement0:0, ArrayElement1:0, ArrayElement2:0, ArrayElement3:0, ArrayElement4:0, ArrayElement5:0, ArrayElement6:0], Reserved1:0]}
      EE_IMMOBILIZERAUTHSTAT_StrIMM_Descr_Core4
        nv-block-data-mappings:
          {nv-ram-block-element=autosar-variable-in-impl-datatype={root-variable-data-prototype=EE_IMMOBILIZERAUTHSTAT_StrIMM_RamBlock_Core4, target-data-prototype=EE_IMMOBILIZERAUTHSTAT_StrIMM_Ram_Core4/AeIMOR_b_UpdtAuthStat}, read-nv-data=AeIMOR_b_UpdtAuthStat.AeIMOR_b_UpdtAuthStat}
          {nv-ram-block-element=autosar-variable-in-impl-datatype={root-variable-data-prototype=EE_IMMOBILIZERAUTHSTAT_StrIMM_RamBlock_Core4, target-data-prototype=EE_IMMOBILIZERAUTHSTAT_StrIMM_Ram_Core4/AeIMOR_b_UpdtAuthStat}, written-nv-data=AeIMOR_b_UpdtAuthStat_Rx.AeIMOR_b_UpdtAuthStat}
        nv block needs NvBlockNeeds: calc-ram-block-crc=false, check-static-block-id=false, readonly=false, resistant-to-changed-sw=false, restore-at-start=true, store-at-shutdown=false, store-cyclic=false, store-emergency=false, store-immediate=true, use-auto-validation-at-shut-down=false, use-crc-comp-mechanism=true, write-only-once=false, write-verification=false
        ram block EE_IMMOBILIZERAUTHSTAT_StrIMM_RamBlock_Core4: type=EE_IMMOBILIZERAUTHSTAT_StrIMM_Ram_Core4, init-value={short-label=EE_IMMOBILIZERAUTHSTAT_StrIMM_Ram_Core4, fields=[AeIMOR_b_UpdtAuthStat:0, Reserved1:0, Reserved2:0, Reserved3:0]}
        rom block EE_IMMOBILIZERAUTHSTAT_StrIMM_RomBlock_Core4: type=EE_IMMOBILIZERAUTHSTAT_StrIMM_Rom_Core4, init-value={short-label=EE_IMMOBILIZERAUTHSTAT_StrIMM_Rom_Core4, fields=[AeIMOR_b_UpdtAuthStat:0, Reserved1:0, Reserved2:0, Reserved3:0]}
      EE_IMMOBYPASSCNTR_StrIMM_Descr_Core4
        nv-block-data-mappings:
          {nv-ram-block-element=autosar-variable-in-impl-datatype={root-variable-data-prototype=EE_IMMOBYPASSCNTR_StrIMM_RamBlock_Core4, target-data-prototype=EE_IMMOBYPASSCNTR_StrIMM_Ram_Core4/AeIMOR_Cnt_ImmoByPassCntr}, read-nv-data=AeIMOR_Cnt_ImmoByPassCntr.AeIMOR_Cnt_ImmoByPassCntr}
          {nv-ram-block-element=autosar-variable-in-impl-datatype={root-variable-data-prototype=EE_IMMOBYPASSCNTR_StrIMM_RamBlock_Core4, target-data-prototype=EE_IMMOBYPASSCNTR_StrIMM_Ram_Core4/AeIMOR_Cnt_ImmoByPassCntr}, written-nv-data=AeIMOR_Cnt_ImmoByPassCntr_Rx.AeIMOR_Cnt_ImmoByPassCntr}
        nv block needs NvBlockNeeds: calc-ram-block-crc=false, check-static-block-id=false, readonly=false, resistant-to-changed-sw=false, restore-at-start=true, store-at-shutdown=false, store-cyclic=false, store-emergency=false, store-immediate=true, use-auto-validation-at-shut-down=false, use-crc-comp-mechanism=true, write-only-once=false, write-verification=false
        ram block EE_IMMOBYPASSCNTR_StrIMM_RamBlock_Core4: type=EE_IMMOBYPASSCNTR_StrIMM_Ram_Core4, init-value={short-label=EE_IMMOBYPASSCNTR_StrIMM_Ram_Core4, fields=[AeIMOR_Cnt_ImmoByPassCntr:0, Reserved1:0, Reserved2:0, Reserved3:0]}
        rom block EE_IMMOBYPASSCNTR_StrIMM_RomBlock_Core4: type=EE_IMMOBYPASSCNTR_StrIMM_Rom_Core4, init-value={short-label=EE_IMMOBYPASSCNTR_StrIMM_Rom_Core4, fields=[AeIMOR_Cnt_ImmoByPassCntr:0, Reserved1:0, Reserved2:0, Reserved3:0]}
package /IFEepNVBlk_4
  20 x impl type, all with category=STRUCTURE:
    ExpendableNonVolatile_Ram_Core4
      359 x element, all with category=TYPE_REFERENCE:
        NeESMC_I_Ahrperhr_DS: implementation-data-type=float32
        NeSCPR_g_DoNotRepeatValSch1: implementation-data-type=uint32
        NeSCPR_Pct_Sch1CoCH_ImmSOCtrgt: implementation-data-type=float32
        NeSCPR_Pct_Sch2CoCH_ExtSOCtrgt: implementation-data-type=float32
        NeSCPR_Pct_Sch2CoCH_ImmSOCtrgt: implementation-data-type=float32
        NeDCCR_E_TECharge: implementation-data-type=float32
        NeDCCR_E_TEDischarge: implementation-data-type=float32
        NeSCPR_k_LastSecond: implementation-data-type=float32
        NeSCPR_k_LastRTC: implementation-data-type=float32
        NeSCPR_k_CancOverlapTrack: implementation-data-type=float32
        NeSCPR_k_CancGlStartTrack: implementation-data-type=float32
        NeSCPR_k_CancGlEndTrack: implementation-data-type=float32
        NeSCPR_k_CabinTempSetPoint: implementation-data-type=float32
        NeSCPR_g_Sch2CoCH_DNRvalue: implementation-data-type=uint32
        NeSCPR_g_Sch2CP_DNRvalue: implementation-data-type=uint32
        NeSCPR_g_Sch1CoCH_DNRvalue: implementation-data-type=uint32
        NeSCPR_g_Sch1CP_DNRvalue: implementation-data-type=uint32
        NeSCPR_g_DoNotRepeatValSch2: implementation-data-type=uint32
        NeSCPR_Pct_SOCArb: implementation-data-type=float32
        NeSCPR_Pct_Sch1CoCH_ExtSOCtrgt: implementation-data-type=float32
        NeITIR_t_TimeToResetRecentVar: implementation-data-type=float32
        NeITIR_E_MtrATotalTractionEnergy_Lifetime: implementation-data-type=float32
        NeITIR_E_MtrATotalTractionEnergy_Recent: implementation-data-type=float32
        NeITIR_E_MtrBTotalTractionEnergy_Lifetime: implementation-data-type=float32
        NeITIR_E_MtrBTotalTractionEnergy_Recent: implementation-data-type=float32
        NeITIR_E_NonGrdEnrgy_Lifetime: implementation-data-type=float32
        NeITIR_E_NonGrdEnrgy_Recent: implementation-data-type=float32
        NeITIR_l_DistTravelChrgDepEngOff_Lifetime: implementation-data-type=float32
        NeITIR_l_DistTravelChrgDepEngOff_Recent: implementation-data-type=float32
        NeITIR_l_DistTravelChrgDepEngOn_Lifetime: implementation-data-type=float32
        NeITIR_l_DistTravelChrgDepEngOn_Recent: implementation-data-type=float32
        NeITIR_l_DistTravelChrgIncrease_Recent: implementation-data-type=float32
        NeITIR_l_DistTrvlChrgIncrease_Lifetime: implementation-data-type=float32
        NeITIR_l_TotalDistTravelled_Lifetime: implementation-data-type=float32
        NeITIR_l_TotalDistTravelled_Recent: implementation-data-type=float32
        NeITIR_E_GrdEnrgyIntoBatt_Lifetime: implementation-data-type=float32
        NeITIR_E_GrdEnrgyIntoBatt_Recent: implementation-data-type=float32
        NeITIR_E_GrdEnrgyChrgDepEngOn_Recent: implementation-data-type=float32
        NeCSVR_l_DistSinceCodeClr: implementation-data-type=float32
        NeITIR_Cnt_FuelConsChrgDep_Lifetime: implementation-data-type=uint32
        NeRTMR_t_BattChrgTimer_PID: implementation-data-type=float32
        NeRTMR_P_BattChrgPwrOffset_PID: implementation-data-type=float32
        NeRTMR_It_BattChrgTarget_PID: implementation-data-type=float32
        NeRTMR_It_BattChrgInitDiff_PID: implementation-data-type=float32
        NeRTMR_It_BattChargedAmnt_PID: implementation-data-type=float32
        NeITIR_Cnt_FuelConsChrgDep_Recent: implementation-data-type=uint32
        NeITIR_E_GrdEnrgyChrgDepEngOn_Lifetime: implementation-data-type=float32
        NeITIR_Cnt_FuelConsChrgIncrease_Lifetime: implementation-data-type=uint32
        NeITIR_Cnt_FuelConsChrgIncrease_Recent: implementation-data-type=uint32
        NeITIR_Cnt_FuelEngIgnCycl_Lifetime: implementation-data-type=uint32
        NeITIR_Cnt_FuelEngIgnCycl_Recent: implementation-data-type=uint32
        NeITIR_Cnt_IgnCycl_Lifetime: implementation-data-type=uint32
        NeITIR_Cnt_IgnCycl_Recent: implementation-data-type=uint32
        NeITIR_Cnt_Total_City_PSA_Time_Lifetime: implementation-data-type=uint32
        NeITIR_Cnt_Total_City_PSA_Time_Recent: implementation-data-type=uint32
        NeITIR_Cnt_Total_Idle_PSA_Time_Lifetime: implementation-data-type=uint32
        NeITIR_Cnt_Total_Idle_PSA_Time_Recent: implementation-data-type=uint32
        NeITIR_Cnt_Total_PSA_Time_Lifetime: implementation-data-type=uint32
        NeITIR_Cnt_Total_PSA_Time_Recent: implementation-data-type=uint32
        NeITIR_E_GrdEnrgyChrgDepEngOff_Lifetime: implementation-data-type=float32
        NeITIR_E_GrdEnrgyChrgDepEngOff_Recent: implementation-data-type=float32
        NeCSVR_l_DistTravelMIL_On: implementation-data-type=float32
        NeBPCR_T_BatModTmp: implementation-data-type=float32
        NeTPCR_Pct_WupSOC: implementation-data-type=float32
        NeCCCR_P_PLSMaxPower: implementation-data-type=float32
        NeCCCR_T_AmbTemp_CntrlrOff: implementation-data-type=float32
        NeCCCR_T_EngTemp_CntrlrOff: implementation-data-type=float32
        NeCCCR_t_CntrlrOnTime: implementation-data-type=uint32
        NeASLR_v_InitVehSpdLim: implementation-data-type=float32
        NeAATR_T_AmbAirTempPred_Prev: implementation-data-type=float32
        NeCCCR_t_CntrlrOffTime: implementation-data-type=uint32
        NePWDR_Cnt_HVFuseEMFOP: implementation-data-type=uint16
        NeVLDR_Cnt_CPV2_PerfDiag_MFOP: implementation-data-type=uint16
        NeVLDR_Cnt_BHV_PerfDiag_MFOP: implementation-data-type=uint16
        NeVLDR_Cnt_CPV_PerfDiag_MFOP: implementation-data-type=uint16
        NePWDR_Cnt_HVOverVoltFailureMSOF: implementation-data-type=uint16
        NeVLDR_Cnt_CabVlvOpeng_Err_MFOP: implementation-data-type=uint16
        NePWDR_Cnt_HVOverVoltWarnMFOP: implementation-data-type=uint16
        NeVLDR_Cnt_EEXV_PerfDiag_MFOP: implementation-data-type=uint16
        NeVLDR_Cnt_EEXV_PressElctrFlt_MFOP: implementation-data-type=uint16
        NePWDR_Cnt_HVFuseDMFOP: implementation-data-type=uint16
        NePWDR_Cnt_HVFuseCMFOP: implementation-data-type=uint16
        NePWDR_Cnt_HVILCkt_MFOP: implementation-data-type=uint16
        NePWDR_Cnt_HVFuseBMFOP: implementation-data-type=uint16
        NePWDR_Cnt_HVFuseAMFOP: implementation-data-type=uint16
        NePWDR_Cnt_HVDAPMFOP: implementation-data-type=uint16
        NePWDR_Cnt_HVOverVoltFailureMFOP: implementation-data-type=uint16
        NeVLDR_Cnt_EEXV_TempElctrFlt_MFOP: implementation-data-type=uint16
        NePWDR_Cnt_BattOverTempFailureMFOP: implementation-data-type=uint16
        NeVLDR_Cnt_EEXV_PressSens_MFOP: implementation-data-type=uint16
        NeVLDR_Cnt_EXV_PerfDiag_MFOP: implementation-data-type=uint16
        NePMDR_Cnt_BF1SysVoltHi_MFOP: implementation-data-type=uint16
        NePMDR_Cnt_BFHBSpareSysVoltHi_MFOP: implementation-data-type=uint16
        NePMDR_Cnt_BF3SysVoltLow_MFOP: implementation-data-type=uint16
        NeVLDR_Cnt_OEXV_PressElctrFlt_MFOP: implementation-data-type=uint16
        NeVLDR_Cnt_OEXV_PressSens_MFOP: implementation-data-type=uint16
        NePMDR_Cnt_BF3SysVoltHi_MFOP: implementation-data-type=uint16
        NePMDR_Cnt_BF2SysVoltLow_MFOP: implementation-data-type=uint16
        NePMDR_Cnt_BF2SysVoltHi_MFOP: implementation-data-type=uint16
        NePMDR_Cnt_BF1SysVoltLow_MFOP: implementation-data-type=uint16
        NePMDD_Cnt_RunLoMaxFOP: implementation-data-type=uint16
        NeVLDR_Cnt_EXV_PressElctrFlt_MFOP: implementation-data-type=uint16
        NeVLDR_Cnt_OEXV_TempElctrFlt_MFOP: implementation-data-type=uint16
        NeAADR_Cnt_AAD_PerfDiag_MFOP: implementation-data-type=uint16
        NePMDD_Cnt_RunCrankOpenMaxFOP: implementation-data-type=uint16
        NePMDD_Cnt_RunCrankHiMaxFOP: implementation-data-type=uint16
        NePMDD_Cnt_AccLoMaxFOP: implementation-data-type=uint16
        NePMDD_Cnt_AccHiMaxFOP: implementation-data-type=uint16
        NePMDR_Cnt_BFHBSysVoltHi_MFOP: implementation-data-type=uint16
        NePMDR_Cnt_HBSpareSysVoltLow_MFOP: implementation-data-type=uint16
        NePMDR_Cnt_HBSysVoltLow_MFOP: implementation-data-type=uint16
        NePWDR_Cnt_HVUnderVoltFailureMFOP: implementation-data-type=uint16
        NeVLDR_Cnt_EXV_PressSens_MFOP: implementation-data-type=uint16
        NeVLDR_Cnt_EXV_TempElctrFlt_MFOP: implementation-data-type=uint16
        NeVLDR_Cnt_EXV_TempSens_MFOP: implementation-data-type=uint16
        NeVLDR_Cnt_HCTV_Leak_MFOP: implementation-data-type=uint16
        NeVLDR_Cnt_HTL_PerfDiag_MFOP: implementation-data-type=uint16
        NeVLDR_Cnt_HTSoV_StkCls_MFOP: implementation-data-type=uint16
        NePWDR_Cnt_BPCM_MFOP: implementation-data-type=uint16
        NeVLDR_Cnt_HTSoV_StkOpn_MFOP: implementation-data-type=uint16
        NeVLDR_Cnt_LTR_PerfDiag_MFOP: implementation-data-type=uint16
        NeVLDR_Cnt_LTSOV_StkOff_MFOP: implementation-data-type=uint16
        NeVLDR_Cnt_LTSOV_StkOn_MFOP: implementation-data-type=uint16
        NeVLDR_Cnt_OEXV_PerfDiag_MFOP: implementation-data-type=uint16
        NePWDR_Cnt_HVOverVoltWarnMSOF: implementation-data-type=uint16
        NeTHDR_Cnt_OEXV_In_MFOP: implementation-data-type=uint16
        NePWDR_Cnt_HVUnderVoltFailureMSOF: implementation-data-type=uint16
        NeTHDR_Cnt_InTmpSns_MFOP: implementation-data-type=uint16
        NeTHDR_Cnt_HTAP_MFOP: implementation-data-type=uint16
        NeTHDR_Cnt_HCCTOS_MFOP: implementation-data-type=uint16
        NeSCPR_e_NxtSchCH_StrtDay: implementation-data-type=sint16
        NeSCPR_e_NxtSchCH_EndMin: implementation-data-type=sint16
        NeSCPR_e_NxtSchCH_StrtMin: implementation-data-type=sint16
        NeSCPR_e_NxtSchCH_EndHr: implementation-data-type=sint16
        NeSCPR_e_NxtSchCH_EndDay: implementation-data-type=sint16
        NeSCPR_e_LastNowIndex: implementation-data-type=sint16
        NeSCPR_e_EndIndexCanc: implementation-data-type=sint16
        NeSCPR_e_CancelStartIndx: implementation-data-type=sint16
        NeSCPR_e_CancStartIdxHold: implementation-data-type=sint16
        NeSCPR_e_NxtSchCH_StrtHr: implementation-data-type=sint16
        NeSCPR_e_Sch2CoCH_StopMin: implementation-data-type=sint16
        NeTHDR_Cnt_OEXV_Out_MFOP: implementation-data-type=uint16
        NeTHDR_Cnt_OOCTOS_MFOP: implementation-data-type=uint16
        NeTHDR_Cnt_PPCTIS_MFOP: implementation-data-type=uint16
        NeTHDR_Cnt_PPCTIS_OT_MSOP: implementation-data-type=uint16
        NeTHDR_Cnt_LTPP2_MFOP: implementation-data-type=uint16
        NeTHDR_Cnt_LRCTOS_MFOP: implementation-data-type=uint16
        NeTIDR_Cnt_EngTrqHiFlt_MFOP: implementation-data-type=uint16
        NeTIDR_Cnt_EngTrqHiFlt_MSOF: implementation-data-type=uint16
        NeSCPR_e_Sch2CoCH_StopHr: implementation-data-type=sint16
        NeTISD_Cnt_SpdRatlFlt_MFOP: implementation-data-type=uint16
        NeSCPR_e_Sch1CoCH_StopMin: implementation-data-type=sint16
        NeSCPR_e_Sch1CoCH_StopHr: implementation-data-type=sint16
        NeTIDR_Cnt_EngTrqLoFlt_MFOP: implementation-data-type=uint16
        NeTIDR_Cnt_EngTrqLoFlt_MSOF: implementation-data-type=uint16
        NeTIMR_e_TrrnMdSt: implementation-data-type=uint16
        NeSCPR_e_NxtSchCP_StrtMin: implementation-data-type=sint16
        NeSCPR_e_NxtSchCP_StrtHr: implementation-data-type=sint16
        NeSCPR_e_NxtSchCP_Day: implementation-data-type=sint16
        NeTHDR_Cnt_HCCTIS_MFOP: implementation-data-type=uint16
        NeTHDR_Cnt_LTPP_MFOP: implementation-data-type=uint16
        NeTHDR_Cnt_AGS2_Perf_MFOP: implementation-data-type=uint16
        NePWDR_Cnt_StuckHiFOP: implementation-data-type=uint16
        NePWDR_Cnt_SOCLowWarnMFOP: implementation-data-type=uint16
        NePWDR_Cnt_SOCLowFailureMFOP: implementation-data-type=uint16
        NePWDR_Cnt_SOCHighWarnMFOP: implementation-data-type=uint16
        NePWDR_Cnt_SOCHighFailureMFOP: implementation-data-type=uint16
        NePWDR_Cnt_MsmtchLowFOP: implementation-data-type=uint16
        NePWDR_Cnt_HVUnderVoltWarnMSOF: implementation-data-type=uint16
        NeTHDR_Cnt_AGS_Perf_MFOP: implementation-data-type=uint16
        NeTHDR_Cnt_EEXV_Out_MFOP: implementation-data-type=uint16
        NeTHDR_Cnt_ECH_outTmpSns_MFOP: implementation-data-type=uint16
        NeTHDR_Cnt_ECHTIS_MFOP: implementation-data-type=uint16
        NePWDR_Cnt_HVUnderVoltWarnMFOP: implementation-data-type=uint16
        NePMDD_Cnt_RunHiMaxFOP: implementation-data-type=uint16
        NeCPDR_Cnt_LTAP_FunPer_MFOP: implementation-data-type=uint16
        NeCSVD_Cnt_RearAxleRatlFlt_MFOP: implementation-data-type=uint16
        NeCSVD_Cnt_FrontAxleRatlFlt_MFOP: implementation-data-type=uint16
        NeCPDR_Cnt_LTPP_FunPer_MFOP: implementation-data-type=uint16
        NeCPDR_Cnt_LTPP_FunDryRun_MFOP: implementation-data-type=uint16
        NeCPDR_Cnt_LTPP2_FunPer_MFOP: implementation-data-type=uint16
        NeCPDR_Cnt_LTPP2_FunDryRun_MFOP: implementation-data-type=uint16
        NeCPDR_Cnt_LTAP_FunDryRun_MFOP: implementation-data-type=uint16
        NeDMIR_e_DriveStyleSts: implementation-data-type=uint16
        NeCPDR_Cnt_HTAP_FunPer_MFOP: implementation-data-type=uint16
        NeCPDR_Cnt_EOPB_FunPer_MFOP: implementation-data-type=uint16
        NeCPDR_Cnt_EOPB_FunDryRun_MFOP: implementation-data-type=uint16
        NeCPDR_Cnt_EOPA_FunPer_MFOP: implementation-data-type=uint16
        NeCPDR_Cnt_EOPA_FunDryRun_MFOP: implementation-data-type=uint16
        NeCDMR_Cnt_PwrOutletPanelMod2Perf_MFOP: implementation-data-type=uint16
        NeCDMR_Cnt_PwrOutletPanelMod2LmpCntrl_MFOP: implementation-data-type=uint16
        NeCDMR_Cnt_PwrOutletPanelMod2InACPwrCktPerf_MFOP: implementation-data-type=uint16
        NeCDMR_Cnt_PwrOutletPanelMod1Perf_MFOP: implementation-data-type=uint16
        NeDMIR_e_DrvMdArb: implementation-data-type=uint16
        NeHCDR_Cnt_HVC_Heater_MFOP: implementation-data-type=uint16
        NeHSWD_Cnt_SecBnt_Correlation_MFOP: implementation-data-type=uint16
        NeHSWD_Cnt_SecBnt_CircuitPerf_MFOP: implementation-data-type=uint16
        NeHSWD_Cnt_SecBnt_CircuitLow_MFOP: implementation-data-type=uint16
        NeHSWD_Cnt_SecBnt_CircuitHigh_MFOP: implementation-data-type=uint16
        NeHSWD_Cnt_CBC_FaultLow_MFOP: implementation-data-type=uint16
        NeHSWD_Cnt_CBC_FaultHigh_MFOP: implementation-data-type=uint16
        NeHCDR_Cnt_HVC_Heater4_MFOP: implementation-data-type=uint16
        NeHCDR_Cnt_HVC_Heater3_MFOP: implementation-data-type=uint16
        NeHCDR_Cnt_HVC_Heater2_MFOP: implementation-data-type=uint16
        NeHCDR_Cnt_EACPref_MFOP: implementation-data-type=uint16
        NeGENR_Cnt_InPlantAPMOff: implementation-data-type=uint16
        NeCDMR_Cnt_PwrOutletPanelMod1LmpCntrl_MFOP: implementation-data-type=uint16
        NeCDMR_Cnt_PwrOutletPanelMod1InACPwrCktPerf_MFOP: implementation-data-type=uint16
        NeCDMR_Cnt_InletSensor_MFOP: implementation-data-type=uint16
        NeAATR_Cnt_SCP_DCPstvTemp_LoFlt_MFOP: implementation-data-type=uint16
        NeBPCR_Cnt_PWMCntctrStMFOP: implementation-data-type=uint16
        NeADIR_Cnt_WEDMechFailure_MFOP: implementation-data-type=uint16
        NeAATR_Cnt_SCP_InletTemp_PerfFlt_MFOP: implementation-data-type=uint16
        NeAATR_Cnt_SCP_InletTemp_LoFlt_MFOP: implementation-data-type=uint16
        NeAATR_Cnt_SCP_InletTemp_HiFlt_MFOP: implementation-data-type=uint16
        NeAATR_Cnt_SCP_InletTemp_Flt_MFOP: implementation-data-type=uint16
        NeAATR_Cnt_SCP_DCPstvTemp_PerfFlt_MFOP: implementation-data-type=uint16
        NeAATR_Cnt_SCP_DCPstvTemp_Flt_MFOP: implementation-data-type=uint16
        NeCDMR_Cnt_DTCShortName6_MFOP: implementation-data-type=uint16
        NeAATR_Cnt_SCP_DCNegtvTemp_PerfFlt_MFOP: implementation-data-type=uint16
        NeAATR_Cnt_SCP_DCNegtvTemp_LoFlt_MFOP: implementation-data-type=uint16
        NeAATR_Cnt_SCP_DCNegtvTemp_HiFlt_MFOP: implementation-data-type=uint16
        NeAATR_Cnt_SCP_DCNegtvTemp_Flt_MFOP: implementation-data-type=uint16
        NeAATR_Cnt_ECM_IntakeTemp_PerfFlt_MFOP: implementation-data-type=uint16
        NeAATR_Cnt_DCPstvTemp_HiFlt_MFOP: implementation-data-type=uint16
        NeAATR_Cnt_AmbAirVolt_LoFlt_MFOP: implementation-data-type=uint16
        NeAATR_Cnt_AmbAirVolt_HiFlt_MFOP: implementation-data-type=uint16
        NeAATR_Cnt_AmbAirTemp_PerfFlt_MFOP: implementation-data-type=uint16
        NeCDMR_Cnt_ChrgPortUnlock_MFOP: implementation-data-type=uint16
        NeCDMR_Cnt_ChrgPortRlyActCkt_MFOP: implementation-data-type=uint16
        NeCDMR_Cnt_ChrgPortLock_MFOP: implementation-data-type=uint16
        NeCDMR_Cnt_ChgPrtLckFailLMFOP: implementation-data-type=uint16
        NeCDMR_Cnt_ChgPrtLckFailHMFOP: implementation-data-type=uint16
        NeCDMR_Cnt_CPIMInternal_MFOP: implementation-data-type=uint16
        NeCDMR_Cnt_BCIMInternal_MFOP: implementation-data-type=uint16
        NeCCTR_Cnt_SpdCntrlSw1_MFOP: implementation-data-type=uint16
        NeBTQD_Cnt_ESPSignalDiag_MFOP: implementation-data-type=uint16
        NeBRDR_Cnt_LTAP_MFOP: implementation-data-type=uint16
        NeBRDR_Cnt_HeatExPerf_MFOP: implementation-data-type=uint16
        NeBRDR_Cnt_HV_BTOS_MFOP: implementation-data-type=uint16
        NeBRDR_Cnt_HV_BTOS2_MFOP: implementation-data-type=uint16
        NeBRDR_Cnt_HV_BTIS_MFOP: implementation-data-type=uint16
        NeBRDR_Cnt_HV_BTIS2_MFOP: implementation-data-type=uint16
        NeBRDR_Cnt_HV_BHOS_MFOP: implementation-data-type=uint16
        NeBRDR_Cnt_HVBatCltLvlSnsCkt_MFOP: implementation-data-type=uint16
        NeBRDR_Cnt_HVBatCltLvLo_OC_MFOP: implementation-data-type=uint16
        NeBRDR_Cnt_ChillPerf_MFOP: implementation-data-type=uint16
        NeHVTR_Cnt_AntiTampCounter: implementation-data-type=uint16
        NeHSWD_Cnt_CBC_Range_MFOP: implementation-data-type=uint16
        NeITIR_Cnt_TimeSinceEngineStrt: implementation-data-type=uint16
        NeIMPR_Cnt_HVShtDwn_MFOP: implementation-data-type=uint16
        NeCCCR_b_FirstIncrFlag_MinHot: implementation-data-type=boolean
        NeCITR_b_PortLockBCM_Cmd: implementation-data-type=boolean
        NeCITR_b_Lock_Status: implementation-data-type=boolean
        NeCCCR_e_PwrLvlSet: implementation-data-type=TeOBCR_e_PwrLimReq
        NeDMIR_e_PddlMdStatus: implementation-data-type=TeDMIR_e_PaddleModeRequest
        NeDMIR_e_CreepSts: implementation-data-type=TeDMIR_e_CreepSts
        NeCSVR_e_MIL_LightRequest: implementation-data-type=TeDFIR_MIL_Request
        NeSSDC_b_HVBatPerWU12VChrg: implementation-data-type=boolean
        NeSSDC_b_HVBatPerWUCabinPre: implementation-data-type=boolean
        NeSSDC_b_HVBatPerWUSchChrg: implementation-data-type=boolean
        NeSSDC_b_HVBatPerWUThermal: implementation-data-type=boolean
        NeCSVR_b_PriorMIL_StatusOn: implementation-data-type=boolean
        NeCPLR_e_RemoteLockLastSts: implementation-data-type=TeCITR_e_RmtChargePortCmd
        NeCPLR_e_DoorLastSts: implementation-data-type=TeOBCR_e_DoorLockSts
        NeCPLR_e_ChargeportLockLastSts: implementation-data-type=TeOBCR_e_ChargeportLock_Sts
        NeCPLR_b_ManualRelease: implementation-data-type=boolean
        NeCCCR_b_FirstIncrFlag_MaxHot: implementation-data-type=boolean
        NeCCCR_b_FirstIncrFlag_MinCold: implementation-data-type=boolean
        NeCCCR_b_FirstIncrFlag_Cold: implementation-data-type=boolean
        NeCCCR_b_FirstIncrFlag_MaxCold: implementation-data-type=boolean
        NeAECR_e_eCoastLvlLatched: implementation-data-type=TeDMIR_e_eCoastSel
        NeAECR_e_eCoastDefaultCustom: implementation-data-type=TeDMIR_e_eCoastSel
        NeAECR_e_eCoastDefaultAuto: implementation-data-type=TeDMIR_e_eCoastSel
        NeAECR_e_RegenSts: implementation-data-type=TeDMIR_e_RegenSts
        NeAECR_e_RaceModeSts: implementation-data-type=TeTIMR_e_RaceModeSts
        NeAECR_e_PddlMdStatus: implementation-data-type=TeDMIR_e_PaddleModeRequest
        NeCCCR_b_FirstIncrFlag_Hot: implementation-data-type=boolean
        NeAATR_b_AmbAirTempPred_PrevFA: implementation-data-type=boolean
        NeOBCR_b_GoodConnEst: implementation-data-type=boolean
        NeOBCR_b_Lvl1Latch: implementation-data-type=boolean
        NeOBCR_b_Lvl2Latch: implementation-data-type=boolean
        NeOBCR_b_SmartEvse_Detected: implementation-data-type=boolean
        NeOFCR_b_PluginLatchOverride: implementation-data-type=boolean
        NeOFCR_b_RadioRqLstVldStt: implementation-data-type=boolean
        NeBPCR_b_HV_BatPackSOC_FA_Ovrd: implementation-data-type=boolean
        NeBPCR_b_HV_BatRdy: implementation-data-type=boolean
        NeDMIR_e_RegenSts: implementation-data-type=TeDMIR_e_RegenSts
        NeCCCR_b_FirstDecrFlag_MinHot: implementation-data-type=boolean
        NeCCCR_b_FirstDecrFlag_MinCold: implementation-data-type=boolean
        NeCCCR_b_FirstDecrFlag_MaxHot: implementation-data-type=boolean
        NeTIMR_b_RacePrepType: implementation-data-type=boolean
        NeTIMR_e_CustomDrvMdSts: implementation-data-type=TeTMDR_e_TrrnMd
        NeTIMR_e_RacePrepMode: implementation-data-type=TeTIMR_e_RacePrep
        NeCCCR_b_FirstDecrFlag_MaxCold: implementation-data-type=boolean
        NeCCCR_b_FirstDecrFlag_Hot: implementation-data-type=boolean
        NeCCCR_b_FirstDecrFlag_Cold: implementation-data-type=boolean
        NeTPCR_b_12VloadShed: implementation-data-type=boolean
        NeTPCR_b_HoldCabPrecFailLtch: implementation-data-type=boolean
        NeTPCR_b_RS_CabPrecDeny_Prev: implementation-data-type=boolean
        NeTRGR_y_IP_PRNDLTestFailStatus: implementation-data-type=uint8
        NePPCR_e_PrvCmdVal: implementation-data-type=TePPCR_e_PCUCtrl_PP_REQ
        NeDMIR_e_RaceModeSts: implementation-data-type=TeTIMR_e_RaceModeSts
        NeDMIR_e_eCoastDefaultAuto: implementation-data-type=TeDMIR_e_eCoastSel
        NeSCPR_y_Sch2CoCH_Day: implementation-data-type=uint8
        NeRTMR_y_RngTestResult_PID: implementation-data-type=uint8
        NeRTMR_e_BattChrgStatus_PID: implementation-data-type=TeRTMR_e_BattChrgStatus
        NeRTMR_y_BattChrgCndtnCheck_PID: implementation-data-type=uint8
        NeRTMR_y_RngTestStatus_PID: implementation-data-type=uint8
        NeRTMR_y_RngTstCndtnCheck1_PID: implementation-data-type=uint8
        NeRTMR_y_RngTstCndtnCheck2_PID: implementation-data-type=uint8
        NeSCPR_y_Sch1CoCH_Day: implementation-data-type=uint8
        NeSCPR_e_Sch1CH_SchType: implementation-data-type=TeCITR_e_ChrgScheduleType
        NeSCPR_e_Sch2CH_SchType: implementation-data-type=TeCITR_e_ChrgScheduleType
        NeENGR_b_IAT_SnsrFA: implementation-data-type=boolean
        NeENGR_b_ECT_SnsrFA: implementation-data-type=boolean
        NeDMIR_e_eCoastLvlLatched: implementation-data-type=TeDMIR_e_eCoastSel
        NeDMIR_e_eCoastDefaultCustom: implementation-data-type=TeDMIR_e_eCoastSel
        NeSCPR_b_xMinUFCancel: implementation-data-type=boolean
        NeSCPR_b_xMinUF: implementation-data-type=boolean
        NeSCPR_b_StopChrg: implementation-data-type=boolean
        NeSCPR_b_Sch2CoCH_Enbl: implementation-data-type=boolean
        NeHVTR_b_AntiTampFailed: implementation-data-type=boolean
        NeSCPR_b_AllowCancel: implementation-data-type=boolean
        NeSCPR_b_CancSchedIsUF: implementation-data-type=boolean
        NeSCPR_b_CancWindow: implementation-data-type=boolean
        NeSCPR_b_ChrgComplete: implementation-data-type=boolean
        NeSCPR_b_CoCH_Sch1_DNR: implementation-data-type=boolean
        NeSCPR_b_CoCH_Sch2_DNR: implementation-data-type=boolean
        NeSCPR_b_CoCh_VehLocation: implementation-data-type=boolean
        NeSCPR_b_PluginLatchOverride: implementation-data-type=boolean
        NeSCPR_b_RadioRqLstVldStt: implementation-data-type=boolean
        NeSCPR_b_Sch1CoCH_Enbl: implementation-data-type=boolean
        Reserved{1..26}: implementation-data-type=uint8
    ExpendableNonVolatile_Rom_Core4
      359 x element, all with category=TYPE_REFERENCE:
        NeESMC_I_Ahrperhr_DS: implementation-data-type=float32
        NeSCPR_g_DoNotRepeatValSch1: implementation-data-type=uint32
        NeSCPR_Pct_Sch1CoCH_ImmSOCtrgt: implementation-data-type=float32
        NeSCPR_Pct_Sch2CoCH_ExtSOCtrgt: implementation-data-type=float32
        NeSCPR_Pct_Sch2CoCH_ImmSOCtrgt: implementation-data-type=float32
        NeDCCR_E_TECharge: implementation-data-type=float32
        NeDCCR_E_TEDischarge: implementation-data-type=float32
        NeSCPR_k_LastSecond: implementation-data-type=float32
        NeSCPR_k_LastRTC: implementation-data-type=float32
        NeSCPR_k_CancOverlapTrack: implementation-data-type=float32
        NeSCPR_k_CancGlStartTrack: implementation-data-type=float32
        NeSCPR_k_CancGlEndTrack: implementation-data-type=float32
        NeSCPR_k_CabinTempSetPoint: implementation-data-type=float32
        NeSCPR_g_Sch2CoCH_DNRvalue: implementation-data-type=uint32
        NeSCPR_g_Sch2CP_DNRvalue: implementation-data-type=uint32
        NeSCPR_g_Sch1CoCH_DNRvalue: implementation-data-type=uint32
        NeSCPR_g_Sch1CP_DNRvalue: implementation-data-type=uint32
        NeSCPR_g_DoNotRepeatValSch2: implementation-data-type=uint32
        NeSCPR_Pct_SOCArb: implementation-data-type=float32
        NeSCPR_Pct_Sch1CoCH_ExtSOCtrgt: implementation-data-type=float32
        NeITIR_t_TimeToResetRecentVar: implementation-data-type=float32
        NeITIR_E_MtrATotalTractionEnergy_Lifetime: implementation-data-type=float32
        NeITIR_E_MtrATotalTractionEnergy_Recent: implementation-data-type=float32
        NeITIR_E_MtrBTotalTractionEnergy_Lifetime: implementation-data-type=float32
        NeITIR_E_MtrBTotalTractionEnergy_Recent: implementation-data-type=float32
        NeITIR_E_NonGrdEnrgy_Lifetime: implementation-data-type=float32
        NeITIR_E_NonGrdEnrgy_Recent: implementation-data-type=float32
        NeITIR_l_DistTravelChrgDepEngOff_Lifetime: implementation-data-type=float32
        NeITIR_l_DistTravelChrgDepEngOff_Recent: implementation-data-type=float32
        NeITIR_l_DistTravelChrgDepEngOn_Lifetime: implementation-data-type=float32
        NeITIR_l_DistTravelChrgDepEngOn_Recent: implementation-data-type=float32
        NeITIR_l_DistTravelChrgIncrease_Recent: implementation-data-type=float32
        NeITIR_l_DistTrvlChrgIncrease_Lifetime: implementation-data-type=float32
        NeITIR_l_TotalDistTravelled_Lifetime: implementation-data-type=float32
        NeITIR_l_TotalDistTravelled_Recent: implementation-data-type=float32
        NeITIR_E_GrdEnrgyIntoBatt_Lifetime: implementation-data-type=float32
        NeITIR_E_GrdEnrgyIntoBatt_Recent: implementation-data-type=float32
        NeITIR_E_GrdEnrgyChrgDepEngOn_Recent: implementation-data-type=float32
        NeCSVR_l_DistSinceCodeClr: implementation-data-type=float32
        NeITIR_Cnt_FuelConsChrgDep_Lifetime: implementation-data-type=uint32
        NeRTMR_t_BattChrgTimer_PID: implementation-data-type=float32
        NeRTMR_P_BattChrgPwrOffset_PID: implementation-data-type=float32
        NeRTMR_It_BattChrgTarget_PID: implementation-data-type=float32
        NeRTMR_It_BattChrgInitDiff_PID: implementation-data-type=float32
        NeRTMR_It_BattChargedAmnt_PID: implementation-data-type=float32
        NeITIR_Cnt_FuelConsChrgDep_Recent: implementation-data-type=uint32
        NeITIR_E_GrdEnrgyChrgDepEngOn_Lifetime: implementation-data-type=float32
        NeITIR_Cnt_FuelConsChrgIncrease_Lifetime: implementation-data-type=uint32
        NeITIR_Cnt_FuelConsChrgIncrease_Recent: implementation-data-type=uint32
        NeITIR_Cnt_FuelEngIgnCycl_Lifetime: implementation-data-type=uint32
        NeITIR_Cnt_FuelEngIgnCycl_Recent: implementation-data-type=uint32
        NeITIR_Cnt_IgnCycl_Lifetime: implementation-data-type=uint32
        NeITIR_Cnt_IgnCycl_Recent: implementation-data-type=uint32
        NeITIR_Cnt_Total_City_PSA_Time_Lifetime: implementation-data-type=uint32
        NeITIR_Cnt_Total_City_PSA_Time_Recent: implementation-data-type=uint32
        NeITIR_Cnt_Total_Idle_PSA_Time_Lifetime: implementation-data-type=uint32
        NeITIR_Cnt_Total_Idle_PSA_Time_Recent: implementation-data-type=uint32
        NeITIR_Cnt_Total_PSA_Time_Lifetime: implementation-data-type=uint32
        NeITIR_Cnt_Total_PSA_Time_Recent: implementation-data-type=uint32
        NeITIR_E_GrdEnrgyChrgDepEngOff_Lifetime: implementation-data-type=float32
        NeITIR_E_GrdEnrgyChrgDepEngOff_Recent: implementation-data-type=float32
        NeCSVR_l_DistTravelMIL_On: implementation-data-type=float32
        NeBPCR_T_BatModTmp: implementation-data-type=float32
        NeTPCR_Pct_WupSOC: implementation-data-type=float32
        NeCCCR_P_PLSMaxPower: implementation-data-type=float32
        NeCCCR_T_AmbTemp_CntrlrOff: implementation-data-type=float32
        NeCCCR_T_EngTemp_CntrlrOff: implementation-data-type=float32
        NeCCCR_t_CntrlrOnTime: implementation-data-type=uint32
        NeASLR_v_InitVehSpdLim: implementation-data-type=float32
        NeAATR_T_AmbAirTempPred_Prev: implementation-data-type=float32
        NeCCCR_t_CntrlrOffTime: implementation-data-type=uint32
        NePWDR_Cnt_HVFuseEMFOP: implementation-data-type=uint16
        NeVLDR_Cnt_CPV2_PerfDiag_MFOP: implementation-data-type=uint16
        NeVLDR_Cnt_BHV_PerfDiag_MFOP: implementation-data-type=uint16
        NeVLDR_Cnt_CPV_PerfDiag_MFOP: implementation-data-type=uint16
        NePWDR_Cnt_HVOverVoltFailureMSOF: implementation-data-type=uint16
        NeVLDR_Cnt_CabVlvOpeng_Err_MFOP: implementation-data-type=uint16
        NePWDR_Cnt_HVOverVoltWarnMFOP: implementation-data-type=uint16
        NeVLDR_Cnt_EEXV_PerfDiag_MFOP: implementation-data-type=uint16
        NeVLDR_Cnt_EEXV_PressElctrFlt_MFOP: implementation-data-type=uint16
        NePWDR_Cnt_HVFuseDMFOP: implementation-data-type=uint16
        NePWDR_Cnt_HVFuseCMFOP: implementation-data-type=uint16
        NePWDR_Cnt_HVILCkt_MFOP: implementation-data-type=uint16
        NePWDR_Cnt_HVFuseBMFOP: implementation-data-type=uint16
        NePWDR_Cnt_HVFuseAMFOP: implementation-data-type=uint16
        NePWDR_Cnt_HVDAPMFOP: implementation-data-type=uint16
        NePWDR_Cnt_HVOverVoltFailureMFOP: implementation-data-type=uint16
        NeVLDR_Cnt_EEXV_TempElctrFlt_MFOP: implementation-data-type=uint16
        NePWDR_Cnt_BattOverTempFailureMFOP: implementation-data-type=uint16
        NeVLDR_Cnt_EEXV_PressSens_MFOP: implementation-data-type=uint16
        NeVLDR_Cnt_EXV_PerfDiag_MFOP: implementation-data-type=uint16
        NePMDR_Cnt_BF1SysVoltHi_MFOP: implementation-data-type=uint16
        NePMDR_Cnt_BFHBSpareSysVoltHi_MFOP: implementation-data-type=uint16
        NePMDR_Cnt_BF3SysVoltLow_MFOP: implementation-data-type=uint16
        NeVLDR_Cnt_OEXV_PressElctrFlt_MFOP: implementation-data-type=uint16
        NeVLDR_Cnt_OEXV_PressSens_MFOP: implementation-data-type=uint16
        NePMDR_Cnt_BF3SysVoltHi_MFOP: implementation-data-type=uint16
        NePMDR_Cnt_BF2SysVoltLow_MFOP: implementation-data-type=uint16
        NePMDR_Cnt_BF2SysVoltHi_MFOP: implementation-data-type=uint16
        NePMDR_Cnt_BF1SysVoltLow_MFOP: implementation-data-type=uint16
        NePMDD_Cnt_RunLoMaxFOP: implementation-data-type=uint16
        NeVLDR_Cnt_EXV_PressElctrFlt_MFOP: implementation-data-type=uint16
        NeVLDR_Cnt_OEXV_TempElctrFlt_MFOP: implementation-data-type=uint16
        NeAADR_Cnt_AAD_PerfDiag_MFOP: implementation-data-type=uint16
        NePMDD_Cnt_RunCrankOpenMaxFOP: implementation-data-type=uint16
        NePMDD_Cnt_RunCrankHiMaxFOP: implementation-data-type=uint16
        NePMDD_Cnt_AccLoMaxFOP: implementation-data-type=uint16
        NePMDD_Cnt_AccHiMaxFOP: implementation-data-type=uint16
        NePMDR_Cnt_BFHBSysVoltHi_MFOP: implementation-data-type=uint16
        NePMDR_Cnt_HBSpareSysVoltLow_MFOP: implementation-data-type=uint16
        NePMDR_Cnt_HBSysVoltLow_MFOP: implementation-data-type=uint16
        NePWDR_Cnt_HVUnderVoltFailureMFOP: implementation-data-type=uint16
        NeVLDR_Cnt_EXV_PressSens_MFOP: implementation-data-type=uint16
        NeVLDR_Cnt_EXV_TempElctrFlt_MFOP: implementation-data-type=uint16
        NeVLDR_Cnt_EXV_TempSens_MFOP: implementation-data-type=uint16
        NeVLDR_Cnt_HCTV_Leak_MFOP: implementation-data-type=uint16
        NeVLDR_Cnt_HTL_PerfDiag_MFOP: implementation-data-type=uint16
        NeVLDR_Cnt_HTSoV_StkCls_MFOP: implementation-data-type=uint16
        NePWDR_Cnt_BPCM_MFOP: implementation-data-type=uint16
        NeVLDR_Cnt_HTSoV_StkOpn_MFOP: implementation-data-type=uint16
        NeVLDR_Cnt_LTR_PerfDiag_MFOP: implementation-data-type=uint16
        NeVLDR_Cnt_LTSOV_StkOff_MFOP: implementation-data-type=uint16
        NeVLDR_Cnt_LTSOV_StkOn_MFOP: implementation-data-type=uint16
        NeVLDR_Cnt_OEXV_PerfDiag_MFOP: implementation-data-type=uint16
        NePWDR_Cnt_HVOverVoltWarnMSOF: implementation-data-type=uint16
        NeTHDR_Cnt_OEXV_In_MFOP: implementation-data-type=uint16
        NePWDR_Cnt_HVUnderVoltFailureMSOF: implementation-data-type=uint16
        NeTHDR_Cnt_InTmpSns_MFOP: implementation-data-type=uint16
        NeTHDR_Cnt_HTAP_MFOP: implementation-data-type=uint16
        NeTHDR_Cnt_HCCTOS_MFOP: implementation-data-type=uint16
        NeSCPR_e_NxtSchCH_StrtDay: implementation-data-type=sint16
        NeSCPR_e_NxtSchCH_EndMin: implementation-data-type=sint16
        NeSCPR_e_NxtSchCH_StrtMin: implementation-data-type=sint16
        NeSCPR_e_NxtSchCH_EndHr: implementation-data-type=sint16
        NeSCPR_e_NxtSchCH_EndDay: implementation-data-type=sint16
        NeSCPR_e_LastNowIndex: implementation-data-type=sint16
        NeSCPR_e_EndIndexCanc: implementation-data-type=sint16
        NeSCPR_e_CancelStartIndx: implementation-data-type=sint16
        NeSCPR_e_CancStartIdxHold: implementation-data-type=sint16
        NeSCPR_e_NxtSchCH_StrtHr: implementation-data-type=sint16
        NeSCPR_e_Sch2CoCH_StopMin: implementation-data-type=sint16
        NeTHDR_Cnt_OEXV_Out_MFOP: implementation-data-type=uint16
        NeTHDR_Cnt_OOCTOS_MFOP: implementation-data-type=uint16
        NeTHDR_Cnt_PPCTIS_MFOP: implementation-data-type=uint16
        NeTHDR_Cnt_PPCTIS_OT_MSOP: implementation-data-type=uint16
        NeTHDR_Cnt_LTPP2_MFOP: implementation-data-type=uint16
        NeTHDR_Cnt_LRCTOS_MFOP: implementation-data-type=uint16
        NeTIDR_Cnt_EngTrqHiFlt_MFOP: implementation-data-type=uint16
        NeTIDR_Cnt_EngTrqHiFlt_MSOF: implementation-data-type=uint16
        NeSCPR_e_Sch2CoCH_StopHr: implementation-data-type=sint16
        NeTISD_Cnt_SpdRatlFlt_MFOP: implementation-data-type=uint16
        NeSCPR_e_Sch1CoCH_StopMin: implementation-data-type=sint16
        NeSCPR_e_Sch1CoCH_StopHr: implementation-data-type=sint16
        NeTIDR_Cnt_EngTrqLoFlt_MFOP: implementation-data-type=uint16
        NeTIDR_Cnt_EngTrqLoFlt_MSOF: implementation-data-type=uint16
        NeTIMR_e_TrrnMdSt: implementation-data-type=uint16
        NeSCPR_e_NxtSchCP_StrtMin: implementation-data-type=sint16
        NeSCPR_e_NxtSchCP_StrtHr: implementation-data-type=sint16
        NeSCPR_e_NxtSchCP_Day: implementation-data-type=sint16
        NeTHDR_Cnt_HCCTIS_MFOP: implementation-data-type=uint16
        NeTHDR_Cnt_LTPP_MFOP: implementation-data-type=uint16
        NeTHDR_Cnt_AGS2_Perf_MFOP: implementation-data-type=uint16
        NePWDR_Cnt_StuckHiFOP: implementation-data-type=uint16
        NePWDR_Cnt_SOCLowWarnMFOP: implementation-data-type=uint16
        NePWDR_Cnt_SOCLowFailureMFOP: implementation-data-type=uint16
        NePWDR_Cnt_SOCHighWarnMFOP: implementation-data-type=uint16
        NePWDR_Cnt_SOCHighFailureMFOP: implementation-data-type=uint16
        NePWDR_Cnt_MsmtchLowFOP: implementation-data-type=uint16
        NePWDR_Cnt_HVUnderVoltWarnMSOF: implementation-data-type=uint16
        NeTHDR_Cnt_AGS_Perf_MFOP: implementation-data-type=uint16
        NeTHDR_Cnt_EEXV_Out_MFOP: implementation-data-type=uint16
        NeTHDR_Cnt_ECH_outTmpSns_MFOP: implementation-data-type=uint16
        NeTHDR_Cnt_ECHTIS_MFOP: implementation-data-type=uint16
        NePWDR_Cnt_HVUnderVoltWarnMFOP: implementation-data-type=uint16
        NePMDD_Cnt_RunHiMaxFOP: implementation-data-type=uint16
        NeCPDR_Cnt_LTAP_FunPer_MFOP: implementation-data-type=uint16
        NeCSVD_Cnt_RearAxleRatlFlt_MFOP: implementation-data-type=uint16
        NeCSVD_Cnt_FrontAxleRatlFlt_MFOP: implementation-data-type=uint16
        NeCPDR_Cnt_LTPP_FunPer_MFOP: implementation-data-type=uint16
        NeCPDR_Cnt_LTPP_FunDryRun_MFOP: implementation-data-type=uint16
        NeCPDR_Cnt_LTPP2_FunPer_MFOP: implementation-data-type=uint16
        NeCPDR_Cnt_LTPP2_FunDryRun_MFOP: implementation-data-type=uint16
        NeCPDR_Cnt_LTAP_FunDryRun_MFOP: implementation-data-type=uint16
        NeDMIR_e_DriveStyleSts: implementation-data-type=uint16
        NeCPDR_Cnt_HTAP_FunPer_MFOP: implementation-data-type=uint16
        NeCPDR_Cnt_EOPB_FunPer_MFOP: implementation-data-type=uint16
        NeCPDR_Cnt_EOPB_FunDryRun_MFOP: implementation-data-type=uint16
        NeCPDR_Cnt_EOPA_FunPer_MFOP: implementation-data-type=uint16
        NeCPDR_Cnt_EOPA_FunDryRun_MFOP: implementation-data-type=uint16
        NeCDMR_Cnt_PwrOutletPanelMod2Perf_MFOP: implementation-data-type=uint16
        NeCDMR_Cnt_PwrOutletPanelMod2LmpCntrl_MFOP: implementation-data-type=uint16
        NeCDMR_Cnt_PwrOutletPanelMod2InACPwrCktPerf_MFOP: implementation-data-type=uint16
        NeCDMR_Cnt_PwrOutletPanelMod1Perf_MFOP: implementation-data-type=uint16
        NeDMIR_e_DrvMdArb: implementation-data-type=uint16
        NeHCDR_Cnt_HVC_Heater_MFOP: implementation-data-type=uint16
        NeHSWD_Cnt_SecBnt_Correlation_MFOP: implementation-data-type=uint16
        NeHSWD_Cnt_SecBnt_CircuitPerf_MFOP: implementation-data-type=uint16
        NeHSWD_Cnt_SecBnt_CircuitLow_MFOP: implementation-data-type=uint16
        NeHSWD_Cnt_SecBnt_CircuitHigh_MFOP: implementation-data-type=uint16
        NeHSWD_Cnt_CBC_FaultLow_MFOP: implementation-data-type=uint16
        NeHSWD_Cnt_CBC_FaultHigh_MFOP: implementation-data-type=uint16
        NeHCDR_Cnt_HVC_Heater4_MFOP: implementation-data-type=uint16
        NeHCDR_Cnt_HVC_Heater3_MFOP: implementation-data-type=uint16
        NeHCDR_Cnt_HVC_Heater2_MFOP: implementation-data-type=uint16
        NeHCDR_Cnt_EACPref_MFOP: implementation-data-type=uint16
        NeGENR_Cnt_InPlantAPMOff: implementation-data-type=uint16
        NeCDMR_Cnt_PwrOutletPanelMod1LmpCntrl_MFOP: implementation-data-type=uint16
        NeCDMR_Cnt_PwrOutletPanelMod1InACPwrCktPerf_MFOP: implementation-data-type=uint16
        NeCDMR_Cnt_InletSensor_MFOP: implementation-data-type=uint16
        NeAATR_Cnt_SCP_DCPstvTemp_LoFlt_MFOP: implementation-data-type=uint16
        NeBPCR_Cnt_PWMCntctrStMFOP: implementation-data-type=uint16
        NeADIR_Cnt_WEDMechFailure_MFOP: implementation-data-type=uint16
        NeAATR_Cnt_SCP_InletTemp_PerfFlt_MFOP: implementation-data-type=uint16
        NeAATR_Cnt_SCP_InletTemp_LoFlt_MFOP: implementation-data-type=uint16
        NeAATR_Cnt_SCP_InletTemp_HiFlt_MFOP: implementation-data-type=uint16
        NeAATR_Cnt_SCP_InletTemp_Flt_MFOP: implementation-data-type=uint16
        NeAATR_Cnt_SCP_DCPstvTemp_PerfFlt_MFOP: implementation-data-type=uint16
        NeAATR_Cnt_SCP_DCPstvTemp_Flt_MFOP: implementation-data-type=uint16
        NeCDMR_Cnt_DTCShortName6_MFOP: implementation-data-type=uint16
        NeAATR_Cnt_SCP_DCNegtvTemp_PerfFlt_MFOP: implementation-data-type=uint16
        NeAATR_Cnt_SCP_DCNegtvTemp_LoFlt_MFOP: implementation-data-type=uint16
        NeAATR_Cnt_SCP_DCNegtvTemp_HiFlt_MFOP: implementation-data-type=uint16
        NeAATR_Cnt_SCP_DCNegtvTemp_Flt_MFOP: implementation-data-type=uint16
        NeAATR_Cnt_ECM_IntakeTemp_PerfFlt_MFOP: implementation-data-type=uint16
        NeAATR_Cnt_DCPstvTemp_HiFlt_MFOP: implementation-data-type=uint16
        NeAATR_Cnt_AmbAirVolt_LoFlt_MFOP: implementation-data-type=uint16
        NeAATR_Cnt_AmbAirVolt_HiFlt_MFOP: implementation-data-type=uint16
        NeAATR_Cnt_AmbAirTemp_PerfFlt_MFOP: implementation-data-type=uint16
        NeCDMR_Cnt_ChrgPortUnlock_MFOP: implementation-data-type=uint16
        NeCDMR_Cnt_ChrgPortRlyActCkt_MFOP: implementation-data-type=uint16
        NeCDMR_Cnt_ChrgPortLock_MFOP: implementation-data-type=uint16
        NeCDMR_Cnt_ChgPrtLckFailLMFOP: implementation-data-type=uint16
        NeCDMR_Cnt_ChgPrtLckFailHMFOP: implementation-data-type=uint16
        NeCDMR_Cnt_CPIMInternal_MFOP: implementation-data-type=uint16
        NeCDMR_Cnt_BCIMInternal_MFOP: implementation-data-type=uint16
        NeCCTR_Cnt_SpdCntrlSw1_MFOP: implementation-data-type=uint16
        NeBTQD_Cnt_ESPSignalDiag_MFOP: implementation-data-type=uint16
        NeBRDR_Cnt_LTAP_MFOP: implementation-data-type=uint16
        NeBRDR_Cnt_HeatExPerf_MFOP: implementation-data-type=uint16
        NeBRDR_Cnt_HV_BTOS_MFOP: implementation-data-type=uint16
        NeBRDR_Cnt_HV_BTOS2_MFOP: implementation-data-type=uint16
        NeBRDR_Cnt_HV_BTIS_MFOP: implementation-data-type=uint16
        NeBRDR_Cnt_HV_BTIS2_MFOP: implementation-data-type=uint16
        NeBRDR_Cnt_HV_BHOS_MFOP: implementation-data-type=uint16
        NeBRDR_Cnt_HVBatCltLvlSnsCkt_MFOP: implementation-data-type=uint16
        NeBRDR_Cnt_HVBatCltLvLo_OC_MFOP: implementation-data-type=uint16
        NeBRDR_Cnt_ChillPerf_MFOP: implementation-data-type=uint16
        NeHVTR_Cnt_AntiTampCounter: implementation-data-type=uint16
        NeHSWD_Cnt_CBC_Range_MFOP: implementation-data-type=uint16
        NeITIR_Cnt_TimeSinceEngineStrt: implementation-data-type=uint16
        NeIMPR_Cnt_HVShtDwn_MFOP: implementation-data-type=uint16
        NeCCCR_b_FirstIncrFlag_MinHot: implementation-data-type=boolean
        NeCITR_b_PortLockBCM_Cmd: implementation-data-type=boolean
        NeCITR_b_Lock_Status: implementation-data-type=boolean
        NeCCCR_e_PwrLvlSet: implementation-data-type=TeOBCR_e_PwrLimReq
        NeDMIR_e_PddlMdStatus: implementation-data-type=TeDMIR_e_PaddleModeRequest
        NeDMIR_e_CreepSts: implementation-data-type=TeDMIR_e_CreepSts
        NeCSVR_e_MIL_LightRequest: implementation-data-type=TeDFIR_MIL_Request
        NeSSDC_b_HVBatPerWU12VChrg: implementation-data-type=boolean
        NeSSDC_b_HVBatPerWUCabinPre: implementation-data-type=boolean
        NeSSDC_b_HVBatPerWUSchChrg: implementation-data-type=boolean
        NeSSDC_b_HVBatPerWUThermal: implementation-data-type=boolean
        NeCSVR_b_PriorMIL_StatusOn: implementation-data-type=boolean
        NeCPLR_e_RemoteLockLastSts: implementation-data-type=TeCITR_e_RmtChargePortCmd
        NeCPLR_e_DoorLastSts: implementation-data-type=TeOBCR_e_DoorLockSts
        NeCPLR_e_ChargeportLockLastSts: implementation-data-type=TeOBCR_e_ChargeportLock_Sts
        NeCPLR_b_ManualRelease: implementation-data-type=boolean
        NeCCCR_b_FirstIncrFlag_MaxHot: implementation-data-type=boolean
        NeCCCR_b_FirstIncrFlag_MinCold: implementation-data-type=boolean
        NeCCCR_b_FirstIncrFlag_Cold: implementation-data-type=boolean
        NeCCCR_b_FirstIncrFlag_MaxCold: implementation-data-type=boolean
        NeAECR_e_eCoastLvlLatched: implementation-data-type=TeDMIR_e_eCoastSel
        NeAECR_e_eCoastDefaultCustom: implementation-data-type=TeDMIR_e_eCoastSel
        NeAECR_e_eCoastDefaultAuto: implementation-data-type=TeDMIR_e_eCoastSel
        NeAECR_e_RegenSts: implementation-data-type=TeDMIR_e_RegenSts
        NeAECR_e_RaceModeSts: implementation-data-type=TeTIMR_e_RaceModeSts
        NeAECR_e_PddlMdStatus: implementation-data-type=TeDMIR_e_PaddleModeRequest
        NeCCCR_b_FirstIncrFlag_Hot: implementation-data-type=boolean
        NeAATR_b_AmbAirTempPred_PrevFA: implementation-data-type=boolean
        NeOBCR_b_GoodConnEst: implementation-data-type=boolean
        NeOBCR_b_Lvl1Latch: implementation-data-type=boolean
        NeOBCR_b_Lvl2Latch: implementation-data-type=boolean
        NeOBCR_b_SmartEvse_Detected: implementation-data-type=boolean
        NeOFCR_b_PluginLatchOverride: implementation-data-type=boolean
        NeOFCR_b_RadioRqLstVldStt: implementation-data-type=boolean
        NeBPCR_b_HV_BatPackSOC_FA_Ovrd: implementation-data-type=boolean
        NeBPCR_b_HV_BatRdy: implementation-data-type=boolean
        NeDMIR_e_RegenSts: implementation-data-type=TeDMIR_e_RegenSts
        NeCCCR_b_FirstDecrFlag_MinHot: implementation-data-type=boolean
        NeCCCR_b_FirstDecrFlag_MinCold: implementation-data-type=boolean
        NeCCCR_b_FirstDecrFlag_MaxHot: implementation-data-type=boolean
        NeTIMR_b_RacePrepType: implementation-data-type=boolean
        NeTIMR_e_CustomDrvMdSts: implementation-data-type=TeTMDR_e_TrrnMd
        NeTIMR_e_RacePrepMode: implementation-data-type=TeTIMR_e_RacePrep
        NeCCCR_b_FirstDecrFlag_MaxCold: implementation-data-type=boolean
        NeCCCR_b_FirstDecrFlag_Hot: implementation-data-type=boolean
        NeCCCR_b_FirstDecrFlag_Cold: implementation-data-type=boolean
        NeTPCR_b_12VloadShed: implementation-data-type=boolean
        NeTPCR_b_HoldCabPrecFailLtch: implementation-data-type=boolean
        NeTPCR_b_RS_CabPrecDeny_Prev: implementation-data-type=boolean
        NeTRGR_y_IP_PRNDLTestFailStatus: implementation-data-type=uint8
        NePPCR_e_PrvCmdVal: implementation-data-type=TePPCR_e_PCUCtrl_PP_REQ
        NeDMIR_e_RaceModeSts: implementation-data-type=TeTIMR_e_RaceModeSts
        NeDMIR_e_eCoastDefaultAuto: implementation-data-type=TeDMIR_e_eCoastSel
        NeSCPR_y_Sch2CoCH_Day: implementation-data-type=uint8
        NeRTMR_y_RngTestResult_PID: implementation-data-type=uint8
        NeRTMR_e_BattChrgStatus_PID: implementation-data-type=TeRTMR_e_BattChrgStatus
        NeRTMR_y_BattChrgCndtnCheck_PID: implementation-data-type=uint8
        NeRTMR_y_RngTestStatus_PID: implementation-data-type=uint8
        NeRTMR_y_RngTstCndtnCheck1_PID: implementation-data-type=uint8
        NeRTMR_y_RngTstCndtnCheck2_PID: implementation-data-type=uint8
        NeSCPR_y_Sch1CoCH_Day: implementation-data-type=uint8
        NeSCPR_e_Sch1CH_SchType: implementation-data-type=TeCITR_e_ChrgScheduleType
        NeSCPR_e_Sch2CH_SchType: implementation-data-type=TeCITR_e_ChrgScheduleType
        NeENGR_b_IAT_SnsrFA: implementation-data-type=boolean
        NeENGR_b_ECT_SnsrFA: implementation-data-type=boolean
        NeDMIR_e_eCoastLvlLatched: implementation-data-type=TeDMIR_e_eCoastSel
        NeDMIR_e_eCoastDefaultCustom: implementation-data-type=TeDMIR_e_eCoastSel
        NeSCPR_b_xMinUFCancel: implementation-data-type=boolean
        NeSCPR_b_xMinUF: implementation-data-type=boolean
        NeSCPR_b_StopChrg: implementation-data-type=boolean
        NeSCPR_b_Sch2CoCH_Enbl: implementation-data-type=boolean
        NeHVTR_b_AntiTampFailed: implementation-data-type=boolean
        NeSCPR_b_AllowCancel: implementation-data-type=boolean
        NeSCPR_b_CancSchedIsUF: implementation-data-type=boolean
        NeSCPR_b_CancWindow: implementation-data-type=boolean
        NeSCPR_b_ChrgComplete: implementation-data-type=boolean
        NeSCPR_b_CoCH_Sch1_DNR: implementation-data-type=boolean
        NeSCPR_b_CoCH_Sch2_DNR: implementation-data-type=boolean
        NeSCPR_b_CoCh_VehLocation: implementation-data-type=boolean
        NeSCPR_b_PluginLatchOverride: implementation-data-type=boolean
        NeSCPR_b_RadioRqLstVldStt: implementation-data-type=boolean
        NeSCPR_b_Sch1CoCH_Enbl: implementation-data-type=boolean
        Reserved{1..26}: implementation-data-type=uint8
    CumulativeNonVolatile_Ram_Core4
      114 x element, all with category=TYPE_REFERENCE:
        EePLTR_t_RTCTime: implementation-data-type=uint32
        EeHCDR_t_RealTime_Comp_On: implementation-data-type=uint32
        EeHCDR_t_RealTime_Comp_Off: implementation-data-type=uint32
        EeERER_l_EEPROM_EstRange: implementation-data-type=float32
        EeDCCR_t_V2GPerfInhibTime: implementation-data-type=float32
        EeDCCR_t_V2GTime: implementation-data-type=float32
        EeERER_F_EEPROM_WhperKM: implementation-data-type=float32
        EeERER_k_Modify_Factor: implementation-data-type=float32
        EeERER_l_VehDist_Delta: implementation-data-type=float32
        EePWDR_t_DAP_FA_InitTime: implementation-data-type=uint32
        EePWDR_t_DAP_FA_ElapsedTime: implementation-data-type=uint32
        EePWDR_l_DAP_FA_DistTravld: implementation-data-type=float32
        EeOBCR_t_EstTimeofChrg_Lv1: implementation-data-type=float32
        EeOBCR_t_EstTimeofChrg_Lv2: implementation-data-type=float32
        EeIMOR_M_Rand{1..4}_prev: implementation-data-type=float32
        EePLTR_t_PowerdownTime: implementation-data-type=uint32
        EeTPCR_e_HoldClusterMsg: implementation-data-type=sint16
        EeTPCR_e_HoldClusterMsg_KHC: implementation-data-type=sint16
        EePLTR_e_ShippingMode: implementation-data-type=sint16
        EeDMIR_d_ChargeTypeCnf: implementation-data-type=uint16
        EeDMIR_d_TgtSOCRngCnf: implementation-data-type=uint16
        EeIMOR_e_BuildAssemblyModeStat: implementation-data-type=sint16
        EeHVTR_e_StrtCmd_SrvcProc1320: implementation-data-type=uint16
        EePLTR_e_RTCStatus: implementation-data-type=sint16
        EeERER_e_DriveMode: implementation-data-type=sint16
        EeERER_e_TurtleMode: implementation-data-type=sint16
        EeAECR_e_MaxRegenDsrdSt: implementation-data-type=uint16
        EeOBCR_e_ChargingSystemSts: implementation-data-type=sint16
        EeOBCR_e_ChargingLevel: implementation-data-type=sint16
        EeCHFR_b_ChrgSysFault: implementation-data-type=boolean
        EeIMOR_y_MMKey1org22_Mem: implementation-data-type=uint8
        EeOBCR_b_PluggedIn: implementation-data-type=boolean
        EePLTR_b_RTC_CurrentTimeFA: implementation-data-type=boolean
        EeIMOR_b_AuthCmd08_InFlag: implementation-data-type=boolean
        EeIMOR_b_AuthCmd07_InFlag: implementation-data-type=boolean
        EeIMOR_b_AuthCmd06_InFlag: implementation-data-type=boolean
        EeIMOR_b_AuthCmd05_InFlag: implementation-data-type=boolean
        EeIMOR_b_AuthCmd04_InFlag: implementation-data-type=boolean
        EeIMOR_b_AuthCmd03_InFlag: implementation-data-type=boolean
        EeIMOR_b_AuthCmd02_InFlag: implementation-data-type=boolean
        EeIMOR_b_AuthCmd09_InFlag: implementation-data-type=boolean
        EeIMOR_y_MMKey_3_Mem: implementation-data-type=uint8
        EeIMOR_b_VC_VehCfg6_Stat_rec: implementation-data-type=boolean
        EeIMOR_b_VC_VehCfg4_Stat_rec: implementation-data-type=boolean
        EeIMOR_b_VC_VehCfg3_Stat_rec: implementation-data-type=boolean
        EeIMOR_b_VC_VehCfg2_Stat_rec: implementation-data-type=boolean
        EeIMOR_b_ORC_Health_rec: implementation-data-type=boolean
        EeIMOR_b_MMKey_6Flag: implementation-data-type=boolean
        EeIMOR_b_MMKey_5Flag: implementation-data-type=boolean
        EeIMOR_b_MMKey_4Flag: implementation-data-type=boolean
        EeIMOR_b_MMKey_3Flag: implementation-data-type=boolean
        EeIMOR_b_MMKey1org22Flag: implementation-data-type=boolean
        EeIMOR_b_MMKey1org21Flag: implementation-data-type=boolean
        EeIMOR_b_MKeyStrToE2: implementation-data-type=boolean
        EeIMOR_b_ImmoAuthValid_Mem: implementation-data-type=boolean
        EeIMOR_b_ImmoAuthValid_ECMMem: implementation-data-type=boolean
        EeIMOR_b_CodeRecCmplt_Mem: implementation-data-type=boolean
        EeIMOR_b_CntrlEncdResFlag: implementation-data-type=boolean
        EeIMOR_b_AuthCmdCntrlEncdRespFlag: implementation-data-type=boolean
        EeIMOR_b_AuthCmd15_InFlag: implementation-data-type=boolean
        EeIMOR_b_AuthCmd14_InFlag: implementation-data-type=boolean
        EeIMOR_b_AuthCmd13_InFlag: implementation-data-type=boolean
        EeIMOR_b_AuthCmd12_InFlag: implementation-data-type=boolean
        EeIMOR_b_AuthCmd11_InFlag: implementation-data-type=boolean
        EeIMOR_b_AuthCmd10_InFlag: implementation-data-type=boolean
        EeHPMR_b_ORC_LOCFA: implementation-data-type=boolean
        EeHMIR_e_HEV_LMP_RQ: implementation-data-type=TeHMIR_e_HEV_LMP
        EePWDR_b_DAPFA_OpenCntctr: implementation-data-type=boolean
        EePWDR_Cnt_WarmupCycle: implementation-data-type=uint8
        EePWDR_Cnt_DAP_FA_KeyCylCnt: implementation-data-type=uint8
        EeHCDR_b_InitDiag_Pass_Prev: implementation-data-type=boolean
        EeERER_e_TrailerConnectionSts: implementation-data-type=TePLTR_e_TrailerConnSts
        EeERER_b_EEPROM_WhperKM: implementation-data-type=boolean
        EeERER_b_EEPROM_EstRange: implementation-data-type=boolean
        EEeERER_e_TrailerConnectionSts: implementation-data-type=TePLTR_e_TrailerConnSts
        EeIMOR_y_MMKey1org21_Mem: implementation-data-type=uint8
        EeIMOR_b_AuthCmd01_InFlag: implementation-data-type=boolean
        EeIMOR_b_AuthCmd00_InFlag: implementation-data-type=boolean
        EeIMOR_y_MMKey_4_Mem: implementation-data-type=uint8
        EeIMOR_y_MMKey_5_Mem: implementation-data-type=uint8
        EeHVTR_b_OpnReq_SrvcProc1320: implementation-data-type=boolean
        EeIMOR_y_MMKey_6_Mem: implementation-data-type=uint8
        EePWDR_y_DID_B524: implementation-data-type=uint8
        EeAADR_Cnt_AAD_PSACntrLastCal: implementation-data-type=uint8
        Reserved{1..27}: implementation-data-type=uint8
    CumulativeNonVolatile_Rom_Core4
      114 x element, all with category=TYPE_REFERENCE:
        EePLTR_t_RTCTime: implementation-data-type=uint32
        EeHCDR_t_RealTime_Comp_On: implementation-data-type=uint32
        EeHCDR_t_RealTime_Comp_Off: implementation-data-type=uint32
        EeERER_l_EEPROM_EstRange: implementation-data-type=float32
        EeDCCR_t_V2GPerfInhibTime: implementation-data-type=float32
        EeDCCR_t_V2GTime: implementation-data-type=float32
        EeERER_F_EEPROM_WhperKM: implementation-data-type=float32
        EeERER_k_Modify_Factor: implementation-data-type=float32
        EeERER_l_VehDist_Delta: implementation-data-type=float32
        EePWDR_t_DAP_FA_InitTime: implementation-data-type=uint32
        EePWDR_t_DAP_FA_ElapsedTime: implementation-data-type=uint32
        EePWDR_l_DAP_FA_DistTravld: implementation-data-type=float32
        EeOBCR_t_EstTimeofChrg_Lv1: implementation-data-type=float32
        EeOBCR_t_EstTimeofChrg_Lv2: implementation-data-type=float32
        EeIMOR_M_Rand{1..4}_prev: implementation-data-type=float32
        EePLTR_t_PowerdownTime: implementation-data-type=uint32
        EeTPCR_e_HoldClusterMsg: implementation-data-type=sint16
        EeTPCR_e_HoldClusterMsg_KHC: implementation-data-type=sint16
        EePLTR_e_ShippingMode: implementation-data-type=sint16
        EeDMIR_d_ChargeTypeCnf: implementation-data-type=uint16
        EeDMIR_d_TgtSOCRngCnf: implementation-data-type=uint16
        EeIMOR_e_BuildAssemblyModeStat: implementation-data-type=sint16
        EeHVTR_e_StrtCmd_SrvcProc1320: implementation-data-type=uint16
        EePLTR_e_RTCStatus: implementation-data-type=sint16
        EeERER_e_DriveMode: implementation-data-type=sint16
        EeERER_e_TurtleMode: implementation-data-type=sint16
        EeAECR_e_MaxRegenDsrdSt: implementation-data-type=uint16
        EeOBCR_e_ChargingSystemSts: implementation-data-type=sint16
        EeOBCR_e_ChargingLevel: implementation-data-type=sint16
        EeCHFR_b_ChrgSysFault: implementation-data-type=boolean
        EeIMOR_y_MMKey1org22_Mem: implementation-data-type=uint8
        EeOBCR_b_PluggedIn: implementation-data-type=boolean
        EePLTR_b_RTC_CurrentTimeFA: implementation-data-type=boolean
        EeIMOR_b_AuthCmd08_InFlag: implementation-data-type=boolean
        EeIMOR_b_AuthCmd07_InFlag: implementation-data-type=boolean
        EeIMOR_b_AuthCmd06_InFlag: implementation-data-type=boolean
        EeIMOR_b_AuthCmd05_InFlag: implementation-data-type=boolean
        EeIMOR_b_AuthCmd04_InFlag: implementation-data-type=boolean
        EeIMOR_b_AuthCmd03_InFlag: implementation-data-type=boolean
        EeIMOR_b_AuthCmd02_InFlag: implementation-data-type=boolean
        EeIMOR_b_AuthCmd09_InFlag: implementation-data-type=boolean
        EeIMOR_y_MMKey_3_Mem: implementation-data-type=uint8
        EeIMOR_b_VC_VehCfg6_Stat_rec: implementation-data-type=boolean
        EeIMOR_b_VC_VehCfg4_Stat_rec: implementation-data-type=boolean
        EeIMOR_b_VC_VehCfg3_Stat_rec: implementation-data-type=boolean
        EeIMOR_b_VC_VehCfg2_Stat_rec: implementation-data-type=boolean
        EeIMOR_b_ORC_Health_rec: implementation-data-type=boolean
        EeIMOR_b_MMKey_6Flag: implementation-data-type=boolean
        EeIMOR_b_MMKey_5Flag: implementation-data-type=boolean
        EeIMOR_b_MMKey_4Flag: implementation-data-type=boolean
        EeIMOR_b_MMKey_3Flag: implementation-data-type=boolean
        EeIMOR_b_MMKey1org22Flag: implementation-data-type=boolean
        EeIMOR_b_MMKey1org21Flag: implementation-data-type=boolean
        EeIMOR_b_MKeyStrToE2: implementation-data-type=boolean
        EeIMOR_b_ImmoAuthValid_Mem: implementation-data-type=boolean
        EeIMOR_b_ImmoAuthValid_ECMMem: implementation-data-type=boolean
        EeIMOR_b_CodeRecCmplt_Mem: implementation-data-type=boolean
        EeIMOR_b_CntrlEncdResFlag: implementation-data-type=boolean
        EeIMOR_b_AuthCmdCntrlEncdRespFlag: implementation-data-type=boolean
        EeIMOR_b_AuthCmd15_InFlag: implementation-data-type=boolean
        EeIMOR_b_AuthCmd14_InFlag: implementation-data-type=boolean
        EeIMOR_b_AuthCmd13_InFlag: implementation-data-type=boolean
        EeIMOR_b_AuthCmd12_InFlag: implementation-data-type=boolean
        EeIMOR_b_AuthCmd11_InFlag: implementation-data-type=boolean
        EeIMOR_b_AuthCmd10_InFlag: implementation-data-type=boolean
        EeHPMR_b_ORC_LOCFA: implementation-data-type=boolean
        EeHMIR_e_HEV_LMP_RQ: implementation-data-type=TeHMIR_e_HEV_LMP
        EePWDR_b_DAPFA_OpenCntctr: implementation-data-type=boolean
        EePWDR_Cnt_WarmupCycle: implementation-data-type=uint8
        EePWDR_Cnt_DAP_FA_KeyCylCnt: implementation-data-type=uint8
        EeHCDR_b_InitDiag_Pass_Prev: implementation-data-type=boolean
        EeERER_e_TrailerConnectionSts: implementation-data-type=TePLTR_e_TrailerConnSts
        EeERER_b_EEPROM_WhperKM: implementation-data-type=boolean
        EeERER_b_EEPROM_EstRange: implementation-data-type=boolean
        EEeERER_e_TrailerConnectionSts: implementation-data-type=TePLTR_e_TrailerConnSts
        EeIMOR_y_MMKey1org21_Mem: implementation-data-type=uint8
        EeIMOR_b_AuthCmd01_InFlag: implementation-data-type=boolean
        EeIMOR_b_AuthCmd00_InFlag: implementation-data-type=boolean
        EeIMOR_y_MMKey_4_Mem: implementation-data-type=uint8
        EeIMOR_y_MMKey_5_Mem: implementation-data-type=uint8
        EeHVTR_b_OpnReq_SrvcProc1320: implementation-data-type=boolean
        EeIMOR_y_MMKey_6_Mem: implementation-data-type=uint8
        EePWDR_y_DID_B524: implementation-data-type=uint8
        EeAADR_Cnt_AAD_PSACntrLastCal: implementation-data-type=uint8
        Reserved{1..27}: implementation-data-type=uint8
    StaticNonVolatile_Ram_Core4
      42 x element, all with category=TYPE_REFERENCE:
        BeFWDR_r_Axle_Ratio: implementation-data-type=float32
        BeFWDR_r_Tcase_Hi_Ratio: implementation-data-type=float32
        BeFWDR_r_Tcase_Low_Ratio: implementation-data-type=float32
        BeRTMR_g_BSGRestartRsn: implementation-data-type=uint32
        BeTRGR_d_IP_PRNDLTestFlags: implementation-data-type=uint16
        BeFWDR_e_Tcase_Stat: implementation-data-type=sint16
        BeRTMR_y_ClutchLrnTstCndtnCheck3_PID: implementation-data-type=uint8
        BeRTMR_y_ElecOnlyTstCndtnCheck1_PID: implementation-data-type=uint8
        BeRTMR_y_ElecOnlyTstCndtnCheck2_PID: implementation-data-type=uint8
        BeRTMR_y_ReslvrOfsLrnCndtnCheck3_PID: implementation-data-type=uint8
        BeRTMR_y_ReslvrOfsLrnFaultStatus{3..5}_PID: implementation-data-type=uint8
        BeRTMR_y_ClutchLrnTstCndtnCheck2_PID: implementation-data-type=uint8
        BeRTMR_y_ClutchLrnTstCndtnCheck1_PID: implementation-data-type=uint8
        BeRTMR_y_ClutchLrnTestStatus_PID: implementation-data-type=uint8
        BeHSWR_b_ECMHdStatSaved: implementation-data-type=boolean
        Reserved{1..25}: implementation-data-type=uint8
    StaticNonVolatile_Rom_Core4
      42 x element, all with category=TYPE_REFERENCE:
        BeFWDR_r_Axle_Ratio: implementation-data-type=float32
        BeFWDR_r_Tcase_Hi_Ratio: implementation-data-type=float32
        BeFWDR_r_Tcase_Low_Ratio: implementation-data-type=float32
        BeRTMR_g_BSGRestartRsn: implementation-data-type=uint32
        BeTRGR_d_IP_PRNDLTestFlags: implementation-data-type=uint16
        BeFWDR_e_Tcase_Stat: implementation-data-type=sint16
        BeRTMR_y_ClutchLrnTstCndtnCheck3_PID: implementation-data-type=uint8
        BeRTMR_y_ElecOnlyTstCndtnCheck1_PID: implementation-data-type=uint8
        BeRTMR_y_ElecOnlyTstCndtnCheck2_PID: implementation-data-type=uint8
        BeRTMR_y_ReslvrOfsLrnCndtnCheck3_PID: implementation-data-type=uint8
        BeRTMR_y_ReslvrOfsLrnFaultStatus{3..5}_PID: implementation-data-type=uint8
        BeRTMR_y_ClutchLrnTstCndtnCheck2_PID: implementation-data-type=uint8
        BeRTMR_y_ClutchLrnTstCndtnCheck1_PID: implementation-data-type=uint8
        BeRTMR_y_ClutchLrnTestStatus_PID: implementation-data-type=uint8
        BeHSWR_b_ECMHdStatSaved: implementation-data-type=boolean
        Reserved{1..25}: implementation-data-type=uint8
    AdaptiveNonVolatile_Ram_Core4
      39 x element, all with category=TYPE_REFERENCE:
        DeESMR_P_HV_BatChrgPwrLTArb: implementation-data-type=float32
        DeESMR_P_HV_BatChrgPwrSTArb: implementation-data-type=float32
        DeESMR_P_HV_BatDschrgPwrLTArb: implementation-data-type=float32
        DeESMC_P_AccumChrgEnergy: implementation-data-type=float32
        DeESMC_P_AccumDisChgEnergy: implementation-data-type=float32
        DeESMC_I_AccumDisChrgCurr: implementation-data-type=float32
        DeESMC_I_AccumChrgCurr: implementation-data-type=float32
        DeESMR_P_HV_BatDschrgPwrSTArb: implementation-data-type=float32
        DeBPCR_P_HV_BatChrgPwrET: implementation-data-type=float32
        DeBPCR_P_HV_BatChrgPwrST: implementation-data-type=float32
        DeBPCR_P_HV_BatDschrgPwrET: implementation-data-type=float32
        DeBPCR_P_HV_BatDschrgPwrLT: implementation-data-type=float32
        DeBPCR_Pct_HV_BatSOC_DS: implementation-data-type=float32
        DeBPCR_P_HV_BatChrgPwrLT: implementation-data-type=float32
        DeBPCR_P_HV_BatDschrgPwrST: implementation-data-type=float32
        Reserved{1..24}: implementation-data-type=uint8
    AdaptiveNonVolatile_Rom_Core4
      39 x element, all with category=TYPE_REFERENCE:
        DeESMR_P_HV_BatChrgPwrLTArb: implementation-data-type=float32
        DeESMR_P_HV_BatChrgPwrSTArb: implementation-data-type=float32
        DeESMR_P_HV_BatDschrgPwrLTArb: implementation-data-type=float32
        DeESMC_P_AccumChrgEnergy: implementation-data-type=float32
        DeESMC_P_AccumDisChgEnergy: implementation-data-type=float32
        DeESMC_I_AccumDisChrgCurr: implementation-data-type=float32
        DeESMC_I_AccumChrgCurr: implementation-data-type=float32
        DeESMR_P_HV_BatDschrgPwrSTArb: implementation-data-type=float32
        DeBPCR_P_HV_BatChrgPwrET: implementation-data-type=float32
        DeBPCR_P_HV_BatChrgPwrST: implementation-data-type=float32
        DeBPCR_P_HV_BatDschrgPwrET: implementation-data-type=float32
        DeBPCR_P_HV_BatDschrgPwrLT: implementation-data-type=float32
        DeBPCR_Pct_HV_BatSOC_DS: implementation-data-type=float32
        DeBPCR_P_HV_BatChrgPwrLT: implementation-data-type=float32
        DeBPCR_P_HV_BatDschrgPwrST: implementation-data-type=float32
        Reserved{1..24}: implementation-data-type=uint8
    FE_Ram_Core4
      35 x element, all with category=TYPE_REFERENCE:
        FeSCPR_g_ChrgNowMaxTimetoPlugin: implementation-data-type=uint32
        FeSCPR_T_Sch2CP_DepTemp: implementation-data-type=float32
        FeSCPR_T_Sch1CP_DepTemp: implementation-data-type=float32
        FeSCPR_e_Sch2CP_DepMin: implementation-data-type=sint16
        FeSCPR_e_Sch2CP_DepHr: implementation-data-type=sint16
        FeSCPR_e_Sch2CH_StrtMin: implementation-data-type=sint16
        FeSCPR_e_Sch2CH_StrtHr: implementation-data-type=sint16
        FeSCPR_e_Sch2CH_EndMin: implementation-data-type=sint16
        FeSCPR_e_Sch2CH_EndHr: implementation-data-type=sint16
        FeSCPR_e_Sch1CP_DepMin: implementation-data-type=sint16
        FeSCPR_e_Sch1CP_DepHr: implementation-data-type=sint16
        FeSCPR_e_Sch1CH_StrtMin: implementation-data-type=sint16
        FeSCPR_e_Sch1CH_StrtHr: implementation-data-type=sint16
        FeSCPR_e_Sch1CH_EndMin: implementation-data-type=sint16
        FeSCPR_e_Sch1CH_EndHr: implementation-data-type=sint16
        FeSCPR_b_Sch2CP_DNR: implementation-data-type=boolean
        FeSCPR_b_CancelActFOTA: implementation-data-type=boolean
        FeSCPR_b_ChrgNowLatch: implementation-data-type=boolean
        FeSCPR_b_FOTA_Conflict: implementation-data-type=boolean
        FeSCPR_b_Sch1CH_ChrgUntFl: implementation-data-type=boolean
        FeSCPR_b_Sch1CH_DNR: implementation-data-type=boolean
        FeSCPR_b_Sch1CH_Enbl: implementation-data-type=boolean
        FeSCPR_b_Sch1CP_DNR: implementation-data-type=boolean
        FeSCPR_b_Sch1CP_Enbl: implementation-data-type=boolean
        FeSCPR_b_Sch2CH_ChrgUntFl: implementation-data-type=boolean
        FeSCPR_b_Sch2CH_DNR: implementation-data-type=boolean
        FeSCPR_b_Sch2CH_Enbl: implementation-data-type=boolean
        FeSCPR_b_Sch2CP_Enbl: implementation-data-type=boolean
        FeSCPR_e_FOTA_Install_Type: implementation-data-type=TeCITR_e_FOTA_Install_Type
        FeSCPR_e_Sch1CP_Allow: implementation-data-type=TeCITR_e_SchAllow
        FeSCPR_e_Sch2CP_Allow: implementation-data-type=TeCITR_e_SchAllow
        FeSCPR_y_Sch1CH_Day: implementation-data-type=uint8
        FeSCPR_y_Sch1CP_Day: implementation-data-type=uint8
        FeSCPR_y_Sch2CH_Day: implementation-data-type=uint8
        FeSCPR_y_Sch2CP_Day: implementation-data-type=uint8
    FE_Rom_Core4
      35 x element, all with category=TYPE_REFERENCE:
        FeSCPR_g_ChrgNowMaxTimetoPlugin: implementation-data-type=uint32
        FeSCPR_T_Sch2CP_DepTemp: implementation-data-type=float32
        FeSCPR_T_Sch1CP_DepTemp: implementation-data-type=float32
        FeSCPR_e_Sch2CP_DepMin: implementation-data-type=sint16
        FeSCPR_e_Sch2CP_DepHr: implementation-data-type=sint16
        FeSCPR_e_Sch2CH_StrtMin: implementation-data-type=sint16
        FeSCPR_e_Sch2CH_StrtHr: implementation-data-type=sint16
        FeSCPR_e_Sch2CH_EndMin: implementation-data-type=sint16
        FeSCPR_e_Sch2CH_EndHr: implementation-data-type=sint16
        FeSCPR_e_Sch1CP_DepMin: implementation-data-type=sint16
        FeSCPR_e_Sch1CP_DepHr: implementation-data-type=sint16
        FeSCPR_e_Sch1CH_StrtMin: implementation-data-type=sint16
        FeSCPR_e_Sch1CH_StrtHr: implementation-data-type=sint16
        FeSCPR_e_Sch1CH_EndMin: implementation-data-type=sint16
        FeSCPR_e_Sch1CH_EndHr: implementation-data-type=sint16
        FeSCPR_b_Sch2CP_DNR: implementation-data-type=boolean
        FeSCPR_b_CancelActFOTA: implementation-data-type=boolean
        FeSCPR_b_ChrgNowLatch: implementation-data-type=boolean
        FeSCPR_b_FOTA_Conflict: implementation-data-type=boolean
        FeSCPR_b_Sch1CH_ChrgUntFl: implementation-data-type=boolean
        FeSCPR_b_Sch1CH_DNR: implementation-data-type=boolean
        FeSCPR_b_Sch1CH_Enbl: implementation-data-type=boolean
        FeSCPR_b_Sch1CP_DNR: implementation-data-type=boolean
        FeSCPR_b_Sch1CP_Enbl: implementation-data-type=boolean
        FeSCPR_b_Sch2CH_ChrgUntFl: implementation-data-type=boolean
        FeSCPR_b_Sch2CH_DNR: implementation-data-type=boolean
        FeSCPR_b_Sch2CH_Enbl: implementation-data-type=boolean
        FeSCPR_b_Sch2CP_Enbl: implementation-data-type=boolean
        FeSCPR_e_FOTA_Install_Type: implementation-data-type=TeCITR_e_FOTA_Install_Type
        FeSCPR_e_Sch1CP_Allow: implementation-data-type=TeCITR_e_SchAllow
        FeSCPR_e_Sch2CP_Allow: implementation-data-type=TeCITR_e_SchAllow
        FeSCPR_y_Sch1CH_Day: implementation-data-type=uint8
        FeSCPR_y_Sch1CP_Day: implementation-data-type=uint8
        FeSCPR_y_Sch2CH_Day: implementation-data-type=uint8
        FeSCPR_y_Sch2CP_Day: implementation-data-type=uint8
    EE_RunTimeBlock1_Ram_Core4
      13 x element, all with category=TYPE_REFERENCE:
        AeASLR_v_STSLSpdLimMPH: implementation-data-type=float32
        AeDCCR_y_DCChrgTestSts: implementation-data-type=uint8
        AeADIR_e_WEDExtToolCmd: implementation-data-type=TeADIR_e_WEDExtToolCmd
        AeTRGR_y_PwrDwnSts: implementation-data-type=uint8
        AeRTMR_b_ElectricOnlyTest_Enabled: implementation-data-type=boolean
        AeRTMR_e_EngStrtType_LstActn: implementation-data-type=TeRTMR_e_EngStrtType
        AeRTMR_e_WED_ToothAbutResult: implementation-data-type=TeRTMR_e_WEDToothAbutResults
        AeRTMR_y_ElecOnlyTestResult_PID: implementation-data-type=uint8
        AeRTMR_y_ElecOnlyTestStatus_PID: implementation-data-type=uint8
        AeIMPR_b_HVRpdShtdwnCmd: implementation-data-type=boolean
        Reserved{1..3}: implementation-data-type=uint8
    EE_RunTimeBlock1_Rom_Core4
      13 x element, all with category=TYPE_REFERENCE:
        AeASLR_v_STSLSpdLimMPH: implementation-data-type=float32
        AeDCCR_y_DCChrgTestSts: implementation-data-type=uint8
        AeADIR_e_WEDExtToolCmd: implementation-data-type=TeADIR_e_WEDExtToolCmd
        AeTRGR_y_PwrDwnSts: implementation-data-type=uint8
        AeRTMR_b_ElectricOnlyTest_Enabled: implementation-data-type=boolean
        AeRTMR_e_EngStrtType_LstActn: implementation-data-type=TeRTMR_e_EngStrtType
        AeRTMR_e_WED_ToothAbutResult: implementation-data-type=TeRTMR_e_WEDToothAbutResults
        AeRTMR_y_ElecOnlyTestResult_PID: implementation-data-type=uint8
        AeRTMR_y_ElecOnlyTestStatus_PID: implementation-data-type=uint8
        AeIMPR_b_HVRpdShtdwnCmd: implementation-data-type=boolean
        Reserved{1..3}: implementation-data-type=uint8
    EE_RunTimeBlock2_Ram_Core4
      8 x element, all with category=TYPE_REFERENCE:
        AePLTR_Pct_CS_SOCSetPt: implementation-data-type=float32
        AePLTR_Pct_IP_SOCSetPt: implementation-data-type=float32
        AePLTR_milel_IPEETestMileageLimit: implementation-data-type=float32
        AePLTR_milel_OdometerLimit: implementation-data-type=float32
        AePLTR_b_InFieldMode: implementation-data-type=boolean
        AePLTR_b_PwrOffOk: implementation-data-type=boolean
        AePLTR_b_REMDisabled: implementation-data-type=boolean
        AePLTR_b_RadFanHandshake_disbld: implementation-data-type=boolean
    EE_RunTimeBlock2_Rom_Core4
      8 x element, all with category=TYPE_REFERENCE:
        AePLTR_Pct_CS_SOCSetPt: implementation-data-type=float32
        AePLTR_Pct_IP_SOCSetPt: implementation-data-type=float32
        AePLTR_milel_IPEETestMileageLimit: implementation-data-type=float32
        AePLTR_milel_OdometerLimit: implementation-data-type=float32
        AePLTR_b_InFieldMode: implementation-data-type=boolean
        AePLTR_b_PwrOffOk: implementation-data-type=boolean
        AePLTR_b_REMDisabled: implementation-data-type=boolean
        AePLTR_b_RadFanHandshake_disbld: implementation-data-type=boolean
    EE_IMMOBILIZERMMKEY_StrIMM_Ram_Core4
      element AaIMOR_y_MMKeyStr_EE: implementation-data-type=rt_Array_UInt8_7
      element Reserved1: implementation-data-type=uint8
    EE_IMMOBILIZERMMKEY_StrIMM_Rom_Core4
      element AaIMOR_y_MMKeyStr_EE: implementation-data-type=rt_Array_UInt8_7
      element Reserved1: implementation-data-type=uint8
    EE_IMMOBILIZERAUTHSTAT_StrIMM_Ram_Core4
      4 x element, all with category=TYPE_REFERENCE:
        AeIMOR_b_UpdtAuthStat: implementation-data-type=boolean
        Reserved{1..3}: implementation-data-type=uint8
    EE_IMMOBILIZERAUTHSTAT_StrIMM_Rom_Core4
      4 x element, all with category=TYPE_REFERENCE:
        AeIMOR_b_UpdtAuthStat: implementation-data-type=boolean
        Reserved{1..3}: implementation-data-type=uint8
    EE_IMMOBYPASSCNTR_StrIMM_Ram_Core4
      4 x element, all with category=TYPE_REFERENCE, implementation-data-type=uint8:
        AeIMOR_Cnt_ImmoByPassCntr
        Reserved{1..3}
    EE_IMMOBYPASSCNTR_StrIMM_Rom_Core4
      4 x element, all with category=TYPE_REFERENCE, implementation-data-type=uint8:
        AeIMOR_Cnt_ImmoByPassCntr
        Reserved{1..3}
